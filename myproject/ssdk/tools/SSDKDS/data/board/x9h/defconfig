## myproject/ssdk/tools/SSDKDS/data/board/x9h/defconfig
```kconfig
#
# G9X Board Options
#
CONFIG_MEM_BASE=0x3B000000
CONFIG_MEM_SIZE=0x2000000
CONFIG_BOARD_REMAP=y

#
# Arch Type
#

#
# Architecture Options
#
CONFIG_ARCH_ARM=y
CONFIG_ARCH="arm"
# CONFIG_ARCH_WITH_SMP is not set
CONFIG_ARCH_WITH_CACHE=y
CONFIG_ARCH_CACHE_LINE=32
CONFIG_ARCH_ICACHE=y
CONFIG_ARCH_DCACHE=y
# CONFIG_ARCH_L2CACHE is not set
CONFIG_ARCH_EARLY_ENABLE_ICACHE=y
CONFIG_ARCH_EARLY_ENABLE_DCACHE=y
CONFIG_ARCH_WITH_FPU=y
CONFIG_ARCH_USE_FPU=y
# CONFIG_ARCH_WITH_MMU is not set
CONFIG_ARCH_WITH_MPU=y
CONFIG_ARCH_USE_MPU=y
CONFIG_ARCH_STACK_DYNAMIC=y
CONFIG_ARCH_STACK_COLORATION=y
CONFIG_ARCH_ABT_STACK_SIZE=128
CONFIG_ARCH_IRQ_STACK_SIZE=512
CONFIG_ARCH_FIQ_STACK_SIZE=256
CONFIG_ARCH_SYS_STACK_SIZE=2048
CONFIG_ARCH_UND_STACK_SIZE=128
CONFIG_ARCH_SVC_STACK_SIZE=2048

#
# ARM Options
#
CONFIG_ARCH_CORTEXR5=y
CONFIG_ARCH_FAMILY="armv7-r"
CONFIG_ARM_THUMB=y
# CONFIG_ARM_THUMB2 is not set
# CONFIG_ARM_HIGHVECTORS is not set
CONFIG_ARM_WITH_TCM=y
CONFIG_ARM_WITH_CP15=y
CONFIG_ARM_WITH_PMU=y
# CONFIG_ENABLE_CYCLE_COUNTER is not set
CONFIG_ARM_FPU_D16=y

#
# ARMv7-R Configuration Options
#
CONFIG_ARMV7R_USE_TCMA=y
CONFIG_ARMV7R_TCMA_BASE=0x4C0000
# CONFIG_ARMV7R_TCMA_ECC is not set
CONFIG_ARMV7R_USE_TCMB=y
CONFIG_ARMV7R_TCMB_BASE=0x4B0000
# CONFIG_ARMV7R_TCMB_ECC is not set
# CONFIG_ARMV7R_MPU_CACHE_ALIGN_CHECK is not set
# end of Arch Type

#
# Board Common Features
#

#
# Board Common Features
#
CONFIG_MAIN_THREAD_STACK_SIZE=1024
CONFIG_MAIN_THREAD_PRIORITY=2
# end of Board Common Features

#
# RTOS Features
#

#
# RTOS Options
#
CONFIG_OS_FREERTOS=y
# CONFIG_OS_BAREMETAL is not set
CONFIG_OS_TICK=1
CONFIG_OS_DEFAULT_STACK_SIZE=1024
CONFIG_OS_MIN_STACK_SIZE=512
CONFIG_OS_MIN_THREAD_PRIO=1
CONFIG_OS_MAX_THREAD_PRIO=32

#
# FreeRTOS Options
#
CONFIG_API_CALL_INTERRUPT_PRIORITY=18
# end of RTOS Features

#
# Device Drivers
#

#
# Drivers Options
#
# CONFIG_ADC is not set
CONFIG_CLK=y

#
# CLK Driver Options
#
CONFIG_KUNLUN_CKGEN=y
CONFIG_SC_PLL=y
CONFIG_GPIO=y

#
# GPIO Driver Options
#
CONFIG_KUNLUN_GPIO=y
# CONFIG_I2C is not set
CONFIG_IRQ=y

#
# IRQ Driver Options
#
CONFIG_ARM_GIC=y
# CONFIG_SDRV_VIC is not set
# CONFIG_MMC is not set
# CONFIG_PCIE is not set
CONFIG_PINCTRL=y

#
# Pin Ctrl Driver Options
#
CONFIG_KUNLUN_PINCTRL=y
CONFIG_RESETGEN=y

#
# Reset Gen Driver Options
#
CONFIG_KUNLUN_RESETGEN=y
CONFIG_SCR=y

#
# SCR Driver Options
#
# CONFIG_SPI is not set
# CONFIG_OSPI is not set
CONFIG_TIMER=y

#
# Timer Driver Options
#
# CONFIG_XLI_TTC is not set
CONFIG_SDRV_TMR=y
CONFIG_UART=y

#
# Uart Driver Options
#
CONFIG_DW_UART=y
# CONFIG_XLI_UART is not set
# CONFIG_SDRV_UART is not set
# CONFIG_XTRG is not set
# end of Device Drivers

#
# Library Routines
#

#
# LIB Options
#
CONFIG_DEBUG=y

#
# Debug Options
#
CONFIG_DEBUG_LEVEL=2
CONFIG_LIBC=y

#
# LIBC Options
#
CONFIG_NEWLIB=y
# CONFIG_IARLIB is not set
# CONFIG_STD_HEAP is not set
# end of Library Routines

#
# Middleware Routines
#

#
# Middleware Options
#
CONFIG_CLI=y

#
# CLI Options
#
CONFIG_CLI_STACK_SIZE=1024
CONFIG_CLI_PRIORITY=24
# CONFIG_CLI_SYNC_MODE is not set
# CONFIG_MEM_RW is not set
# CONFIG_DHRYSTONE is not set
# CONFIG_FLASH_LOADER is not set
# end of Middleware Routines
```

## myproject/ssdk/tools/SSDKDS/data/project/d3_disp_sf/Kconfig
```kconfig
comment "Taishan EVB SF Board Options"

config MEM_BASE
    hex "Memory Start Address"
    default 0x404000

config MEM_SIZE
    hex "Memory Size"
    default 0x1FC000

rsource "../../Kconfig"
```
