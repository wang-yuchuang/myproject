## myproject/ssdk/examples/kunlun/application/pvt/Kconfig
```kconfig
comment "pvt application config options"

menuconfig PVT_APPLICATION_PRINT
    bool "pvt application for print pvt info"
    default n

if PVT_APPLICATION_PRINT
    config PVT_AUTO_OUT_PRT
        bool "print pvt auto start"
        default n

    config PVT_PRINT_WAIT_TIME
        int "print pvt info wait time"
        default 3

endif

menuconfig PVT_APPLICATION_MONITOR
    bool "pvt application for monitor temperature"
    default n


if PVT_APPLICATION_MONITOR
    config PVT_MONITOR_DEV
        int "use pvt device for temperature monitor"
        default 0
        help
          "0 use safety pvt device and 1 use ap pvt device"

    config PVT_MONITOR_WAIT_TIME
        int "monitor thread wait time(s)"
        default 3

    config PVT_MONITOR_TYPE_0
        int "monitor ins0 temperature type"
        default 0
        help
          "0: monitor temperature type hyst high"
          "1: monitor temperature type hyst low"

    config PVT_MONITOR_VAL_H_0
        int "monitor ins0 temperature high value"
        default 90

    config PVT_MONITOR_VAL_L_0
        int "monitor ins0 temperature low value"
        default 85

    config PVT_MONITOR_TYPE_1
        int "monitor ins1 temperature type"
        default 0
        help
          "0: monitor temperature type hyst high"
          "1: monitor temperature type hyst low"

    config PVT_MONITOR_VAL_H_1
        int "monitor ins1 temperature high value"
        default 95

    config PVT_MONITOR_VAL_L_1
        int "monitor ins1 temperature low value"
        default 90
endif
```

## myproject/ssdk/examples/kunlun/application/sdlog-tools/Kconfig
```kconfig
comment "sdlog command support options"

config SDLOGC
    bool "supoort sdlogc"
    select SDRV_VIRT_UART
    default n

config SDLOGD
    bool "supoort sdlogd"
    select SDRV_VIRT_UART
    default n

config BOARD_SDLOGD
    bool "support board sdlogd"
    depends on SDLOGD
    default n

config SDLOGD_POLL_SAF
    bool "supoort polling safety logbuf"
    depends on SDLOGD
    default n

config SDLOGD_POLL_SEC
    bool "supoort polling secure logbuf"
    depends on SDLOGD
    default n

config SDLOGD_POLL_MP
    bool "supoort polling mp logbuf"
    depends on SDLOGD
    default n

config SDLOGD_POLL_AP1
    bool "supoort polling ap1 logbuf"
    depends on SDLOGD
    default n

config SDLOGD_POLL_AP2
    bool "supoort polling ap2 logbuf"
    depends on SDLOGD
    default n

config SDLOGD_OUTPUT_UART
    bool "support sdlogd uart output"
    depends on SDLOGD
    default n

config SDLOGD_UPDATE_THRESHOLD
    string "sdlogd update threshold"
    default "50"

config SDLOGD_POLL_INTERVAL_MS
    string "sdlogd polling interval"
    default "5000"

config SDSHELL_BACKEND
    bool "support sdshell backend"
    select SDRV_VIRT_UART
    default n

config SDSHELL_AP1_FRONTEND
    bool "support ap1 as sdshell frontend"
    depends on SDSHELL_BACKEND
    default n

config SDSHELL_AP2_FRONTEND
    bool "support ap2 as sdshell frontend"
    depends on SDSHELL_BACKEND
    default n
```

## myproject/ssdk/examples/kunlun/drivers/Kconfig
```kconfig
comment "Driver Example Options"

config BACKLIGHT_DEMO
    bool "backlight Example Application Support"
    depends on CLI
    default n

menuconfig SILEX_CRYPTO_TESTER
    bool "Silex CRYPTO Tester Support"
    default n

if SILEX_CRYPTO_TESTER
rsource "crypto/crypto_silex/Kconfig"
endif # SILEX_CRYPTO_TESTER

menuconfig DISP_TESTER
    bool "Display Tester Support"
    default n

if DISP_TESTER
rsource "disp/Kconfig"
endif # DISP_TESTER

config FUSE_DEMO
    bool "fuse Example Application Support"
    depends on CLI
    default n

config GPIO_DEMO
    bool "GPIO Example Application Support"
    depends on CLI
    default n

if GPIO_DEMO
rsource "gpio/Kconfig"
endif #GPIO_DEMO

config I2CTOOLS
    bool "I2C Test Tools"
    depends on CLI
    default n

# input demo/test menuconfig
menuconfig INPUT_DEMO
    bool "input example demo & tester support"
    select INPUT_SERVICE
    default n

if INPUT_DEMO
    rsource "input/Kconfig"
endif # INPUT_DEMO

menuconfig MBOX_DEMO
    bool "MBOX Example Application Support"
    select MBOX
    default n

if MBOX_DEMO
rsource "mbox/Kconfig"
endif # MBOX_DEMO

# pmu driver menuconfig
menuconfig PMU_DEMO
    bool "PMU Example demo support"
    select PMU
    default n

if PMU_DEMO
rsource "pmu/Kconfig"
endif # PMU_DEMO

# pvt driver menuconfig
menuconfig PVT_DEMO
    bool "PVT Example demo support"
    select PVT
    default n

if PVT_DEMO
rsource "pmu/Kconfig"
endif # PVT_DEMO

menuconfig RPMSG_DEMO
    bool "RPMSG Example Application Support"
    select RPMSG
    select RPMSG_SERVICE
    default n

if RPMSG_DEMO
rsource "rpmsg/Kconfig"
endif # RPMSG_DEMO

menuconfig RTC_DEMO
    bool "RTC Example Application Support"
    select RTC
    default n

if RTC_DEMO
rsource "rtc/Kconfig"
endif

# serdes demo/test menuconfig
menuconfig SERDES_DEMO
    bool "serdes example demo & tester support"
    depends on SERDES
    default n

if SERDES_DEMO
    rsource "serdes/Kconfig"
endif # SERDES_DEMO

config SPI_DEMO
    bool "SPI Example Application Support"
    depends on CLI
    default n

# touch demo/test menuconfig
menuconfig TOUCH_DEMO
    bool "touch example demo & tester support"
    depends on TOUCH_KUNLUN_PLATFORM
    default n

if TOUCH_DEMO
    rsource "touch/Kconfig"
endif # TOUCH_DEMO

# vpu demo/test menuconfig
menuconfig VPU_DEMO
    bool "vpu example demo & tester support"
    select VPU
    select RES_LOADER
    default n

if VPU_DEMO
    rsource "vpu/Kconfig"
endif # VPU_DEMO

menuconfig IRQ_TESTER
    bool "TIMER IRQ Tester Support"
    select INTERRUPT_NESTING
    default n

if IRQ_TESTER
rsource "irq/Kconfig"
endif # IRQ_TESTER
menuconfig I2C_TESTER
    bool "I2C Tester Support"
    default n

if I2C_TESTER
rsource "i2c/Kconfig"
endif # I2C_TESTER

menuconfig DMA_TESTER
    bool "DMA Tester Support"
    default n

if DMA_TESTER
rsource "dma/Kconfig"
endif # DMA_TESTER

menuconfig CAN_TESTER
    bool "CAN Tester Support"
    default n

if CAN_TESTER
rsource "can/Kconfig"
endif # CAN_TESTER

menuconfig PIN_TESTER
    bool "PIN Tester Support"
    default n

if PIN_TESTER
rsource "pin/Kconfig"
endif # PIN_TESTER

menuconfig WDOG_TESTER
    bool "WDOG Tester Support"
    default n

if WDOG_TESTER
rsource "watchdog/Kconfig"
endif # WDOG_TESTER

menuconfig NORFLASH_TESTER
    bool "Norflash Tester Support"
    default n

if NORFLASH_TESTER
rsource "norflash/Kconfig"
endif # NORFLASH_TESTER

menuconfig PCIE_TESTER
    bool "PCIE Tester Support"
    default n

if PCIE_TESTER
rsource "pcie/Kconfig"
endif # PCIE_TESTER

menuconfig MMC_TESTER
    bool "MMC Tester Support"
    default n

if MMC_TESTER
rsource "mmc/Kconfig"
endif # MMC_TESTER

menuconfig DISK_DEMO
    bool "DISK Example Support"
    default n

if DISK_DEMO
rsource "disk/Kconfig"
endif # DISK_DEMO

menuconfig FEE_DEMO
    bool "FEE Example Support"
    depends on (CDNS_OSPI || TAISHAN_XSPI) && DISK_NOR_FLASH
    default y

if FEE_DEMO
rsource "fee/Kconfig"
endif # FEE_DEMO

menuconfig VPU_TEST
    bool "vpu test"
    default n

if VPU_TEST
    rsource "vpu_test/Kconfig"
endif # VPU_TEST

menuconfig ETH_TEST
    bool "eth test"
    default n

if ETH_TEST
    rsource "eth/Kconfig"
endif # ETH_TEST

menuconfig SPINLOCK_TEST
    bool "spinlock interface test"
    default n

if SPINLOCK_TEST
    rsource "spinlock/Kconfig"
endif # SPINLOCK_TES

if ARCH_WITH_SMP
menuconfig IPI_TEST
    bool "ipi irq test"
    default n

if IPI_TEST
    rsource "ipi/Kconfig"
endif # IPI_TEST
endif # ARCH_WITH_SMP

menuconfig DW_UART_TEST
    bool "DesignWare Uart test"
    default n

if DW_UART_TEST
rsource "dw_uart/Kconfig"
endif # DW_UART_TEST
```

## myproject/ssdk/examples/kunlun/drivers/disp/Kconfig
```kconfig
comment "Display Tester Options"

config DISP_PQ_TESTER
    bool "display pq tester"
    default n
```

## myproject/ssdk/examples/kunlun/drivers/i2c/Kconfig
```kconfig
comment "I2C Tester Options"
choice
    prompt "select i2c tools type"
    default I2C_TOOLS_VALIDATION

    config I2C_TOOLS_VALIDATION
        bool "i2c tools for validation"
    config I2C_TOOLS_CMD
        bool "i2c tools for command"
endchoice
```

## myproject/ssdk/examples/kunlun/drivers/mbox/Kconfig
```kconfig
comment "MBOX Demo Options"

config KUNLUN_MBOX_DEMO
    bool "Kunlun mbox demo"
    select KUNLUN_MBOX
    depends on CLI
    default n
```

## myproject/ssdk/examples/kunlun/drivers/norflash/Kconfig
```kconfig
comment "Norflash Tester Options"

config KUNLUN_SNOR_TEST
    bool "Kunlun ospi Test"
    default n

config OSPI1_TEST
    bool "Kunlun ospi1 Test"
    default n
    depends on KUNLUN_SNOR_TEST

config OSPI2_TEST
    bool "Kunlun ospi2 Test"
    default n
    depends on KUNLUN_SNOR_TEST

config SPI_NOR_VALIDATION
    bool "Kunlun validation Test"
    default n
```

## myproject/ssdk/examples/kunlun/drivers/pin/Kconfig
```kconfig
comment "PIN Tester Options"

config PINMUX_AP
    bool "support AP domain pinmux options"
    default y
```
