//*****************************************************************************
//
// rsa.c - hal for rsa Module.
//
// Copyright (c) 2019-2029 SemiDrive Incorporated.  All rights reserved.
// Software License Agreement
//
//*****************************************************************************
#include <sd_rsa.h>

#define RSA_1024_LEN        128
#define RSA_2048_LEN        256
#define RSA_3072_LEN        384
#define RSA_4096_LEN        512

#define RSA_SUPPORT_PKA_ID_MASK 0x04 // 0~3 support pka 4~7 donot support

uint8_t __attribute__((aligned(CONFIG_ARCH_CACHE_LINE))) rsa_p_1024[RSA_1024_LEN] =
    "\x00\x00\x00\x00\x00\x00\x00\x00\x00\x00\x00\x00\x00\x00\x00\x00"
    "\x00\x00\x00\x00\x00\x00\x00\x00\x00\x00\x00\x00\x00\x00\x00\x00"
    "\x00\x00\x00\x00\x00\x00\x00\x00\x00\x00\x00\x00\x00\x00\x00\x00"
    "\x00\x00\x00\x00\x00\x00\x00\x00\x00\x00\x00\x00\x00\x00\x00\x00"
    "\xee\xcf\xae\x81\xb1\xb9\xb3\xc9\x08\x81\x0b\x10\xa1\xb5\x60\x01"
    "\x99\xeb\x9f\x44\xae\xf4\xfd\xa4\x93\xb8\x1a\x9e\x3d\x84\xf6\x32"
    "\x12\x4e\xf0\x23\x6e\x5d\x1e\x3b\x7e\x28\xfa\xe7\xaa\x04\x0a\x2d"
    "\x5b\x25\x21\x76\x45\x9d\x1f\x39\x75\x41\xba\x2a\x58\xfb\x65\x99";
uint8_t __attribute__((aligned(CONFIG_ARCH_CACHE_LINE))) rsa_q_1024[RSA_1024_LEN] =
    "\x00\x00\x00\x00\x00\x00\x00\x00\x00\x00\x00\x00\x00\x00\x00\x00"
    "\x00\x00\x00\x00\x00\x00\x00\x00\x00\x00\x00\x00\x00\x00\x00\x00"
    "\x00\x00\x00\x00\x00\x00\x00\x00\x00\x00\x00\x00\x00\x00\x00\x00"
    "\x00\x00\x00\x00\x00\x00\x00\x00\x00\x00\x00\x00\x00\x00\x00\x00"
    "\xc9\x7f\xb1\xf0\x27\xf4\x53\xf6\x34\x12\x33\xea\xaa\xd1\xd9\x35"
    "\x3f\x6c\x42\xd0\x88\x66\xb1\xd0\x5a\x0f\x20\x35\x02\x8b\x9d\x86"
    "\x98\x40\xb4\x16\x66\xb4\x2e\x92\xea\x0d\xa3\xb4\x32\x04\xb5\xcf"
    "\xce\x33\x52\x52\x4d\x04\x16\xa5\xa4\x41\xe7\x00\xaf\x46\x15\x03";

uint8_t __attribute__((aligned(CONFIG_ARCH_CACHE_LINE))) rsa_p_2048[RSA_2048_LEN] =
    "\x00\x00\x00\x00\x00\x00\x00\x00\x00\x00\x00\x00\x00\x00\x00\x00"
    "\x00\x00\x00\x00\x00\x00\x00\x00\x00\x00\x00\x00\x00\x00\x00\x00"
    "\x00\x00\x00\x00\x00\x00\x00\x00\x00\x00\x00\x00\x00\x00\x00\x00"
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    "\x46\x58\x33\x68\x46\xf5\x6e\x46\x86\x18\x81\xc1\x02\x33\xd2\x17"
    "\x6b\xf1\x5a\x5e\x96\xdd\xc7\x80\xbc\x86\x8a\xa7\x7d\x3c\xe7\x69";
uint8_t __attribute__((aligned(CONFIG_ARCH_CACHE_LINE))) rsa_q_2048[RSA_2048_LEN] =
    "\x00\x00\x00\x00\x00\x00\x00\x00\x00\x00\x00\x00\x00\x00\x00\x00"
    "\x00\x00\x00\x00\x00\x00\x00\x00\x00\x00\x00\x00\x00\x00\x00\x00"
    "\x00\x00\x00\x00\x00\x00\x00\x00\x00\x00\x00\x00\x00\x00\x00\x00"
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    "\x34\x5c\x03\xe0\x5f\x41\xd5\x1b\x5c\x3a\x90\xa3\xf2\x40\x73\xc7"
    "\xd7\x4a\x4f\xe2\x5d\x9c\xf2\x1c\x75\x96\x0f\x3f\xc3\x86\x31\x83";

uint8_t __attribute__((aligned(CONFIG_ARCH_CACHE_LINE))) rsa_p_3072[RSA_3072_LEN] =
    "\x00\x00\x00\x00\x00\x00\x00\x00\x00\x00\x00\x00\x00\x00\x00\x00"
    "\x00\x00\x00\x00\x00\x00\x00\x00\x00\x00\x00\x00\x00\x00\x00\x00"
    "\x00\x00\x00\x00\x00\x00\x00\x00\x00\x00\x00\x00\x00\x00\x00\x00"
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    "\x80\x32\x7e\xac\xd8\x73\xdf\x0c\x9b\xb4\xda\x8d\x30\xda\x77\xed"
    "\xbc\x09\x30\x00\x6d\xbf\x3d\x6e\xf9\x69\xde\x1b\xfd\x05\x7f\x03";
uint8_t __attribute__((aligned(CONFIG_ARCH_CACHE_LINE))) rsa_q_3072[RSA_3072_LEN] =
    "\x00\x00\x00\x00\x00\x00\x00\x00\x00\x00\x00\x00\x00\x00\x00\x00"
    "\x00\x00\x00\x00\x00\x00\x00\x00\x00\x00\x00\x00\x00\x00\x00\x00"
    "\x00\x00\x00\x00\x00\x00\x00\x00\x00\x00\x00\x00\x00\x00\x00\x00"
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    "\xf1\xf3\x0b\x30\x16\x27\x0d\xd8\xc3\x0e\xad\x74\xe6\x99\xf2\xd6"
    "\x8e\x28\x5e\x89\x2e\xcf\x55\x70\x06\x22\xea\x67\xf6\x51\x2f\x3f";

uint8_t __attribute__((aligned(CONFIG_ARCH_CACHE_LINE))) rsa_p_4096[RSA_4096_LEN] =
    "\x00\x00\x00\x00\x00\x00\x00\x00\x00\x00\x00\x00\x00\x00\x00\x00"
    "\x00\x00\x00\x00\x00\x00\x00\x00\x00\x00\x00\x00\x00\x00\x00\x00"
    "\x00\x00\x00\x00\x00\x00\x00\x00\x00\x00\x00\x00\x00\x00\x00\x00"
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    "\xe2\x5d\xb3\xc5\xd3\xcc\xbe\x49\x4a\xd1\xf1\x62\xe7\x53\x32\x7f"
    "\x04\xd1\x47\x74\x17\xc2\xda\x68\x75\x15\x56\xd9\x0d\xa9\xae\x83";
uint8_t __attribute__((aligned(CONFIG_ARCH_CACHE_LINE))) rsa_q_4096[RSA_4096_LEN] =
    "\x00\x00\x00\x00\x00\x00\x00\x00\x00\x00\x00\x00\x00\x00\x00\x00"
    "\x00\x00\x00\x00\x00\x00\x00\x00\x00\x00\x00\x00\x00\x00\x00\x00"
    "\x00\x00\x00\x00\x00\x00\x00\x00\x00\x00\x00\x00\x00\x00\x00\x00"
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    "\x8e\x55\x5f\x0d\x85\x5f\xcb\x6d\x3d\xad\x5a\x15\xf2\x89\xc5\x6b"
    "\x9b\x21\x29\x05\xd2\x9d\x90\x3d\x09\xfe\x7b\xf8\x40\xd7\xc9\xa1";

//*****************************************************************************
//
//! hal_rsa_encrypt.
//!
//! @param handle input, opration handle for uplayer,creat by ce hal
//! @param pub_key input, rsa pubkey includ n,e
//! @param src input, msg for encrypt
//! @param src_size input, in msg len
//! @param dst output, buff for encrypted msg
//! @param dst_size input, buff len
//! @param padding input, padding type(not used)
//!
//! This function is for rsa encrypt
//!
//! @return crypto_status_t CRYPTO_SUCCESS
//
//*****************************************************************************
crypto_status_t hal_rsa_encrypt(void* handle, const rsa_pubkey_t* pub_key,
                            const uint8_t* src, uint32_t src_size, uint8_t* dst, uint32_t dst_size,
                            int padding)
{
    uint32_t vce_id;
    buff_addr_type_t addr_type = HAL_EXT_MEM;
    crypto_status_t ret = CRYPTO_SUCCESS;
    crypto_instance_t* l_cryptoinstance = NULL;

    if (handle == NULL) {
        ret = CRYPTO_ERROR;
    } else {
        l_cryptoinstance = (crypto_instance_t*)handle;

        /*do ce init and enable here*/

        vce_id = l_cryptoinstance->vce_id;

        if ((vce_id & RSA_SUPPORT_PKA_ID_MASK) == 0) {
            if (l_cryptoinstance->rsa_method->encrypt) {
                ret = l_cryptoinstance->rsa_method->encrypt(vce_id, SD_RSA_PADDING_NONE
                        , block_t_convert(src, src_size, addr_type)
                        , block_t_convert(pub_key->n, pub_key->n_len, addr_type)
                        , block_t_convert(pub_key->e, pub_key->e_len, addr_type)
                        , block_t_convert(dst, dst_size, HAL_EXT_MEM)
                        , SD_ALG_SHA1);
            }
        }
        else {
            ret = CRYPTO_INVALID_CE;
        }
    }

    return ret;
}

//*****************************************************************************
//
//! hal_rsa_decrypt.
//!
//! @param handle input, opration handle for uplayer,creat by ce hal
//! @param pri_key input, rsa pri key includ d info
//! @param out_len input, decrypt out len
//! @param out output, buff for decrypt
//! @param max_out input, buff len
//! @param in input, msg for decrypt
//! @param in_len input, msg len
//! @param padding input, padding type(not used)
//!
//! This function is for rsa decrypt
//!
//! @return crypto_status_t CRYPTO_SUCCESS
//
//*****************************************************************************
crypto_status_t hal_rsa_decrypt(void* handle, const rsa_keypair_t* pri_key, size_t out_len, uint8_t* out, size_t max_out,
                            const uint8_t* in, size_t in_len, int padding)
{
    uint32_t vce_id;
    buff_addr_type_t addr_type = HAL_EXT_MEM;
    crypto_status_t ret = CRYPTO_SUCCESS;
    crypto_instance_t* l_cryptoinstance = NULL;
    uint32_t size = 128;

    if (handle == NULL) {
        ret = CRYPTO_ERROR;
    }
    else {
        l_cryptoinstance = (crypto_instance_t*)handle;

        /*do ce init and enable here*/

        vce_id = l_cryptoinstance->vce_id;

        ssdk_printf(SSDK_DEBUG, "out_len = %d\n", (uint32_t)out_len);

        //out_len_temp = pri_key->n_len;

        if ((vce_id & RSA_SUPPORT_PKA_ID_MASK) == 0) {
            if (l_cryptoinstance->rsa_method->decrypt) {
                ret = l_cryptoinstance->rsa_method->decrypt(vce_id,
                        ESEC_RSA_PADDING_NONE,
                        block_t_convert(in, in_len, addr_type),
                        block_t_convert(pri_key->n, pri_key->n_len, addr_type),
                        block_t_convert(pri_key->d, pri_key->d_len, addr_type),
                        block_t_convert(out, pri_key->n_len, addr_type),
                        0,
                        &size,
                        SD_ALG_SHA1);
            }
        }
        else {
            ret = CRYPTO_INVALID_CE;
        }
    }

    return ret;
}

//*****************************************************************************
//
//! hal_rsa_sign.
//!
//! @param handle input, opration handle for uplayer,creat by ce hal
//! @param hash_nid input, hash type (not used )
//! @param in input, msg for sign
//! @param in_len input, msg len
//! @param out output
//! @param out_len output len
//! @param pri_key input, priv key
//! @param padding input, padding type
//! @param salt_len input, salt length
//!
//! This function is for rsa signature
//!
//! @return crypto_status_t
//
//*****************************************************************************
crypto_status_t hal_rsa_sign(void* handle, int hash_nid, const uint8_t* in, unsigned in_len, uint8_t* out,
                         unsigned out_len, const rsa_keypair_t* pri_key, int padding, uint32_t salt_len)
{
    uint32_t vce_id;
    buff_addr_type_t addr_type = HAL_EXT_MEM;
    crypto_status_t ret = CRYPTO_SUCCESS;
    crypto_instance_t* l_cryptoinstance = NULL;

    if (handle == NULL) {
        ret = CRYPTO_ERROR;
    }
    else {
        l_cryptoinstance = (crypto_instance_t*)handle;

        /*do ce init and enable here*/

        vce_id = l_cryptoinstance->vce_id;

        //out_len_temp = pri_key->n_len;

        if ((vce_id & RSA_SUPPORT_PKA_ID_MASK) == 0) {
            if (l_cryptoinstance->rsa_method->sign) {
                ret = l_cryptoinstance->rsa_method->sign(vce_id, SD_ALG_SHA256, padding,
                        block_t_convert(in, in_len, addr_type),
                        //block_t_convert((void *)(sram_base + RSA_SRAM_DST_OFFSET), keysize, HAL_SRAM_PUB), //use sram offset based on current ce
                        block_t_convert(out, pri_key->n_len, HAL_EXT_MEM),
                        block_t_convert(pri_key->n, pri_key->n_len, addr_type),
                        block_t_convert(pri_key->d, pri_key->d_len, addr_type),
                        salt_len);
            }
        }
        else {
            ret = CRYPTO_INVALID_CE;
        }
    }

    return ret;
}

//*****************************************************************************
//
//! hal_rsa_verify.
//!
//! @param handle input, opration handle for uplayer,creat by ce hal
//! @param hash_nid input, hash type (not used )
//! @param msg input, msg for verify
//! @param msg_len input, msg len
//! @param sig input, sig msg for compare
//! @param sig_len input, sig msg len
//! @param pub_key input, pub key
//! @param padding input, padding type
//! @param salt_len input, salt length
//!
//! This function is for rsa Verification
//!
//! @return crypto_status_t CRYPTO_SUCCESS (value is 0) verify pass.
//
//*****************************************************************************
crypto_status_t hal_rsa_verify(void* handle, int hash_nid, const uint8_t* msg, size_t msg_len,
                           const uint8_t* sig, size_t sig_len, const rsa_pubkey_t* pub_key,
                           int padding, uint32_t salt_len)
{
    uint32_t vce_id;
    ce_addr_type_t addr_type = HAL_EXT_MEM;
    crypto_status_t ret = CRYPTO_SUCCESS;
    crypto_instance_t* l_cryptoinstance = NULL;

    if (handle == NULL) {
        ret = CRYPTO_ERROR;
    }
    else {
        l_cryptoinstance = (crypto_instance_t*)handle;

        /*do ce init and enable here*/

        vce_id = l_cryptoinstance->vce_id;

        if ((vce_id & RSA_SUPPORT_PKA_ID_MASK) == 0) {
            if (l_cryptoinstance->rsa_method->verify) {
                ret = l_cryptoinstance->rsa_method->verify(vce_id, hash_nid, padding,
                        block_t_convert(msg, msg_len, addr_type),
                        block_t_convert(pub_key->n, pub_key->n_len, addr_type),
                        block_t_convert(pub_key->e, pub_key->e_len, addr_type),
                        block_t_convert(sig, sig_len, addr_type),
                        salt_len);
            }
        }
        else {
            ret = CRYPTO_INVALID_CE;
        }
    }

    return ret;
}

//*****************************************************************************
//
//! hal_rsa_keygen.
//!
//! @param handle input, opration handle for uplayer,creat by ce hal
//! @param key_e input, pub key
//! @param key_e_len input
//! @param key_len input,support RSA_1024_LEN 128 RSA_2048_LEN 256 RSA_3072_LEN 384 RSA_4096_LEN 512
//! @param key_n output, pub key
//! @param key_d output, priv key
//!
//! This function is for rsa key generation
//!
//! @return crypto_status_t CRYPTO_SUCCESS (value is 0) verify pass.
//
//*****************************************************************************
crypto_status_t hal_rsa_keygen(void* handle, uint8_t* key_e, uint32_t key_e_len, int32_t key_len, uint8_t* key_n, uint8_t* key_d)
{
    uint32_t vce_id;
    buff_addr_type_t addr_type = HAL_EXT_MEM;
    crypto_status_t ret = CRYPTO_SUCCESS;
    crypto_instance_t* l_cryptoinstance = NULL;

    uint8_t* p;
    uint8_t* q;

    if (handle == NULL) {
        ret = CRYPTO_ERROR;
    }
    else {
        l_cryptoinstance = (crypto_instance_t*)handle;

        /*do ce init and enable here*/
        /*use test p q for test, should change to get_p&get_q*/
        switch (key_len) {
            case RSA_1024_LEN:
                p = (uint8_t*)&rsa_p_1024;
                q = (uint8_t*)&rsa_q_1024;
                break;

            case RSA_2048_LEN:
                p = (uint8_t*)&rsa_p_2048;
                q = (uint8_t*)&rsa_q_2048;
                break;

            case RSA_3072_LEN:
                p = (uint8_t*)&rsa_p_3072;
                q = (uint8_t*)&rsa_q_3072;
                break;

            case RSA_4096_LEN:
                p = (uint8_t*)&rsa_p_4096;
                q = (uint8_t*)&rsa_q_4096;
                break;

            default:
                p = (uint8_t*)&rsa_p_1024;
                q = (uint8_t*)&rsa_q_1024;
                break;
        }

        vce_id = l_cryptoinstance->vce_id;

        if ((vce_id & RSA_SUPPORT_PKA_ID_MASK) == 0) {
            if (l_cryptoinstance->rsa_method->sign) {
                ret = l_cryptoinstance->rsa_method->keygen(vce_id, block_t_convert(p, key_len, addr_type),
                        block_t_convert(q, key_len, addr_type),
                        block_t_convert(key_e, key_e_len, addr_type),
                        block_t_convert(key_n, key_len, HAL_EXT_MEM),
                        block_t_convert(key_d, key_len, HAL_EXT_MEM),
                        key_len,
                        0);
            }
        }
        else {
            ret = CRYPTO_INVALID_CE;
        }
    }

    return ret;
}

//*****************************************************************************
//
//! hal_rsa_keygen_ex.
//!
//! @param handle input, opration handle for uplayer,creat by ce hal
//! @param key_e input, pub key
//! @param key_len input,support RSA_1024_LEN 128 RSA_2048_LEN 256 RSA_3072_LEN 384 RSA_4096_LEN 512
//! @param key output, key combination, modulus+lambda+private key+exponent
//!
//! This function is for rsa key generation
//!
//! @return crypto_status_t CRYPTO_SUCCESS (value is 0) verify pass.
//
//*****************************************************************************
crypto_status_t hal_rsa_keygen_ex(void* handle, int32_t key_len, uint8_t* key_e, uint8_t* key)
{
    uint32_t vce_id;
    crypto_status_t ret = CRYPTO_SUCCESS;
    crypto_instance_t* l_cryptoinstance = NULL;

    if (handle == NULL) {
        ret = CRYPTO_ERROR;
    }
    else {
        l_cryptoinstance = (crypto_instance_t*)handle;

        vce_id = l_cryptoinstance->vce_id;

        if ((vce_id & RSA_SUPPORT_PKA_ID_MASK) == 0) {
            if (l_cryptoinstance->rsa_method->sign) {
                ret = l_cryptoinstance->rsa_method->keygen_ex(vce_id, key_len,
                        block_t_convert(key_e, key_len, HAL_EXT_MEM),
                        block_t_convert(key, key_len * 4, HAL_EXT_MEM),
                        true, true);
            }
        }
        else {
            ret = CRYPTO_INVALID_CE;
        }
    }

    return ret;
}