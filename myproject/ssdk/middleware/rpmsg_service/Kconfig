## myproject/ssdk/middleware/rpmsg_service/Kconfig
```kconfig
comment "RPMSG Service Options"

config RPMSG_RPROC_NUM
    int "RPMSG Max Proc Number"
    default 8

config RPMSG_WITH_LK
    bool "RPMSG communicate with LK"
    select WORKQUEUE
    default n

config USE_IPCC_RPC
    bool "enable rpmsg ipcc rp call(rpc)"
    default n

if ARCH_CHIP_D9 || ARCH_CHIP_G9 || ARCH_CHIP_X9
config OBSERVE_AP1
    bool "enbale observe AP1 domain reboot and recovery the communication"
    default n

config OBSERVE_AP2
    bool "enbale observe AP2 domain reboot and recovery the communication"
    default n
endif # ARCH_CHIP_D9 || ARCH_CHIP_G9 || ARCH_CHIP_X9
```

## myproject/ssdk/middleware/sd_property/Kconfig
```kconfig
comment "Property Options"

config SDRV_PROP_SERVER
    bool "SDRV PROP ENABLE SERVER"

config SDRV_PROP_CLIENT
    bool "SDRV PROP CLIENT SERVER"
    default n
```

## myproject/ssdk/middleware/sdpe_rpc/Kconfig
```kconfig
comment "SDPE RPC Options"

choice
    prompt "RPC Role"
    default SDPE_RPC_CLIENT

config SDPE_RPC_SERVER
    bool "SDPE RPC Server"

config SDPE_RPC_CLIENT
    bool "SDPE RPC Client"

endchoice

config SDPE_RPC_MEM_BASE
    hex "SDPE RPC Share Buffer Base"
    default 0x001f8000

config SDPE_RPC_MEM_OFFSET
    hex "SDPE RPC Share Buffer Offset"
    default 0x1000

config SDPE_RPC_MEM_SIZE
    hex "SDPE RPC Share Buffer Size"
    default 0x8000

config SDPE_RPC_MBUF
    bool "Support SDPE RPC mbuf"
    default n

config SDPE_RPC_MBOX_TRANSPORT
    bool "Support mbox transport"
    select MBOX
    default n

if SDPE_RPC_MBOX_TRANSPORT

config SDPE_RPC_MBOX_RX_BUF
    int "SDPE RPC rx mbox buffer"
    default 512

endif

config SDPE_RPC_RPMSG_TRANSPORT
    bool "Support rpmsg transport"
    select RPMSG
    default n
```

## myproject/ssdk/middleware/sdshell/Kconfig
```kconfig
comment "Virt-Console Options"

config VIRT_CONSOLE_AP1_BE
    bool "Support virt console ap1 as backend"
    depends on SDRV_VIRT_CONSOLE
    default y

config VIRT_CONSOLE_MP_BE
    bool "Support virt console mp as backend"
    depends on SDRV_VIRT_CONSOLE
    default n
```

## myproject/ssdk/middleware/str/Kconfig
```kconfig
config STR_STORE_SUPPORT
    bool

config LOWER_POWER_OS
    bool "Lower Power System Support"
    select STR_STORE_SUPPORT
    select DW_UMCTL2
    select SCR
    select SD_BOOT_PIN
    default n

config SAVE_DDR_INFO_IN_EMMC
    bool "Save DDR Info In EMMC Support"
    select STR_STORE_SUPPORT
    default n
```

## myproject/ssdk/middleware/tjpgdec/Kconfig
```kconfig
comment "TjpgDec Options"

config JD_SZBUF
    int "Specifies size of stream input buffer"
    default 512

config JD_FORMAT
    int "Specifies output pixel format"
    default 0
    ---help---
        Specifies output pixel format.
            0: RGB888 (24-bit/pix)
            1: RGB565 (16-bit/pix)
            2: Grayscale (8-bit/pix)

config JD_USE_SCALE
    int "Specifies the output scaling feature"
    default 0
    ---help---
        Switches output descaling feature.
            0: Disable
            1: Enable

config JD_TBLCLIP
    int "Specifies the clip method"
    default 1
    ---help---
        Use table conversion for saturation arithmetic. A bit faster, but increases 1 KB of code size.
            0: Disable
            1: Enable

config JD_FASTDECODE
    int "Specifies the optimization level"
    default 2
    ---help---
        Optimization level
            0: Basic optimization. Suitable for 8/16-bit MCUs.
            1: + 32-bit barrel shifter. Suitable for 32-bit MCUs.
            2: + Table conversion for huffman decoding (wants 6 << HUFF_BIT bytes of RAM)
```

## myproject/ssdk/middleware/update_monitor/Kconfig
```kconfig
comment "update monitor for remote processer update through rpmsg"

choice
    prompt "Update Monitor Mode"
    default UPDATE_MONITOR_NO_UPDATE

config NO_UPDATE
    bool "WDT Only"

config UPDATE_FLASH
    bool "Flash"
    select OSPI
    select CDNS_OSPI
    select DISK_NOR_FLASH
    select DISK_MAPPED

config UPDATE_EMMC
    bool "EMMC"
    select DISK_MMC
    select DISK_MAPPED
endchoice

config HANDOVER_OSPI1
    bool "support_handover_ospi1"
    depends on UPDATE_FLASH
    default n

config UM_BLOCK_IO_MODE
    bool "block io mode"
    depends on UPDATE_FLASH
    default y
```

## myproject/ssdk/middleware/usb/Kconfig
```kconfig
comment "USB Driver Options"

config USB_DEVICE
    bool "USB Device Driver Support"
    default n

if USB_DEVICE
rsource "uC-USBD/Kconfig"
endif # USB_DEVICE

config USB_HOST
    bool "USB Host Driver Support"
    default n

if USB_HOST
rsource "uC-USBH/Kconfig"
endif # USB_HOST

config USB_OTG
    bool "USB OTG Function Support"
    depends on USB_DEVICE && USB_HOST
    default n

config RNSS_USB
    bool
    default y
    help
      Renesas USB HS IP Driver Support.
```

## myproject/ssdk/middleware/usb/uC-USBD/Kconfig
```kconfig
comment "USB Device Class Driver Options"

config USB_DEVICE_HID
    bool "USB Device Class Driver for Human Interface Device"
    default n

config USB_DEVICE_MSC
    bool "USB Device Class Driver for Mass Storage Device"
    default n

config USB_DEVICE_FB
    bool "USB Device Class Driver for Fast Boot Device"
    default n

config USB_DEVICE_CDC_ACM
    bool "USB Device Class Driver for USB Serial Device"
    default n
```

## myproject/ssdk/middleware/usb/uC-USBH/Kconfig
```kconfig
comment "USB Host Class Driver Options"

config USB_HOST_HID
    bool "USB Host Class Driver for Human Interface Device"
    default n

config USB_HOST_MSC
    bool "USB Host Class Driver for Mass Storage Device"
    default n
```

## myproject/ssdk/middleware/virtio/Kconfig
```kconfig
config VIRTIO_FRONTEND
    bool "VirtIO Frontend Device Support"
    default n

config VIRTIO_BACKEND
    bool "VirtIO Backend Device Support"
    default n

config VIRTIO_MMC_FRONTEND
    bool "VirtIO MMC Frontend Device Support"
    default n
```

## myproject/ssdk/rtos/BareMetal/Kconfig
```kconfig
comment "BareMetal Options"

config OS_POLL
    bool "OS polling"
    default y

config BAREMETAL_WORK_IN_IRQ
    bool "Enable BareMetal work in irq mode"
    default n
```

## myproject/ssdk/rtos/FreeRTOS/Kconfig
```kconfig
comment "FreeRTOS Options"

config API_CALL_INTERRUPT_PRIORITY
    int "FreeRTOS API call interrupt priority"
    default 18

config IDLE_TASK_STACK_SIZE
    int "FreeRTOS idle task stack size"
    default 128

choice
    prompt "Select FreeRTOS idle task function"
    default USE_IDLE_HOOK

    config USE_TICKLESS_IDLE
        bool "Use tickless idle"

    config USE_IDLE_HOOK
        bool "Use idle hook"
endchoice

if USE_TICKLESS_IDLE
    config EXPECTED_IDLE_TIME_BEFORE_SLEEP
        int "Expected idle time before sleep(Tick)"
        default 2
endif
```

## myproject/ssdk/rtos/Kconfig
```kconfig
comment "RTOS Options"

choice
    prompt "RTOS type"
    default OS_FREERTOS

config OS_FREERTOS
    bool "Use FreeRTOS"

config OS_BAREMETAL
    bool "Use BareMetal"
    select STD_HEAP

endchoice

config OS_TICK
    int "OS tick (ms)"
    default 1

config OS_DEFAULT_STACK_SIZE
    int "OS default statck size"
    default 1024

config OS_MIN_STACK_SIZE
    int "OS minimal statck size"
    default 512

config OS_MIN_THREAD_PRIO
    int "OS minimal thread priorities"
    default 1

config OS_MAX_THREAD_PRIO
    int "OS max thread priorities"
    default 32

if OS_FREERTOS
rsource "FreeRTOS/Kconfig"
endif # OS_FREERTOS

if OS_BAREMETAL
rsource "BareMetal/Kconfig"
endif # OS_BAREMETAL
```

## myproject/ssdk/tools/SSDKDS/data/board/d3/Kconfig
```kconfig
comment "Taishan Board Options"

config MEM_BASE
    hex "Memory Start Address"
    default 0x410000

config MEM_SIZE
    hex "Memory Size"
    default 0x80000

config CLOCK_OVER_DRIVE_MODE
    bool "Clock run in over driver mode"
    default n

rsource "../../Kconfig"
```

## myproject/ssdk/tools/SSDKDS/data/board/d3/defconfig
```kconfig
CONFIG_ARCH_EARLY_ENABLE_ICACHE=y
CONFIG_ARCH_EARLY_ENABLE_DCACHE=y
CONFIG_ARCH_USE_FPU=y
CONFIG_ARCH_USE_MPU=y
CONFIG_ARM_WITH_PMU=y
CONFIG_ARMV7R_TCMA_BASE=0x1910000
CONFIG_ARMV7R_TCMB_BASE=0x1900000
CONFIG_MAIN_THREAD_PRIORITY=2
CONFIG_CLK=y
CONFIG_TAISHAN_CKGEN=y
CONFIG_CLK_MONITOR=y
CONFIG_IRQ=y
CONFIG_SDRV_VIC=y
CONFIG_PINCTRL=y
CONFIG_TAISHAN_PINCTRL=y
CONFIG_RESETGEN=y
CONFIG_TAISHAN_RESETGEN=y
CONFIG_SDRV_UART=y
CONFIG_MEM_RW=y
```

## myproject/ssdk/tools/SSDKDS/data/board/d9/Kconfig
```kconfig
comment "D9 Board Options"

config MEM_BASE
    hex "Memory Start Address"
    default 0x37200000

config MEM_SIZE
    hex "Memory Size"
    default 0x10000000

config BOARD_REMAP
    bool "Enable Kunlun board remap"
    select SCR
    select RESETGEN
    select KUNLUN_RESETGEN
    default n

rsource "../../Kconfig"
```
