## myproject/ssdk/boards/x9hp_ms/Kconfig
```kconfig
config BOARD_X9HP_MS
    bool
    depends on ARCH_CHIP_X9
    default y

rsource "$(CORE)/Kconfig"
```

## myproject/ssdk/boards/x9hp_ms/safety/Kconfig
```kconfig
comment "X9 Safety Core Options"

config MEM_BASE
    hex "Memory Start Address"
    default 0x37200000

config MEM_SIZE
    hex "Memory Size"
    default 0x10000000

config RES_SIZE
    hex "Res Size"
    default 0x0

config BOARD_REMAP
    bool "Enable Kunlun board remap"
    select SCR
    select RESETGEN
    select KUNLUN_RESETGEN
    default n

config KUNLUN_BOOT_MP
    bool "Boot MP Core"
    default n

config EARLYCOPY
    bool "Early Copy sections from LMA to VMA"
    default y
```

## myproject/ssdk/boards/x9hp_ms/safety/projects/ms-mmc/defconfig
```kconfig
CONFIG_ARCH_EARLY_ENABLE_ICACHE=y
CONFIG_ARCH_EARLY_ENABLE_DCACHE=y
CONFIG_ARCH_USE_FPU=y
CONFIG_ARCH_USE_MPU=y
CONFIG_ARCH_FIQ_STACK_SIZE=256
CONFIG_ARCH_SVC_STACK_SIZE=2048
CONFIG_ARM_WITH_PMU=y
CONFIG_ARMV7R_TCMA_BASE=0x0
CONFIG_ARMV7R_TCMB_BASE=0x10000
CONFIG_ARCH_CHIP_X9=y
CONFIG_MAIN_THREAD_PRIORITY=2
CONFIG_MEM_BASE=0x37800000
CONFIG_MEM_SIZE=0x8000000
CONFIG_RES_SIZE=0x1800000
CONFIG_BOARD_REMAP=y
CONFIG_KUNLUN_CKGEN=y
CONFIG_DW_DMA=y
CONFIG_KUNLUN_FUSE=y
CONFIG_ARM_GIC=y
CONFIG_DW_I2C=y
CONFIG_KUNLUN_MBOX=y
CONFIG_KUNLUN_PINCTRL=y
CONFIG_SDRV_KUNLUN_PMU=y
CONFIG_KUNLUN_PWM=y
CONFIG_DW_RTC=y
CONFIG_KUNLUN_SEM=y
CONFIG_SDRV_SYSCNT=y
CONFIG_SDRV_TMR=y
CONFIG_DW_UART=y
CONFIG_SDRV_WDOG_KUNLUN=y
CONFIG_MEMMAP=y
CONFIG_RES_LOADER=y
CONFIG_DISK_NAME="memdisk0"
CONFIG_ELF_LOADER=y
CONFIG_ELF_LOADER_ADDR_CONVERT=y
CONFIG_CLI=y
CONFIG_RPMSG_WITH_LK=y
CONFIG_USE_IPCC_RPC=y
CONFIG_OBSERVE_AP1=y
CONFIG_OBSERVE_AP2=y
CONFIG_KUNLUN_REBOOT=y
CONFIG_APP_REBOOT_SS=y
CONFIG_CAN_PROXY=y
CONFIG_SUPPORT_CAN_SDDRV=y
CONFIG_PROPERTY=y
CONFIG_ERRCODE=y
CONFIG_SDRV_VIRT_CONSOLE=y
CONFIG_SUPPORT_CRASHDUMP_FEATURE=y
CONFIG_DRIVERS_EXAMPLE=y
CONFIG_RPMSG_DEMO=y
CONFIG_PMU_DEMO=y
CONFIG_RTC_DEMO=y
CONFIG_FUSE_DEMO=y
```

## myproject/ssdk/boards/x9hp_ms_a12_vemmc/safety/projects/ms-vmmc/defconfig
```kconfig
CONFIG_ARCH_EARLY_ENABLE_ICACHE=y
CONFIG_ARCH_EARLY_ENABLE_DCACHE=y
CONFIG_ARCH_USE_FPU=y
CONFIG_ARCH_USE_MPU=y
CONFIG_ARCH_FIQ_STACK_SIZE=256
CONFIG_ARCH_SVC_STACK_SIZE=2048
CONFIG_ARM_WITH_PMU=y
CONFIG_ARCH_CHIP_X9=y
CONFIG_MAIN_THREAD_PRIORITY=2
CONFIG_MEM_BASE=0x49E00000
CONFIG_MEM_SIZE=0x5E00000
CONFIG_BOARD_REMAP=y
CONFIG_KUNLUN_BOOT_MP=y
CONFIG_KUNLUN_CKGEN=y
CONFIG_DW_DMA=y
CONFIG_ARM_GIC=y
CONFIG_DW_I2C=y
CONFIG_KUNLUN_MBOX=y
CONFIG_KUNLUN_PINCTRL=y
CONFIG_SDRV_KUNLUN_PMU=y
CONFIG_SDRV_KUNLUN_PVT=y
CONFIG_DW_RTC=y
CONFIG_KUNLUN_SEM=y
CONFIG_SDRV_SYSCNT=y
CONFIG_SDRV_TMR=y
CONFIG_DW_UART=y
CONFIG_SDRV_WDOG_KUNLUN=y
CONFIG_KUNLUN_MMC=y
CONFIG_MEMMAP=y
CONFIG_SLIMFS=y
CONFIG_VERIFIED_BOOT=y
CONFIG_DISK_NAME="mmc0"
CONFIG_ELF_LOADER=y
CONFIG_ELF_LOADER_ADDR_CONVERT=y
CONFIG_CLI=y
CONFIG_RPMSG_WITH_LK=y
CONFIG_USE_IPCC_RPC=y
CONFIG_OBSERVE_AP1=y
CONFIG_OBSERVE_AP2=y
CONFIG_KUNLUN_REBOOT=y
CONFIG_UPDATE_MONITOR=y
CONFIG_APP_REBOOT_SS=y
CONFIG_NOTIFY_SEC_REBOOT=y
CONFIG_CAN_PROXY=y
CONFIG_SUPPORT_CAN_SDDRV=y
CONFIG_PROPERTY=y
CONFIG_SDRV_PROP_CLIENT=y
CONFIG_ERRCODE=y
CONFIG_SDRV_VIRT_CONSOLE=y
CONFIG_SDRV_THERMAL_SERVICE=y
CONFIG_SUPPORT_CRASHDUMP_FEATURE=y
CONFIG_VIRTIO=y
CONFIG_VIRTIO_FRONTEND=y
CONFIG_VIRTIO_MMC_FRONTEND=y
CONFIG_TIME_SYNC=y
CONFIG_SDRV_SHM=y
CONFIG_FuncSafetyPkg=y
CONFIG_DRIVERS_EXAMPLE=y
CONFIG_RPMSG_DEMO=y
CONFIG_PMU_DEMO=y
CONFIG_RTC_DEMO=y
CONFIG_APPLICATION=y
CONFIG_PVT_APPLICATION=y
CONFIG_PVT_APPLICATION_PRINT=y
# CONFIG_APP_AUDIO is not set
CONFIG_PFM_ON=y
CONFIG_KERNEL_MONITOR=y
CONFIG_SILEX_CRYPTO_TESTER=y
CONFIG_FUSE_DEMO=y
CONFIG_PIN_TESTER=y
CONFIG_MMC_TESTER=y
```

## myproject/ssdk/boards/x9hp_ms_v9p_ea/Kconfig
```kconfig
config BOARD_X9HP_MS_V9P_EA
    bool
    depends on ARCH_CHIP_X9
    default y

rsource "$(CORE)/Kconfig"
```

## myproject/ssdk/boards/x9hp_ms_v9p_ea/mp/projects/ms-vmmc/defconfig
```kconfig
CONFIG_ARCH_EARLY_ENABLE_ICACHE=y
CONFIG_ARCH_EARLY_ENABLE_DCACHE=y
CONFIG_ARCH_USE_FPU=y
CONFIG_ARCH_USE_MPU=y
CONFIG_ARCH_FIQ_STACK_SIZE=256
CONFIG_ARCH_SVC_STACK_SIZE=2048
CONFIG_ARM_WITH_PMU=y
CONFIG_ARCH_CHIP_X9=y
CONFIG_MAIN_THREAD_PRIORITY=2
CONFIG_MP=y
CONFIG_MEM_BASE=0x38400000
CONFIG_MEM_SIZE=0xF800000
CONFIG_BOARD_REMAP=y
CONFIG_AUDIO_BOARD=y
CONFIG_KUNLUN_CKGEN=y
CONFIG_SILEX_CRYPTO=y
CONFIG_DESER=y
CONFIG_mipi_max9286_fengjing_MC163_720P_MAX96705=y
CONFIG_dvp_max96706_fengjing_MC163_MAX96705=y
CONFIG_LVDS_HSD123_SERDES_1920x720_LCD=y
CONFIG_MIPI_HSD123_SERDES_1920x720_LCD=y
CONFIG_MIPI_HSD123_SERDES_1920x720_2_LCD=y
CONFIG_LVDS_KD070_SERDES_1024x600_LCD=y
CONFIG_DS90UB9XX=y
CONFIG_DW_DMA=y
CONFIG_KUNLUN_FUSE=y
CONFIG_ARM_GIC=y
CONFIG_TCA9539=y
CONFIG_TCA6408=y
CONFIG_DW_I2C=y
CONFIG_KUNLUN_MBOX=y
CONFIG_KUNLUN_PINCTRL=y
CONFIG_SDRV_KUNLUN_PMU=y
CONFIG_SDRV_KUNLUN_PVT=y
CONFIG_KUNLUN_PWM=y
CONFIG_DW_RTC=y
CONFIG_KUNLUN_SEM=y
CONFIG_SERDES_KUNLUN_PLATFORM=y
CONFIG_SERDES_TI9XX=y
CONFIG_KUNLUN_SND=y
CONFIG_CDNS_I2S_SC=y
CONFIG_SDRV_SYSCNT=y
CONFIG_SDRV_TMR=y
CONFIG_TOUCH_KUNLUN_GOODIX=y
CONFIG_TOUCH_LINK_WITH_SERDES=y
CONFIG_DW_UART=y
CONFIG_KUNLUN_MMC=y
CONFIG_MEMMAP=y
CONFIG_SLIMFS=y
CONFIG_DISK_NAME="mmc0"
CONFIG_RES_LOADER=y
CONFIG_ELF_LOADER=y
CONFIG_ELF_LOADER_ADDR_CONVERT=y
CONFIG_CLI=y
CONFIG_IPCC_BUFF_NUM=16
CONFIG_RPMSG_WITH_LK=y
CONFIG_USE_IPCC_RPC=y
CONFIG_OBSERVE_AP1=y
CONFIG_OBSERVE_AP2=y
CONFIG_AUDIO_MANAGER=y
CONFIG_AUDIO_HUB=y
CONFIG_REBOOT=y
CONFIG_KUNLUN_REBOOT=y
CONFIG_GUI_LVGL=y
CONFIG_LVGL_SDRV_DISPLAY=y
CONFIG_LVGL_SDRV_DECODER_PNG=y
CONFIG_LVGL_SDRV_DECODER_JPG=y
CONFIG_LVGL_SDRV_INPUT=y
CONFIG_BACKLIGHT_SERVICE=y
CONFIG_KUNLUN_CAMERA_SERVICE=y
CONFIG_CAN_PROXY=y
CONFIG_VCAN_CLIENT=y
CONFIG_CLUSTER_BRIDGE=y
CONFIG_DISP_CLIENT=y
CONFIG_DISPLAY_SERVICE=y
CONFIG_INPUT_SERVICE_DUMMY_DATA=y
CONFIG_NFS_CLIENT=y
CONFIG_PROPERTY=y
CONFIG_SDRV_PROP_SERVER=y
CONFIG_ERRCODE=y
CONFIG_SDRV_VIRT_CONSOLE=y
CONFIG_SDRV_THERMAL_SERVICE=y
CONFIG_GRAPHICS=y
CONFIG_VIRTIO=y
CONFIG_VIRTIO_FRONTEND=y
CONFIG_VIRTIO_BACKEND=y
CONFIG_VIRTIO_MMC_FRONTEND=y
CONFIG_TIME_SYNC=y
CONFIG_DRIVERS_EXAMPLE=y
CONFIG_MBOX_DEMO=y
CONFIG_RPMSG_DEMO=y
CONFIG_PMU_DEMO=y
CONFIG_RTC_DEMO=y
CONFIG_APPLICATION=y
CONFIG_AUDIO_HUB_SVC=y
CONFIG_PVT_APPLICATION=y
CONFIG_PVT_APPLICATION_PRINT=y
CONFIG_PVT_APPLICATION_MONITOR=y
CONFIG_CAM_PRE=y
CONFIG_CAM_DEBUG=y
CONFIG_AUDIO_MANAGER_TEST=y
CONFIG_PFM_ON=y
CONFIG_BACKLIGHT_DEMO=y
CONFIG_SILEX_CRYPTO_TESTER=y
CONFIG_DISP_TESTER=y
CONFIG_FUSE_DEMO=y
CONFIG_INPUT_DEMO=y
CONFIG_PVT_DEMO=y
CONFIG_SERDES_DEMO=y
CONFIG_TOUCH_DEMO=y
CONFIG_MMC_TESTER=y
```

## myproject/ssdk/boards/x9hp_ms_v9p_ea/safety/Kconfig
```kconfig
comment "X9 Safety Core Options"

config MEM_BASE
    hex "Memory Start Address"
    default 0x37200000

config MEM_SIZE
    hex "Memory Size"
    default 0x10000000

config RES_SIZE
    hex "Res Size"
    default 0x0

config BOARD_REMAP
    bool "Enable Kunlun board remap"
    select SCR
    select RESETGEN
    select KUNLUN_RESETGEN
    default n

config KUNLUN_BOOT_MP
    bool "Boot MP Core"
    default n

config SUPPORT_STR_MODE
    bool "support str mode"
    default n

config STR_CORE_COMMU
    bool "str communication between saf and sec"
    default n

config ULINK_SINGLE_SIDE_SAF
    bool "ULINK for single side safety R5 core"
    default n
```

## myproject/ssdk/boards/x9hp_ms_v9p_ea/safety/projects/ms/defconfig
```kconfig
CONFIG_ARCH_EARLY_ENABLE_ICACHE=y
CONFIG_ARCH_EARLY_ENABLE_DCACHE=y
CONFIG_ARCH_USE_FPU=y
CONFIG_ARCH_USE_MPU=y
CONFIG_ARCH_FIQ_STACK_SIZE=256
CONFIG_ARCH_SVC_STACK_SIZE=2048
CONFIG_ARM_WITH_PMU=y
CONFIG_ARCH_CHIP_X9=y
CONFIG_MAIN_THREAD_PRIORITY=2
CONFIG_MEM_BASE=0x47C00000
CONFIG_MEM_SIZE=0x8000000
CONFIG_RES_SIZE=0x1800000
CONFIG_BOARD_REMAP=y
CONFIG_ULINK_SINGLE_SIDE_SAF=y
CONFIG_AUDIO_BOARD=y
CONFIG_KUNLUN_CKGEN=y
CONFIG_SILEX_CRYPTO=y
CONFIG_DW_DMA=y
CONFIG_KUNLUN_FUSE=y
CONFIG_ARM_GIC=y
CONFIG_DW_I2C=y
CONFIG_KUNLUN_MBOX=y
CONFIG_KUNLUN_PINCTRL=y
CONFIG_SDRV_KUNLUN_PMU=y
CONFIG_SDRV_KUNLUN_PVT=y
CONFIG_KUNLUN_PWM=y
CONFIG_DW_RTC=y
CONFIG_KUNLUN_SEM=y
CONFIG_SERDES_KUNLUN_PLATFORM=y
CONFIG_SERDES_TI9XX=y
CONFIG_KUNLUN_SND=y
CONFIG_CDNS_I2S_SC=y
CONFIG_SDRV_SYSCNT=y
CONFIG_SDRV_TMR=y
CONFIG_SUPPORT_LOG_TIMESTAMP=y
CONFIG_DW_UART=y
CONFIG_UNILINK=y
CONFIG_SDRV_WDOG_KUNLUN=y
CONFIG_MEMMAP=y
CONFIG_DISK_NOR_FLASH=y
CONFIG_RES_LOADER=y
CONFIG_ELF_LOADER=y
CONFIG_ELF_LOADER_ADDR_CONVERT=y
CONFIG_CLI=y
CONFIG_RPMSG_WITH_LK=y
CONFIG_USE_IPCC_RPC=y
CONFIG_OBSERVE_AP1=y
CONFIG_OBSERVE_AP2=y
CONFIG_AUDIO_MANAGER=y
CONFIG_KUNLUN_REBOOT=y
CONFIG_UPDATE_MONITOR=y
CONFIG_APP_REBOOT_SS=y
CONFIG_CAN_PROXY=y
CONFIG_SUPPORT_CAN_SDDRV=y
CONFIG_CLUSTER_BRIDGE=y
CONFIG_LWIP=y
CONFIG_NFS_CLIENT=y
CONFIG_PROPERTY=y
CONFIG_ERRCODE=y
CONFIG_SDRV_VIRT_CONSOLE=y
CONFIG_SDRV_THERMAL_SERVICE=y
CONFIG_SUPPORT_CRASHDUMP_FEATURE=y
CONFIG_GRAPHICS=y
CONFIG_TIME_SYNC=y
CONFIG_DRIVERS_EXAMPLE=y
CONFIG_RPMSG_DEMO=y
CONFIG_PMU_DEMO=y
CONFIG_RTC_DEMO=y
CONFIG_APPLICATION=y
# CONFIG_APP_AUDIO is not set
CONFIG_SILEX_CRYPTO_TESTER=y
CONFIG_FUSE_DEMO=y
CONFIG_SERDES_DEMO=y
```

## myproject/ssdk/boards/x9hp_ms_x9sp_ea/Kconfig
```kconfig
config BOARD_X9HP_SP
    bool
    depends on ARCH_CHIP_X9
    default y

rsource "$(CORE)/Kconfig"
```

## myproject/ssdk/boards/x9hp_ms_x9sp_ea/safety/projects/ms/defconfig
```kconfig
CONFIG_ARCH_EARLY_ENABLE_ICACHE=y
CONFIG_ARCH_EARLY_ENABLE_DCACHE=y
CONFIG_ARCH_USE_FPU=y
CONFIG_ARCH_USE_MPU=y
CONFIG_ARCH_FIQ_STACK_SIZE=256
CONFIG_ARCH_SVC_STACK_SIZE=2048
CONFIG_ARM_WITH_PMU=y
CONFIG_ARCH_CHIP_X9=y
CONFIG_MAIN_THREAD_PRIORITY=2
CONFIG_MEM_BASE=0x47800000
CONFIG_MEM_SIZE=0x8000000
CONFIG_RES_SIZE=0x1800000
CONFIG_BOARD_REMAP=y
CONFIG_AUDIO_BOARD=y
CONFIG_KUNLUN_CKGEN=y
CONFIG_SILEX_CRYPTO=y
CONFIG_DW_DMA=y
CONFIG_KUNLUN_FUSE=y
CONFIG_ARM_GIC=y
CONFIG_DW_I2C=y
CONFIG_KUNLUN_MBOX=y
CONFIG_KUNLUN_PINCTRL=y
CONFIG_SDRV_KUNLUN_PMU=y
CONFIG_SDRV_KUNLUN_PVT=y
CONFIG_KUNLUN_PWM=y
CONFIG_DW_RTC=y
CONFIG_KUNLUN_SEM=y
CONFIG_SERDES_KUNLUN_PLATFORM=y
CONFIG_SERDES_TI9XX=y
CONFIG_KUNLUN_SND=y
CONFIG_CDNS_I2S_SC=y
CONFIG_SDRV_SYSCNT=y
CONFIG_SDRV_TMR=y
CONFIG_TOUCH_KUNLUN_PLATFORM=y
CONFIG_TOUCH_KUNLUN_GOODIX=y
CONFIG_TOUCH_LINK_WITH_SERDES=y
CONFIG_DW_UART=y
CONFIG_SDRV_KUNLUN_VPU=y
CONFIG_SDRV_WDOG_KUNLUN=y
CONFIG_MEMMAP=y
CONFIG_DISK_NOR_FLASH=y
CONFIG_RES_LOADER=y
CONFIG_ELF_LOADER=y
CONFIG_ELF_LOADER_ADDR_CONVERT=y
CONFIG_CLI=y
CONFIG_RPMSG_WITH_LK=y
CONFIG_USE_IPCC_RPC=y
CONFIG_OBSERVE_AP1=y
CONFIG_OBSERVE_AP2=y
CONFIG_AUDIO_MANAGER=y
CONFIG_KUNLUN_REBOOT=y
CONFIG_UPDATE_MONITOR=y
CONFIG_TJPGDEC=y
CONFIG_DECODER_LODEPNG=y
CONFIG_APP_REBOOT_SS=y
CONFIG_CAN_PROXY=y
CONFIG_SUPPORT_CAN_SDDRV=y
CONFIG_CLUSTER_BRIDGE=y
CONFIG_INPUT_SERVICE_DUMMY_DATA=y
CONFIG_NFS_CLIENT=y
CONFIG_PROPERTY=y
CONFIG_ERRCODE=y
CONFIG_SDRV_VIRT_CONSOLE=y
CONFIG_SDRV_THERMAL_SERVICE=y
CONFIG_SUPPORT_CRASHDUMP_FEATURE=y
CONFIG_GRAPHICS=y
CONFIG_DRIVERS_EXAMPLE=y
CONFIG_RPMSG_DEMO=y
CONFIG_PMU_DEMO=y
CONFIG_DISK_DEMO=y
CONFIG_DISK_NOR_FLASH_DEMO=y
CONFIG_RTC_DEMO=y
CONFIG_APPLICATION=y
CONFIG_PVT_APPLICATION=y
CONFIG_PVT_APPLICATION_PRINT=y
CONFIG_PVT_IN_SAFETY_DOMAIN=y
CONFIG_PVT_APPLICATION_MONITOR=y
CONFIG_AUDIO_MANAGER_TEST=y
CONFIG_PFM_ON=y
CONFIG_POWER_OFF=y
CONFIG_KERNEL_MONITOR=y
CONFIG_SEM_MONITOR=y
CONFIG_SILEX_CRYPTO_TESTER=y
CONFIG_FUSE_DEMO=y
CONFIG_INPUT_DEMO=y
CONFIG_PVT_DEMO=y
CONFIG_SERDES_DEMO=y
CONFIG_TOUCH_DEMO=y
CONFIG_PIN_TESTER=y
```

## myproject/ssdk/boards/x9sp_evb/safety/Kconfig
```kconfig
comment "X9 Safety Core Options"

config MEM_BASE
    hex "Memory Start Address"
    default 0x7E600000

config MEM_SIZE
    hex "Memory Size"
    default 0x800000

config RES_SIZE
    hex "Res Size"
    default 0x0

config BOARD_REMAP
    bool "Enable Kunlun board remap"
    select SCR
    select RESETGEN
    select KUNLUN_RESETGEN
    default n

config KUNLUN_BOOT_MP
    bool "Boot MP Core"
    default n

config SUPPORT_STR_MODE
    bool "support str mode"
    default n

config STR_CORE_COMMU
    bool "str communication between saf and sec"
    default n

config EARLYCOPY
    bool "Early Copy sections from LMA to VMA"
    default y

config HANDOVER_CFG
    bool "handover some IPs in safety to AP domain"
    select SCR
    default n

config SOC_CLK_INIT
    bool "initialize soc clock"
    default y

config SOC_RST_INIT
    bool "initialize soc rstgen"
    default y

config SAFETY_HPI_QOS
    bool "safety hpi qos settings"
    default y
```

## myproject/ssdk/boards/x9sp_evb/safety/projects/lowerpoweros/defconfig
```kconfig
CONFIG_ARCH_EARLY_ENABLE_ICACHE=y
CONFIG_ARCH_EARLY_ENABLE_DCACHE=y
CONFIG_ARCH_USE_FPU=y
CONFIG_ARCH_USE_MPU=y
CONFIG_ARCH_FIQ_STACK_SIZE=256
CONFIG_ARCH_SVC_STACK_SIZE=2048
CONFIG_ARM_WITH_PMU=y
CONFIG_ARCH_CHIP_X9=y
CONFIG_ARCH_CHIP_X9_THANG=y
CONFIG_MAIN_THREAD_PRIORITY=2
CONFIG_MEM_BASE=0x100000
CONFIG_MEM_SIZE=0x40000
CONFIG_BOARD_REMAP=y
CONFIG_KUNLUN_CKGEN=y
CONFIG_ARM_GIC=y
CONFIG_KUNLUN_MBOX=y
CONFIG_DW_RTC=y
CONFIG_KUNLUN_SEM=y
CONFIG_SDRV_SYSCNT=y
CONFIG_SDRV_TMR=y
CONFIG_DW_UART=y
CONFIG_SDRV_WDOG_KUNLUN=y
CONFIG_MEMMAP=y
# CONFIG_DEBUG_COMMANDS is not set
CONFIG_PARTITION=y
CONFIG_ELF_LOADER=y
CONFIG_ELF_LOADER_ADDR_CONVERT=y
CONFIG_RPMSG_SERVICE=y
CONFIG_RPMSG_WITH_LK=y
CONFIG_USE_IPCC_RPC=y
CONFIG_OBSERVE_AP1=y
CONFIG_OBSERVE_AP2=y
CONFIG_LOWER_POWER_OS=y
```

## myproject/ssdk/boards/x9sp_ms_demo/mp/Kconfig
```kconfig
comment "X9 MP Core Options"

config MEM_BASE
    hex "Memory Start Address"
    default 0x38000000

config MEM_SIZE
    hex "Memory Size"
    default 0x10000000

config RES_SIZE
    hex "Res Size"
    default 0x1800000

config BOARD_REMAP
    bool "Enable Kunlun board remap"
    select SCR
    select RESETGEN
    select KUNLUN_RESETGEN
    default n

config EARLYCOPY
    bool "Early Copy sections from LMA to VMA"
    default y
```

## myproject/ssdk/boards/x9sp_ms_demo/safety/projects/ms-mmc/defconfig
```kconfig
CONFIG_ARCH_EARLY_ENABLE_ICACHE=y
CONFIG_ARCH_EARLY_ENABLE_DCACHE=y
CONFIG_ARCH_USE_FPU=y
CONFIG_ARCH_USE_MPU=y
CONFIG_ARCH_FIQ_STACK_SIZE=256
CONFIG_ARCH_SVC_STACK_SIZE=2048
CONFIG_ARM_WITH_PMU=y
CONFIG_PHYS_RELOCATION=y
CONFIG_ARMV7R_TCMA_BASE=0x0
CONFIG_ARMV7R_TCMB_BASE=0x10000
CONFIG_ARCH_CHIP_X9=y
CONFIG_MAIN_THREAD_PRIORITY=2
CONFIG_MEM_BASE=0x600000
CONFIG_MEM_SIZE=0x100000
CONFIG_BOARD_REMAP=y
CONFIG_KUNLUN_BOOT_MP=y
CONFIG_SUPPORT_STR_MODE=y
CONFIG_HANDOVER_CFG=y
# CONFIG_SOC_CLK_INIT is not set
# CONFIG_SOC_RST_INIT is not set
CONFIG_KUNLUN_CKGEN=y
CONFIG_DW_DMA=y
CONFIG_KUNLUN_FUSE=y
CONFIG_ARM_GIC=y
CONFIG_DW_I2C=y
CONFIG_KUNLUN_MBOX=y
CONFIG_KUNLUN_PINCTRL=y
CONFIG_SDRV_KUNLUN_PMU=y
CONFIG_DW_RTC=y
CONFIG_KUNLUN_SEM=y
CONFIG_SDRV_SYSCNT=y
CONFIG_SDRV_TMR=y
CONFIG_DW_UART=y
CONFIG_SDRV_WDOG_KUNLUN=y
CONFIG_PMIC=y
CONFIG_PMIC_LP875XX=y
CONFIG_MEMMAP=y
CONFIG_RES_LOADER=y
CONFIG_DISK_NAME="memdisk0"
CONFIG_ELF_LOADER=y
CONFIG_ELF_LOADER_ADDR_CONVERT=y
CONFIG_CLI=y
CONFIG_RPMSG_WITH_LK=y
CONFIG_USE_IPCC_RPC=y
CONFIG_OBSERVE_AP1=y
CONFIG_OBSERVE_AP2=y
CONFIG_CAN_PROXY=y
CONFIG_SUPPORT_CAN_SDDRV=y
CONFIG_PROPERTY=y
CONFIG_SDRV_PROP_CLIENT=y
CONFIG_ERRCODE=y
CONFIG_SUPPORT_CRASHDUMP_FEATURE=y
CONFIG_TIME_SYNC=y
CONFIG_DRIVERS_EXAMPLE=y
CONFIG_RPMSG_DEMO=y
CONFIG_PMU_DEMO=y
CONFIG_RTC_DEMO=y
CONFIG_APPLICATION=y
# CONFIG_APP_AUDIO is not set
CONFIG_PFM_ON=y
CONFIG_POWER_OFF=y
CONFIG_KERNEL_MONITOR=y
CONFIG_SEM_MONITOR=y
CONFIG_FUSE_DEMO=y
CONFIG_PIN_TESTER=y
# CONFIG_PINMUX_AP is not set
```

## myproject/ssdk/boards/x9u-ref_a/Kconfig
```kconfig
config BOARD_X9HP_MS
    bool
    depends on ARCH_CHIP_X9
    default y

config ULINK_SIDE_A
    bool "ULINK FOR X9U SSA"
    default y

rsource "$(CORE)/Kconfig"
```
