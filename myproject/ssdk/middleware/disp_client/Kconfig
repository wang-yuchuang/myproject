## myproject/ssdk/middleware/dloader/Kconfig
```kconfig
comment "dloader for update"

config DLOADER
    bool "dloader"
    default y

config DLODER_USE_RAM_AS_DISK
    bool "Select Ram as disk"
    default n

config SDCARD_SLOT_NUMBER
    int "Select sdcard in slot 0 or 1"
    default 1

config DL_DATA_BUF_SIZE
    hex "Download data buffer size"
    default 0x100000

config DL_SCRATCH_SIZE
    hex "Download data scratch buffer size"
    default 0x20000

config DLOADER_BLOCK_IO_MODE
    bool "Block read write Mode"
    default n

config DLOADER_DISK_BLOCK_SIZE
    hex "Dloader disk block size"
    default 0x200

config DLOADER_PROG_HYPER_FLASH_FUSE
    bool "Prog Hyper Flash Fuse"
    default n
    depends on HYPERBUS_MODE
    depends on TAISHAN_XSPI

choice
    prompt "Dloader Communication Mode"
    default DLOADER_WITH_USB

config DLOADER_WITH_USB
    bool "Select USB fastboot for dloader"
    select USB
    select USB_DEVICE
    select USB_DEVICE_FB

config DLOADER_WITH_TRACE
    bool "Select Trace for dloader"
    select BOARD_REMAP
    select BOARD_DEBUG
    select ARCH_DISABLE_ICACHE
    select ARCH_DISABLE_DCACHE
endchoice

config TRACE_PROG_STATUS_BASE
    hex "Dloader Trace Program Status Memory Base"
    depends on DLOADER_WITH_TRACE
    default 0x1900000

config TRACE_CMD_BASE
    hex "Dloader Trace Command Memory Base"
    depends on DLOADER_WITH_TRACE
    default 0x1901000
```

## myproject/ssdk/middleware/flashloader/Kconfig
```kconfig
comment "Flash Loader Options"

config CHECK_FLASH_LOAD
    bool "Check Flash-loading Result"
    default n
    help
        Enable this to apply a data check after each flash writing.

if CHECK_FLASH_LOAD

config FLASHLOADER_BUFFER_SIZE
    hex "Flash Loader Buffer Size"
    default 0x4000
    help
        The size of RAM buffer used during the flash-loading process.
        Must be the multiple of the flash block size.

endif # CHECK_FLASH_LOAD

config AVB_FOOTER
    bool "Enable AVB Footer"
    default n

if AVB_FOOTER

config IMG_PARTITION_SIZE
    hex "Image Partition Size"
    default 0x200000
    help
        The size of the flash partition which the image is loaded to
        (e.g., the size of 'ospi1_safety_os_a' partition).

endif # AVB_FOOTER

config BPT_UPDATE
    bool "Enable BPT Update"
    default n

config READ_BACK_BUFFER
    bool "Enable Read Back Buffer Size"
    default n

if READ_BACK_BUFFER

config READ_BACK_BUFFER_SIZE
    hex "Read Back Buffer Size"
    default 0x40000

endif # READ_BACK_BUFFER
```

## myproject/ssdk/middleware/fusa_monitor/Kconfig
```kconfig
comment "FUSA monitor configuration"

config SEM_ERROR_INTR
    bool "Enable SEM error interrupt"
    default n

if !SEM_ERROR_INTR
config SEM_ERROR_CHECK_PERIOD
    int "SEM error check period, in milli-seconds."
    default 0
    --help--
    SEM error check period in milli-seconds. Set to 0 to disable
    period SEM error check.
endif
```

## myproject/ssdk/middleware/iccmsg/Kconfig
```kconfig
comment "Iccmsg Driver Options"

config ICCMSG_TRACE
	bool "Enable iccmsg RX/TX frame trace recording"
	default y
	help
	  Enable recording of received and transmitted protocol frames
	  in per-instance trace buffers. Useful for debugging but
	  adds memory and CPU overhead in high-frequency data paths.
	  Disable for production builds to improve performance.
```

## myproject/ssdk/middleware/input/Kconfig
```kconfig
comment "input service config option"

config INPUT_SERVICE_DUMMY_DATA
    bool "input service dummy data cmd support"
    default n

config INPUT_PRINT_REPORT_POINT
    bool "input service report data print"
    default n
```

## myproject/ssdk/middleware/iram/Kconfig
```kconfig
comment "IRAM NONE-ECC Options"

config TAISHAN_IRAM_NONE_ECC
    bool "Taishan Disable IRAM ECC"
    select SCR
    default n
```

## myproject/ssdk/middleware/littlevgl/Kconfig
```kconfig
if ARCH_CHIP_E3 || ARCH_CHIP_D3
rsource "taishan/Kconfig"
endif

if ARCH_CHIP_D9 || ARCH_CHIP_G9 || ARCH_CHIP_X9
rsource "kunlun/Kconfig"
endif
```

## myproject/ssdk/middleware/littlevgl/kunlun/Kconfig
```kconfig
comment "LVGL gui engine"

config LVGL_SDRV_DISPLAY
    bool "SDRV LVGL support display"
    select DISPSS
    select DISPSS_KUNLUN
    depends on GUI_LVGL
    default n

config LVGL_SDRV_DECODER_PNG
    bool "SDRV LVGL support png decoder"
    select DECODER_LODEPNG
    depends on GUI_LVGL
    default n

config LVGL_SDRV_DECODER_JPG
    bool "SDRV LVGL support jpg decoder"
    select TJPGDEC
    depends on GUI_LVGL
    default n

config LVGL_SDRV_FAT_FS
    bool "SDRV LVGL support fat fs"
    depends on GUI_LVGL
    default n

config LVGL_SDRV_GPU
    bool "SDRV LVGL support GPU"
    select GPU_HAL
    default n

config LVGL_SDRV_INPUT
    bool "SDRV LVGL support touch"
    depends on GUI_LVGL
    select TOUCH_KUNLUN_PLATFORM
    default n
```

## myproject/ssdk/middleware/littlevgl/taishan/Kconfig
```kconfig
comment "LVGL gui engine"

config LVGL_SDRV_DISPLAY
    bool "SDRV LVGL support display"
    select DISPSS
    default n

config LVGL_SDRV_DECODER_PNG
    bool "SDRV LVGL support png decoder"
    select DECODER_LODEPNG
    default n

config LVGL_SDRV_DECODER_JPG
    bool "SDRV LVGL support jpg decoder"
    select TJPGDEC
    default n

config LVGL_SDRV_FAT_FS
    bool "SDRV LVGL support fat fs"
    default n

config LVGL_SDRV_GPU
    bool "SDRV LVGL support GPU"
    select G2DLITE
    default n

config LVGL_SDRV_INPUT
    bool "SDRV LVGL support touch"
    default n
```

## myproject/ssdk/middleware/module_helper/Kconfig
```kconfig
comment "Module Helper Options"

config MODULE_HELPER_PER_DDR
    bool "peripheral DDR module demo"
    default n

config MODULE_HELPER_PER_SYS
    bool "peripheral SYS module demo"
    default n

config MODULE_HELPER_PER_TEST
    bool "peripheral TEST module demo"
    default n

config MODULE_HELPER_PER_DISP
    bool "peripheral DISP module demo"
    default n
```

## myproject/ssdk/middleware/reboot/Kconfig
```kconfig
comment "Reboot Options"

config KUNLUN_REBOOT
    bool "Kunlun Device"
    select MEM_IMAGE
    default n

config TAISHAN_REBOOT
    bool "Taishan Device"
    select PARTITION
    select DISK
    select RESETGEN
    select SCR
    default n

if TAISHAN_REBOOT
choice
    prompt "Select SP Split/Lockstep"
    default SP_SPLIT_MODE

    config SP_SPLIT_MODE
        bool "Split Mode"

    config SP_LOCKSTEP_MODE
        bool "Lockstep Mode"
endchoice

choice
    prompt "Select SX Split/Lockstep"
    default SX_SPLIT_MODE

    config SX_SPLIT_MODE
        bool "Split Mode"

    config SX_LOCKSTEP_MODE
        bool "Lockstep Mode"
endchoice

choice
    prompt "Select Boot device"
    default REBOOT_DISK_NORFLASH

    config REBOOT_DISK_NORFLASH
        bool "Boot From Norflash0"
        select OSPI
        select TAISHAN_XSPI
        select DISK_NOR_FLASH

    config REBOOT_DISK_MMC0
        bool "Boot From MMC0"
        select MMC
        select SEHC
        select DISK_MMC

    config REBOOT_DISK_MMC1
        bool "Boot From MMC1"
        select MMC
        select SEHC
        select DISK_MMC
endchoice

if SP_LOCKSTEP_MODE
config SP_MEM_BASE
    hex "SP Memory Base"
    default 0x700000

config SP_MEM_LEN
    int "SP Memory Length(kB)"
    default 512

config SP_PT_NAME
    string "SP Partition Name"
    default "sp0"
endif #SP_LOCKSTEP_MODE

if SX_LOCKSTEP_MODE
config SX_MEM_BASE
    hex "SX Memory Base"
    default 0x600000

config SX_MEM_LEN
    int "SX Memory Length(kB)"
    default 512

config SX_PT_NAME
    string "SX Partition Name"
    default "sx0"
endif #SX_LOCKSTEP_MODE

if SP_SPLIT_MODE
config SP0_MEM_BASE
    hex "SP0 Memory Base"
    default 0x700000

config SP0_MEM_LEN
    int "SP0 Memory Length(kB)"
    default 512

config SP0_PT_NAME
    string "SP0 Partition Name"
    default "sp0"

config SP1_MEM_BASE
    hex "SP1 Memory Base"
    default 0x780000

config SP1_MEM_LEN
    int "SP1 Memory Length(kB)"
    default 512

config SP1_PT_NAME
    string "SP1 Partition Name"
    default "sp1"
endif #SP_SPLIT_MODE

if SX_SPLIT_MODE
config SX0_MEM_BASE
    hex "SX0 Memory Base"
    default 0x600000

config SX0_MEM_LEN
    int "SX0 Memory Length(kB)"
    default 512

config SX0_PT_NAME
    string "SX0 Partition Name"
    default "sx0"

config SX1_MEM_BASE
    hex "SX1 Memory Base"
    default 0x680000

config SX1_MEM_LEN
    int "SX1 Memory Length(kB)"
    default 512

config SX1_PT_NAME
    string "SX1 Partition Name"
    default "sx1"

endif #SX_SPLIT_MODE
endif #TAISHAN_REBOOT

config TAISHAN_REBOOT_GLOBAL
    bool "Taishan Global Reboot"
    default n
```

## myproject/ssdk/middleware/rpmsg/Kconfig
```kconfig
comment "Rpmsg Driver Options"

menuconfig RPMSG_VIRTIO
    bool "Rpmsg over share memory"
    default y

if RPMSG_VIRTIO
rsource "virtio/Kconfig"
endif # RPMSG_VIRTIO

menuconfig RPMSG_IPCC
    bool "Rpmsg over mailbox"
    select BUFFQUEUE
    default y

if RPMSG_IPCC
rsource "ipcc/Kconfig"
endif # RPMSG_IPCC
```

## myproject/ssdk/middleware/rpmsg/ipcc/Kconfig
```kconfig
comment "Rpmsg IPCC Options"

config IPCC_BUFF_NUM
    int "Rpmsg ipcc buffer number"
    default 4

config IPCC_PAYLOAD_SIZE
    int "Rpmsg ipcc payload size"
    default 512
```

## myproject/ssdk/middleware/rpmsg/virtio/Kconfig
```kconfig
comment "Rpmsg shm Options"

config SHM_BUFF_NUM
    int "Rpmsg share memory buffer number"
    default 256

config SHM_PAYLOAD_SIZE
    int "Rpmsg share memory payload size"
    default 512
```
