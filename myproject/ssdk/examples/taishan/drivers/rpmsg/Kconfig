## myproject/ssdk/examples/taishan/drivers/rtc/Kconfig
```kconfig
comment "RTC Demo Options"

config SDRV_RTC_DEMO
    bool "Taishan RTC demo"
    default n
```

## myproject/ssdk/examples/taishan/drivers/sent/Kconfig
```kconfig
comment "SENT Example Application Options"

config TAISHAN_SENT_DEMO
    bool "Taishan sent example"
    select SENT
    select SDRV_SENT
    select XTRG
    default n
```

## myproject/ssdk/examples/taishan/drivers/spi/Kconfig
```kconfig
comment "SPI Example Application Options"

config TAISHAN_SPI_DEMO
    bool "Taishan SPI Example Application"
    default n
```

## myproject/ssdk/examples/taishan/drivers/timer/Kconfig
```kconfig
comment "Timer Demo Options"

config SDRV_TMR_DEMO
    bool "Kunlun tmr demo"
    select TIMER
    select SDRV_TMR
    default n
```

## myproject/ssdk/examples/taishan/drivers/uart/Kconfig
```kconfig
comment "UART Example Application Options"

config TAISHAN_UART_DEMO
    bool "Taishan uart example"
    select UART
    select SDRV_UART
    default n
```

## myproject/ssdk/examples/taishan/drivers/usb/Kconfig
```kconfig
comment "USB Example Application Options"

config USB_DEMO_OTG
    bool "USB OTG HID Example Application Support"
    depends on USB_OTG && USB_HOST_HID && USB_DEVICE_HID
    default n

choice
    prompt "USB Device Example Application type"
    depends on !USB_DEMO_OTG
    default USBD_DEMO_NONE

config USBD_DEMO_NONE
    bool "USB Device Example Application Close"

config USBD_DEMO_HID
    bool "USB Device HID Example Application Support"
    depends on USB_DEVICE_HID

config USBD_DEMO_MSC
    bool "USB Device MSC Example Application Support"
    depends on USB_DEVICE_MSC

config USBD_DEMO_FB
    bool "USB Device FastBoot Example Application Support"
    depends on USB_DEVICE_FB

config USBD_DEMO_CDC_ACM
    bool "USB Device Serial Example Application Support"
    depends on USB_DEVICE_CDC_ACM

endchoice

config USBH_DEMO_HID_MSC
    bool "USB Host HID + MSC Example Application Support"
    depends on !USB_DEMO_OTG
    depends on USB_HOST_HID && USB_HOST_MSC
    default n
```

## myproject/ssdk/examples/taishan/ota/Kconfig
```kconfig
comment "OTA Example Option"

config OTA_FROM_UDISK
    bool "Ota From Udisk file"
    select USB
    select USB_HOST
    select USB_HOST_MSC
    default n

config OTA_FROM_ETH_TFTP
    bool "Ota from Ethernet via tftp"
    select ETH
    select DWC_ETH
    default n

config OTA_TFTP_SERVER_IP
    depends on OTA_FROM_ETH_TFTP
    string "Ota Tftp Server Ip"
    default "10.18.252.75"
```

## myproject/ssdk/examples/taishan/util/Kconfig
```kconfig
comment "Utility Example Options"

config POWER_MONITOR
    bool "E3 Board Power Voltage/Current Monitor Example"
    depends on TAISHAN_ADC
    depends on CLI
    default n

config POWER_CLOCK_GATE
    bool "Examples to enable E3 power/clock gating"
    depends on CLI
    default n

if POWER_CLOCK_GATE
rsource "gating/Kconfig"
endif # POWER_CLOCK_GATE

config MEM_SECTION_EXAMPLE
    bool "Example to place code and data in different memory sections"
    depends on EARLYCOPY
    default n

config PVT_EXAMPLE
    bool "Process-Voltage-Temperature example"
    depends on CLI
    default n

if PVT_EXAMPLE
rsource "pvt/Kconfig"
endif # PVT_EXAMPLE
```

## myproject/ssdk/examples/taishan/util/gating/Kconfig
```kconfig
comment "Clock and power gating examples"

config POWER_GATE_EXAMPLE_E3
    bool "E3 power gate example"
    default n

config CLOCK_GATE_EXAMPLE_E3
    bool "E3 clock gate example"
    depends on TAISHAN_CKGEN
    default n

config POWER_GATE_EXAMPLE_D3
    bool "D3 power gate example"
    default n

config CLOCK_GATE_EXAMPLE_D3
    bool "D3 clock gate example"
    depends on TAISHAN_CKGEN
    default n
```

## myproject/ssdk/examples/taishan/util/pvt/Kconfig
```kconfig
comment "Process-Voltage-Temperature sensor Example"

config TAISHAN_TEMPERATURE_EXAMPLE
    bool "Taishan Temperature Sensor example"
    default n
    depends on TAISHAN_TEMPERATURE_SENSOR
```

## myproject/ssdk/lib/Kconfig
```kconfig
comment "LIB Options"

menuconfig BUFFQUEUE
    bool "Buffer Queue Support"
    default n

if BUFFQUEUE
rsource "buffqueue/Kconfig"
endif # BUFFQUEUE

menuconfig CHECKSUM
    bool "Enable Checksum Library"
    default n

if CHECKSUM
rsource "checksum/Kconfig"
endif # CHECKSUM

menuconfig SD_CRC32
    bool "Enable Sd_crc32 Library"
    default n

if SD_CRC32
rsource "sd_crc32/Kconfig"
endif

menuconfig SD_X509
    bool "Enable Sd_x509 Library"
    default n

if SD_X509
rsource "sd_x509/Kconfig"
endif

menuconfig SLIMFS
    bool "Enable slimfs Library"
    select DISK_MMC
    select PARTITION
    default n

if SLIMFS
rsource "slimfs/Kconfig"
endif

menuconfig LIBAVB
    bool "Enable avb Library"
    default n

if LIBAVB
rsource "libavb/Kconfig"
endif

menuconfig PART_LOAD_UTIL
    bool "utility for loading partition data"
    depends on PARTITION
    default n

if PART_LOAD_UTIL
rsource "partition_load/Kconfig"
endif # PART_LOAD_UTIL

menuconfig VERIFIED_BOOT
    bool "Enable verified_boot Library"
    select SD_X509
    select LIBAVB
    select CRYPTO
    select SD_CRC32
    select SILEX_CRYPTO
    select KUNLUN_FUSE
    select PARTITION
    select PART_LOAD_UTIL
    default n

if VERIFIED_BOOT
rsource "verified_boot/Kconfig"
endif

menuconfig DEBUG
    bool "Debug Support"
    default y

if DEBUG
rsource "debug/Kconfig"
endif # DEBUG

menuconfig DEBUG_COMMANDS
    bool "Debug Commands Support"
    default y

if DEBUG_COMMANDS
rsource "debugcommands/Kconfig"
endif # DEBUG_COMMANDS

menuconfig DISK
    bool "Enable common disk layer for storage devices"
    default n

if DISK
rsource "disk/Kconfig"
endif # DISK

if DISK_NOR_FLASH
menuconfig FEE
    bool "Enable Flash EEPROM Emulation"
    depends on (CDNS_OSPI || TAISHAN_XSPI) && DISK_NOR_FLASH
    default y

if FEE
rsource "fee/Kconfig"
endif # FEE
endif # NOR_FLASH

menuconfig LIBC
    bool "Enable libc"
    default y

if LIBC
rsource "libc/Kconfig"
endif # LIBC

menuconfig PARTITION
    bool "Partition Support"
    select CHECKSUM
    select DISK
    default n

if PARTITION
rsource "partition/Kconfig"
endif # PARTITION

menuconfig RES_LOADER
    bool "resource loader support"
    default n
    select DISK
    select FATFS
    select PARTITION

if RES_LOADER
rsource "res_loader/Kconfig"
endif # RES_LOADER

menuconfig RING_BUFFER
    bool "Enable Ring Buffer"
    default n

if RING_BUFFER
rsource "ring_buffer/Kconfig"
endif # RING_BUFFER

menuconfig SD_BOOT_IMG
    bool "Semidrive Boot Image Parsing Support"
    default n

menuconfig SD_BOOT_PIN
    bool "Semidrive Boot Pin Parsing Support"
    default n

menuconfig WORKQUEUE
    bool "Worker Queue Support"
    default n

if WORKQUEUE
rsource "workqueue/Kconfig"
endif # WORKQUEUE

menuconfig ELF_LOADER
    bool "ELF file loader support"
    default n

if ELF_LOADER
rsource "elf/Kconfig"
endif # ELF_LOADER

config VERIFIED_BOOT
    bool "verified bootimage"
    default n
```

## myproject/ssdk/lib/buffqueue/Kconfig
```kconfig
comment "Buffer Queue Options"

config BUFFQUEUE_VRING_ALIGN
    int "Vring buffer align"
    default 4
```

## myproject/ssdk/lib/disk/Kconfig
```kconfig
comment "DISK Options"

config DISK_RAM
    bool "Use block device disk ram"
    default n

config DISK_MMC
    bool "Use block device disk mmc"
    default n

config DISK_NOR_FLASH
    bool "Use block device disk nor flash"
    default n

config DISK_NOR_FLASH_BYTES_API_SUPPORT
    bool "Disk nor flash bytes api which not need block aligned access config"
    depends on DISK_NOR_FLASH
    default y

config DISK_USB
    bool "Use block device disk usb"
    depends on USB_HOST_MSC
    default y

config DISK_MAPPED
    bool "Use mapped disk"
    default n

config DISK_NAME
    string "disk name for mount file system"
    default "norflash0"
```

## myproject/ssdk/lib/elf/Kconfig
```kconfig
comment "ELF loader config option"

config ELF_LOADER_ADDR_CONVERT
    bool "elf loader memory addr trans to safety domain from ap domain"
    default n

choice
    prompt "byte order selection"
    default LITTLE_ENDIAN

config LITTLE_ENDIAN
    bool "LITTLE_ENDIAN"

config BIG_ENDIAN
    bool "BIG_ENDIAN"
endchoice

choice
    prompt "ELF file format select"
    default ELF32

config ELF32
    bool "ELF32 file format"

config ELF64
    bool "ELF64 file format"
endchoice
```

## myproject/ssdk/lib/fee/Kconfig
```kconfig
comment "FEE Options"

config FEE_BLOCK
    bool "Flash EEPROM Emulation access base on block"
    default n

config FEE_EEPROM
    bool "Flash EEPROM Emulation access base on eeprom addr"
    default y
```

## myproject/ssdk/lib/libc/Kconfig
```kconfig
comment "LIBC Options"

config STD_HEAP
    bool "Use libc std heap"
    default n
```

## myproject/ssdk/lib/partition/Kconfig
```kconfig
comment "partition lib"

config PARTITION_BLOCK_IO_MODE
    bool "Partition Block IO Mode"
    default y
```
