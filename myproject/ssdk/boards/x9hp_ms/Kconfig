## myproject/ssdk/boards/x9u-ref_a/safety/Kconfig
```kconfig
comment "X9 Safety Core Options"

config MEM_BASE
    hex "Memory Start Address"
    default 0x37200000

config MEM_SIZE
    hex "Memory Size"
    default 0x10000000

config BOARD_REMAP
    bool "Enable Kunlun board remap"
    select SCR
    select RESETGEN
    select KUNLUN_RESETGEN
    default n

config XIP_MODE
    bool "Run in XIP mode"
    default n

config RAM_BASE
    hex "RAM base for XIP mode"
    depends on XIP_MODE
    default 0x404000

config RAM_SIZE
    hex "RAM size for XIP mode"
    depends on XIP_MODE
    default 0x5C000

config EARLYCOPY
    bool "Early Copy sections from LMA to VMA"
    default y

config ULINK_SIDE_A
    bool "ULINK FOR X9U SSA"
    default y
```

## myproject/ssdk/boards/x9u-ref_a/safety/projects/ref-mmc/defconfig
```kconfig
CONFIG_ARCH_EARLY_ENABLE_ICACHE=y
CONFIG_ARCH_EARLY_ENABLE_DCACHE=y
CONFIG_ARCH_USE_FPU=y
CONFIG_ARCH_USE_MPU=y
CONFIG_ARCH_FIQ_STACK_SIZE=256
CONFIG_ARCH_SVC_STACK_SIZE=2048
CONFIG_ARM_WITH_PMU=y
CONFIG_ARMV7R_TCMA_BASE=0x0
CONFIG_ARMV7R_TCMB_BASE=0x10000
CONFIG_ARCH_CHIP_X9=y
CONFIG_MAIN_THREAD_PRIORITY=2
CONFIG_MEM_BASE=0x37800000
CONFIG_MEM_SIZE=0x8000000
CONFIG_BOARD_REMAP=y
CONFIG_EARLYCOPY=y
CONFIG_AUDIO_BOARD=y
CONFIG_KUNLUN_CKGEN=y
CONFIG_SILEX_CRYPTO=y
CONFIG_DESER=y
CONFIG_mipi_max9286_fengjing_MC163_720P_MAX96705=y
CONFIG_LVDS_HSD123_SERDES_1920x720_LCD=y
CONFIG_MIPI_HSD123_SERDES_1920x720_LCD=y
CONFIG_MIPI_HSD123_SERDES_1920x720_2_LCD=y
CONFIG_LVDS_KD070_SERDES_1024x600_LCD=y
CONFIG_DS90UB9XX=y
CONFIG_DW_DMA=y
CONFIG_DW_PCIE_DMA=y
CONFIG_KUNLUN_FUSE=y
CONFIG_ARM_GIC=y
CONFIG_TCA6408=y
CONFIG_DW_I2C=y
CONFIG_KUNLUN_MBOX=y
CONFIG_DWC_PCIE=y
CONFIG_KUNLUN_PINCTRL=y
CONFIG_SDRV_KUNLUN_PMU=y
CONFIG_SDRV_KUNLUN_PVT=y
CONFIG_KUNLUN_PWM=y
CONFIG_DW_RTC=y
CONFIG_KUNLUN_SEM=y
CONFIG_SERDES_KUNLUN_PLATFORM=y
CONFIG_SERDES_TI9XX=y
CONFIG_KUNLUN_SND=y
CONFIG_CDNS_I2S_SC=y
CONFIG_SDRV_SYSCNT=y
CONFIG_SDRV_TMR=y
CONFIG_TOUCH_KUNLUN_PLATFORM=y
CONFIG_TOUCH_KUNLUN_GOODIX=y
CONFIG_TOUCH_LINK_WITH_SERDES=y
CONFIG_DW_UART=y
CONFIG_UNILINK=y
CONFIG_SDRV_KUNLUN_VPU=y
CONFIG_SDRV_WDOG_KUNLUN=y
CONFIG_MEMMAP=y
CONFIG_DISK_RAM=y
CONFIG_DISK_NAME="memdisk0"
CONFIG_ELF_LOADER=y
CONFIG_ELF_LOADER_ADDR_CONVERT=y
CONFIG_CLI=y
CONFIG_RPMSG_WITH_LK=y
CONFIG_USE_IPCC_RPC=y
CONFIG_OBSERVE_AP1=y
CONFIG_OBSERVE_AP2=y
CONFIG_AUDIO_MANAGER=y
CONFIG_KUNLUN_REBOOT=y
CONFIG_APP_REBOOT_SS=y
CONFIG_BACKLIGHT_SERVICE=y
CONFIG_KUNLUN_CAMERA_SERVICE=y
CONFIG_CSI_SVC_VIA_UNILINK=y
CONFIG_CAN_PROXY=y
CONFIG_SUPPORT_CAN_SDDRV=y
CONFIG_CLUSTER_BRIDGE=y
CONFIG_DISP_CLIENT=y
CONFIG_DISPLAY_SERVICE=y
CONFIG_INPUT_SERVICE_DUMMY_DATA=y
CONFIG_LWIP=y
CONFIG_NFS_CLIENT=y
CONFIG_PROPERTY=y
CONFIG_SDRV_VIRT_CONSOLE=y
CONFIG_SDRV_THERMAL_SERVICE=y
CONFIG_SUPPORT_CRASHDUMP_FEATURE=y
CONFIG_GRAPHICS=y
CONFIG_DRIVERS_EXAMPLE=y
CONFIG_RPMSG_DEMO=y
CONFIG_PMU_DEMO=y
CONFIG_RTC_DEMO=y
CONFIG_APP_LAUNCHER=y
CONFIG_APPLICATION=y
CONFIG_APP_LAUNCHER_DEBUG=y
CONFIG_BOOT_ANIMATION=y
CONFIG_PVT_APPLICATION=y
CONFIG_PVT_APPLICATION_PRINT=y
CONFIG_PVT_IN_SAFETY_DOMAIN=y
CONFIG_PVT_APPLICATION_MONITOR=y
CONFIG_CAM_PRE=y
CONFIG_CAM_DEBUG=y
CONFIG_AUDIO_MANAGER_TEST=y
CONFIG_BACKLIGHT_DEMO=y
CONFIG_SILEX_CRYPTO_TESTER=y
CONFIG_DISP_TESTER=y
CONFIG_DISP_PQ_TESTER=y
CONFIG_FUSE_DEMO=y
CONFIG_INPUT_DEMO=y
CONFIG_PVT_DEMO=y
CONFIG_SERDES_DEMO=y
CONFIG_TOUCH_DEMO=y
CONFIG_VPU_DEMO=y
```

## myproject/ssdk/boards/x9u-ref_a/safety/projects/xip/defconfig
```kconfig
CONFIG_ARCH_EARLY_ENABLE_ICACHE=y
CONFIG_ARCH_EARLY_ENABLE_DCACHE=y
CONFIG_ARCH_USE_FPU=y
CONFIG_ARCH_USE_MPU=y
CONFIG_ARCH_FIQ_STACK_SIZE=256
CONFIG_ARCH_SVC_STACK_SIZE=2048
CONFIG_ARCH_CHIP_X9=y
CONFIG_MAIN_THREAD_PRIORITY=2
CONFIG_MEM_BASE=0x4000000
CONFIG_MEM_SIZE=0x200000
CONFIG_BOARD_REMAP=y
CONFIG_XIP_MODE=y
CONFIG_RAM_BASE=0x100000
CONFIG_RAM_SIZE=0x40000
CONFIG_EARLYCOPY=y
CONFIG_CSI=y
CONFIG_KUNLUN_CKGEN=y
CONFIG_DW_DMA=y
CONFIG_KUNLUN_FUSE=y
CONFIG_ARM_GIC=y
CONFIG_DW_I2C=y
CONFIG_KUNLUN_MBOX=y
CONFIG_KUNLUN_PINCTRL=y
CONFIG_KUNLUN_PWM=y
CONFIG_KUNLUN_SEM=y
CONFIG_SERDES_KUNLUN_PLATFORM=y
CONFIG_SERDES_TI9XX=y
CONFIG_CDNS_OSPI_WR_DIRECT_EN=y
CONFIG_SDRV_SYSCNT=y
CONFIG_SDRV_TMR=y
CONFIG_DW_UART=y
CONFIG_SDRV_WDOG_KUNLUN=y
CONFIG_MEMMAP=y
CONFIG_DISK_NOR_FLASH=y
CONFIG_RES_LOADER=y
CONFIG_ELF_LOADER=y
CONFIG_ELF_LOADER_ADDR_CONVERT=y
CONFIG_MEM_RW=y
CONFIG_RPMSG_WITH_LK=y
CONFIG_USE_IPCC_RPC=y
CONFIG_MEM_IMAGE=y
CONFIG_UPDATE_MONITOR=y
CONFIG_CAN_PROXY=y
CONFIG_SUPPORT_CAN_SDDRV=y
CONFIG_SYS_DIAGNOSIS=y
CONFIG_SUPPORT_CRASHDUMP_FEATURE=y
CONFIG_DRIVERS_EXAMPLE=y
CONFIG_RPMSG_DEMO=y
CONFIG_APPLICATION=y
CONFIG_FUSE_DEMO=y
```

## myproject/ssdk/boards/x9u-ref_b/Kconfig
```kconfig
config BOARD_X9HP_MS
    bool
    depends on ARCH_CHIP_X9
    default y

config ULINK_SIDE_B
    bool "ULINK FOR X9U SSB"
    default y

rsource "$(CORE)/Kconfig"
```

## myproject/ssdk/drivers/Kconfig
```kconfig
comment "Drivers Options"

if ARCH_CHIP_E3 || ARCH_CHIP_D3
rsource "taishan/Kconfig"
endif

if ARCH_CHIP_D9 || ARCH_CHIP_G9 || ARCH_CHIP_X9
rsource "kunlun/Kconfig"
rsource "taihang/Kconfig"
endif

if BOARD_TAISHAN_TIANJIE
rsource "xilinx/Kconfig"
endif

config ADC
    bool

config CAN
    bool

config CLK
    bool

config FUSE
    bool

config GPIO
    bool

config DMA
    bool

config ETH
    bool

config PINCTRL
    bool

config HWMUTEX
    bool

config I2C
    bool

config IRDA
    bool

config IRQ
    bool

config LIN
    bool

config MBOX
    bool

config MEMMAP
    bool "Memory Map Driver Support"
    default n

config MMC
    bool

config OSPI
    bool

config XSPI
    bool

config HYPERBUS_MODE
    bool "Norflash Hyperbus Driver"
    default n

config HYPERBUS_DIFFERENTIAL_CLK_EN
    bool "hyperbus differnetial clock enable"
    default n
    depends on HYPERBUS_MODE

config HYPERBUS_INCREMENTAL_PROGRAM_EN
    bool "hyperbus incremental program enable, support program a single bit"
    default n
    depends on HYPERBUS_MODE

config PCIE
    bool

config PM
    bool

config PMU
    bool

config PWM
    bool

config RESETGEN
    bool

config RTC
    bool

config SCR
    bool

config SDRAMC
    bool

config SEM
    bool

config SENT
    bool

config SMC
    bool

config SND
    bool

config SPI
    bool

config TIMER
    bool

config TOUCH
    bool

config UART
    bool

config WDOG
    bool

config PVT
    bool

config VPU
    bool

config SERDES
    bool

config CDNS_OSPI_MST_SLV
    bool "CDNS OSPI MST SLV Driver Support"
    default n

if CDNS_OSPI_MST_SLV
choice
    prompt "CDNS OSPI MST SLV MODE Options"
    default MST_SLV_OCTAL_LINE_SDR_MODE

config MST_SLV_OCTAL_LINE_DTR_MODE
    bool "Use octal dtr mode"

config MST_SLV_OCTAL_LINE_SDR_MODE
    bool "Use octal sdr mode"

config MST_SLV_QUAD_LINE_DTR_MODE
    bool "Use quad dtr mode"

config MST_SLV_QUAD_LINE_SDR_MODE
    bool "Use quad sdr mode"

config MST_SLV_SINGLE_LINE_DTR_MODE
    bool "Use single dtr mode"

config MST_SLV_SINGLE_LINE_STR_MODE
    bool "Use single sdr mode"

endchoice

endif # CDNS_OSPI_MST_SLV
```

## myproject/ssdk/drivers/kunlun/Kconfig
```kconfig
rsource "adc/Kconfig"
rsource "am/Kconfig"
rsource "can/Kconfig"
rsource "clk/Kconfig"
rsource "crypto/silex_crypto/Kconfig"
rsource "csi/Kconfig"
rsource "dispss/Kconfig"
rsource "dma/Kconfig"
rsource "eth/Kconfig"
rsource "fuse/Kconfig"
rsource "g2dlite/Kconfig"
rsource "gic/Kconfig"
rsource "gpio/Kconfig"
rsource "i2c/Kconfig"
rsource "lin/Kconfig"
rsource "mbox/Kconfig"
rsource "pcie/Kconfig"
rsource "pinctrl/Kconfig"
rsource "pmu/Kconfig"
rsource "pvt/Kconfig"
rsource "pwm/Kconfig"
rsource "reset/Kconfig"
rsource "rtc/Kconfig"
rsource "scr/Kconfig"
rsource "sem/Kconfig"
rsource "serdes/Kconfig"
rsource "snd/Kconfig"
rsource "spi/Kconfig"
rsource "spi_nor/Kconfig"
rsource "syscnt/Kconfig"
rsource "tmr/Kconfig"
rsource "virt_uart/Kconfig"
rsource "timestamp/Kconfig"
rsource "touch/Kconfig"
rsource "uart/Kconfig"
rsource "ulink/Kconfig"
rsource "vpu/Kconfig"
rsource "vpu_dev_api/Kconfig"
rsource "watchdog/Kconfig"
rsource "mmc/Kconfig"
rsource "pfm/Kconfig"
rsource "pmic/Kconfig"
```

## myproject/ssdk/drivers/kunlun/adc/Kconfig
```kconfig
config KUNLUN_ADC
    bool "Kunlun ADC Driver Support"
    select ADC
    default n
```

## myproject/ssdk/drivers/kunlun/am/Kconfig
```kconfig
comment "Audio manager Board Options"

menuconfig AUDIO_BOARD
    bool "audio manager board select"
    default n

if AUDIO_BOARD
rsource "am_board/Kconfig"
endif
```

## myproject/ssdk/drivers/kunlun/am/am_board/Kconfig
```kconfig
comment "board Options"

choice
    prompt "Select target board"
    default AM_BOARD_X9_MS

config AM_BOARD_X9_MS
    bool "X9_MS Board Support"

config AM_BOARD_X9_REF
    bool "X9_REF Board Support"

endchoice
```
