## myproject/ssdk/boards/d3_gateway/sf/Kconfig
```kconfig
comment "D3 SF Core Options"

config MEM_BASE
    hex "Memory Start Address"
    default 0x404000

config MEM_SIZE
    hex "Memory Size"
    range 0 IRAM_LIMIT
    default 0x1FBC00

config IRAM_NONE_ECC_BASE
    hex "IRAM NONE-ECC Base Address"
    default 0x800000

config IRAM_NONE_ECC_SIZE
    hex "IRAM NONE-ECC Size"
    default 0x80000

menuconfig CORE_SHM
    bool "Inter-core Share Memory Support"
    default y

if CORE_SHM
    config CORE_SHM_BASE
        hex "Inter-core Share Memory Start Address"
        default 0x5FFC00

    config CORE_SHM_SIZE
        hex "Inter-core Share Memory Size"
        default 0x400
endif

config EARLYCOPY
    bool "Early Copy sections from LMA to VMA"
    default y

config CLOCK_OVER_DRIVE_MODE
    bool "Clock over drive mode"
    default n

config BOARD_DEBUG
    bool "Enable CR5 debug"
    select CORE_DEBUG
    select TAISHAN_CORE_DEBUG
    default n

config FIX_LDO_1V8
    bool "Fix internal 1.8V LDO output"
    default y

config XIP_MODE
    bool "Run in XIP mode"
    default n

config RAM_BASE
    hex "RAM base for XIP mode"
    depends on XIP_MODE
    default 0x404000

config RAM_SIZE
    hex "RAM size for XIP mode"
    depends on XIP_MODE
    default 0x1FC000
```

## myproject/ssdk/boards/d3_gateway/sf/projects/baremetal/defconfig
```kconfig
CONFIG_ARCH_EARLY_ENABLE_ICACHE=y
CONFIG_ARCH_EARLY_ENABLE_DCACHE=y
CONFIG_ARCH_USE_FPU=y
CONFIG_ARCH_USE_MPU=y
CONFIG_ARCH_CHIP_D3=y
CONFIG_ARM_WITH_PMU=y
CONFIG_ARMV7R_TCMA_BASE=0x1910000
CONFIG_ARMV7R_TCMB_BASE=0x1900000
CONFIG_MAIN_THREAD_PRIORITY=2
CONFIG_AUTO_SIGN_BOARD_IMG=y
CONFIG_MEM_SIZE=0x1F4000
CONFIG_OS_BAREMETAL=y
CONFIG_SDRV_BTM=y
CONFIG_TAISHAN_CKGEN=y
CONFIG_CLK_MONITOR=y
CONFIG_SDRV_LIN=y
CONFIG_TAISHAN_PINCTRL=y
CONFIG_TAISHAN_RESETGEN=y
CONFIG_TAISHAN_SCR=y
CONFIG_SDRV_VIC=y
CONFIG_BUFFQUEUE=y
CONFIG_DISK_MMC=y
CONFIG_DISK_NOR_FLASH=y
CONFIG_PARTITION=y
CONFIG_SD_BOOT_IMG=y
CONFIG_MEM_RW=y
```

## myproject/ssdk/boards/d3_gateway/sf/projects/bootloader/defconfig
```kconfig
CONFIG_ARCH_EARLY_ENABLE_ICACHE=y
CONFIG_ARCH_EARLY_ENABLE_DCACHE=y
CONFIG_ARCH_USE_FPU=y
CONFIG_ARCH_USE_MPU=y
CONFIG_ARCH_CHIP_D3=y
CONFIG_ARM_WITH_PMU=y
CONFIG_ARMV7R_TCMA_BASE=0x1910000
CONFIG_ARMV7R_TCMB_BASE=0x1900000
CONFIG_MAIN_THREAD_PRIORITY=2
CONFIG_MEM_SIZE=0x1F4000
CONFIG_SDRV_BTM=y
CONFIG_TAISHAN_CKGEN=y
CONFIG_CLK_MONITOR=y
CONFIG_SEHC=y
CONFIG_TAISHAN_PINCTRL=y
CONFIG_TAISHAN_RESETGEN=y
CONFIG_TAISHAN_SCR=y
CONFIG_TAISHAN_XSPI=y
CONFIG_SDRV_UART=y
CONFIG_SDRV_VIC=y
CONFIG_BUFFQUEUE=y
CONFIG_DISK_MMC=y
CONFIG_DISK_NOR_FLASH=y
CONFIG_MEM_RW=y
CONFIG_OTA_EXAMPLE=y
CONFIG_OTA_FROM_ETH_TFTP=y
```

## myproject/ssdk/boards/d3_gateway/sf/projects/flashloader/defconfig
```kconfig
CONFIG_ARCH_EARLY_ENABLE_ICACHE=y
CONFIG_ARCH_EARLY_ENABLE_DCACHE=y
CONFIG_ARCH_USE_FPU=y
CONFIG_ARCH_CHIP_D3=y
CONFIG_ARM_WITH_PMU=y
CONFIG_MAIN_THREAD_PRIORITY=2
CONFIG_BOARD_LOOPSPERUSEC=30
CONFIG_MEM_BASE=0x500000
CONFIG_MEM_SIZE=0x100000
# CONFIG_EARLYCOPY is not set
# CONFIG_FIX_LDO_1V8 is not set
CONFIG_OS_BAREMETAL=y
CONFIG_BAREMETAL_WORK_IN_IRQ=y
CONFIG_TAISHAN_CKGEN=y
CONFIG_TAISHAN_PINCTRL=y
CONFIG_TAISHAN_RESETGEN=y
CONFIG_TAISHAN_SCR=y
CONFIG_TAISHAN_XSPI=y
CONFIG_SDRV_UART=y
CONFIG_DEBUG_LEVEL=3
CONFIG_CHECKSUM=y
CONFIG_CLI=y
CONFIG_FLASH_LOADER=y
CONFIG_CHECK_FLASH_LOAD=y
CONFIG_BPT_UPDATE=y
CONFIG_READ_BACK_BUFFER=y
```

## myproject/ssdk/boards/d3_gateway/sf/projects/xip/defconfig
```kconfig
CONFIG_ARCH_EARLY_ENABLE_ICACHE=y
CONFIG_ARCH_EARLY_ENABLE_DCACHE=y
CONFIG_ARCH_USE_FPU=y
CONFIG_ARCH_USE_MPU=y
CONFIG_ARCH_CHIP_D3=y
CONFIG_ARM_WITH_PMU=y
CONFIG_ARMV7R_TCMA_BASE=0x1910000
CONFIG_ARMV7R_TCMB_BASE=0x1900000
CONFIG_MAIN_THREAD_PRIORITY=2
CONFIG_MEM_BASE=0x0
CONFIG_MEM_SIZE=0x1F4000
CONFIG_BOARD_DEBUG=y
CONFIG_XIP_MODE=y
CONFIG_RAM_SIZE=0x1F4000
CONFIG_IDLE_TASK_STACK_SIZE=2048
CONFIG_USE_TICKLESS_IDLE=y
CONFIG_TAISHAN_ADC=y
CONFIG_SDRV_ACMP=y
CONFIG_SDRV_BTM=y
CONFIG_FLEXCAN=y
CONFIG_SDRV_FLEXCAN_ENH=y
CONFIG_TAISHAN_CKGEN=y
CONFIG_CLK_MONITOR=y
CONFIG_OSR_CRYPTO=y
CONFIG_OSR_CRYPTO_DRIVER=y
CONFIG_OSR_CRYPTO_DRIVER_MAILBOX=y
CONFIG_SDRV_EPWM=y
CONFIG_DWC_ETH=y
CONFIG_TAISHAN_FUSE=y
CONFIG_SDRV_I2C=y
CONFIG_SEHC=y
CONFIG_TAISHAN_PINCTRL=y
CONFIG_TAISHAN_PM=y
CONFIG_DEBUG_TAISHAN_PM=y
CONFIG_TRACE_TAISHAN_PM=y
CONFIG_SEM=y
CONFIG_SENSOR=y
CONFIG_TAISHAN_TEMPERATURE_SENSOR=y
CONFIG_SDRV_SMC=y
CONFIG_TAISHAN_SND=y
CONFIG_SACI_I2S=y
CONFIG_SACI_SLAVE=y
CONFIG_SACI_PDM=y
CONFIG_CODEC=y
CONFIG_CODEC_TLV320=y
CONFIG_SD_SPI=y
CONFIG_SDRV_VIC=y
CONFIG_SDRV_WDOG_TAISHAN=y
CONFIG_XTRG=y
CONFIG_DISK_MMC=y
CONFIG_MEM_RW=y
CONFIG_DHRYSTONE=y
CONFIG_COREMARK=y
CONFIG_SHM_BUFF_NUM=16
CONFIG_RPMSG_RPROC_NUM=5
CONFIG_CU=y
CONFIG_FLOPS=y
CONFIG_USB=y
CONFIG_USB_DEVICE=y
CONFIG_USB_DEVICE_CDC_ACM=y
CONFIG_USB_HOST=y
CONFIG_USB_HOST_HID=y
CONFIG_USB_HOST_MSC=y
CONFIG_DRIVERS_EXAMPLE=y
CONFIG_USB_DEMO=y
CONFIG_USBD_DEMO_CDC_ACM=y
CONFIG_LIN_DEMO=y
CONFIG_SDRV_LIN_DEMO=y
CONFIG_ADC_DEMO=y
CONFIG_TAISHAN_ADC_DEMO=y
CONFIG_MBOX_DEMO=y
CONFIG_TAISHAN_MBOX_DEMO=y
CONFIG_RPMSG_DEMO=y
CONFIG_DMA_DEMO=y
CONFIG_CANFD_DEMO=y
CONFIG_LED_DEMO=y
CONFIG_ANALOG_IN_DEMO=y
CONFIG_ANALOG_OUT_DEMO=y
CONFIG_HSD_DEMO=y
CONFIG_ACMP_DEMO=y
CONFIG_LSD_DEMO=y
CONFIG_SBC=y
CONFIG_PMU_DEMO=y
CONFIG_TAISHAN_PMU_DEMO=y
CONFIG_WDOG_DEMO=y
CONFIG_GUI_APPLICATION=y
CONFIG_APP_MP3_DEC=y
CONFIG_BOOT_EXAMPLE=y
CONFIG_GLOBAL_REBOOT_EXAMPLE=y
CONFIG_UTIL_EXAMPLE=y
CONFIG_POWER_MONITOR=y
CONFIG_POWER_CLOCK_GATE=y
CONFIG_POWER_GATE_EXAMPLE_E3=y
CONFIG_CLOCK_GATE_EXAMPLE_E3=y
CONFIG_MEM_SECTION_EXAMPLE=y
CONFIG_PVT_EXAMPLE=y
CONFIG_TAISHAN_TEMPERATURE_EXAMPLE=y
CONFIG_OTA_EXAMPLE=y
```

## myproject/ssdk/boards/d9310_ref/Kconfig
```kconfig
config BOARD_D9310_REF
    bool
    select HAS_AP2
    depends on ARCH_CHIP_D9
    default y

rsource "$(CORE)/Kconfig"
```

## myproject/ssdk/boards/d9310_ref/ap/projects/ref/defconfig
```kconfig
CONFIG_ARCH_ARM64=y
CONFIG_ARCH_CACHE_LINE=64
CONFIG_ARCH_WITH_MMU=y
CONFIG_ARCH_USE_MMU=y
# CONFIG_ARCH_STACK_DYNAMIC is not set
CONFIG_ARCH_CHIP_D9=y
CONFIG_MAIN_THREAD_STACK_SIZE=1024
CONFIG_MAIN_THREAD_PRIORITY=2
CONFIG_AP=y
CONFIG_MEM_BASE=0x59200000
CONFIG_MEM_SIZE=0x400000
CONFIG_OS_BAREMETAL=y
CONFIG_KUNLUN_CKGEN=y
CONFIG_ARM_GIC=y
CONFIG_KUNLUN_PINCTRL=y
CONFIG_KUNLUN_RESETGEN=y
CONFIG_KUNLUN_SCR=y
CONFIG_SDRV_SYSCNT=y
CONFIG_SDRV_TMR=y
CONFIG_DW_UART=y
CONFIG_SDRV_WDOG_KUNLUN=y
CONFIG_BUFFQUEUE=y
CONFIG_BUFFQUEUE_VRING_ALIGN=32
# CONFIG_DEBUG is not set
CONFIG_CLI=y
CONFIG_CLI_STACK_SIZE=1024
CONFIG_CLI_SYNC_MODE=y
CONFIG_DRIVERS_EXAMPLE=y
CONFIG_IRQ_TESTER=y
```

## myproject/ssdk/boards/d9342_ref/Kconfig
```kconfig
config BOARD_D9342_REF
    bool
    select HAS_AP1
    depends on ARCH_CHIP_D9
    default y

rsource "$(CORE)/Kconfig"
```

## myproject/ssdk/boards/d9350_ref/Kconfig
```kconfig
config BOARD_D9350_REF
    bool
    select HAS_AP1
    select HAS_AP2
    depends on ARCH_CHIP_D9
    default y

rsource "$(CORE)/Kconfig"
```

## myproject/ssdk/boards/d9350_ref/ap/Kconfig
```kconfig
comment "D9 Lite Core Options"

config MEM_BASE
    hex "Memory Start Address"
    default 0x3B000000

config MEM_SIZE
    hex "Memory Size"
    default 0x10000000

config BOARD_REMAP
    bool "Enable Kunlun board remap"
    select SCR
    select RESETGEN
    select KUNLUN_RESETGEN
    default n

choice
    prompt "board soc select"
    default BOARD_D9_AP1

    config BOARD_D9_AP1
        bool "select board d9 STD"

    config BOARD_D9_AP2
        bool "select board d9 LITE"

endchoice

config EARLYCOPY
    bool "early copy"
    default n
```

## myproject/ssdk/boards/d9350_ref/mp/Kconfig
```kconfig
comment "D9 MP Core Options"

config MEM_BASE
    hex "Memory Start Address"
    default 0x37800000

config MEM_SIZE
    hex "Memory Size"
    default 0x10000000x1000000

config BOARD_REMAP
    bool "Enable Kunlun board remap"
    select SCR
    select RESETGEN
    select KUNLUN_RESETGEN
    default n

config FIREWALL_DISABLE
    bool "disable firewall function"
    default y

config EARLYCOPY
    bool "early copy"
    default n
```

## myproject/ssdk/boards/d9350_ref/mp/projects/ref/defconfig
```kconfig
CONFIG_ARCH_EARLY_ENABLE_ICACHE=y
CONFIG_ARCH_EARLY_ENABLE_DCACHE=y
CONFIG_ARCH_USE_FPU=y
CONFIG_ARCH_USE_MPU=y
CONFIG_ARCH_FIQ_STACK_SIZE=256
CONFIG_ARCH_SVC_STACK_SIZE=2048
CONFIG_ARM_WITH_PMU=y
CONFIG_ARCH_CHIP_D9_SEC=y
CONFIG_ARCH_CHIP_D9=y
CONFIG_MAIN_THREAD_PRIORITY=2
CONFIG_MEM_SIZE=0x1000000
CONFIG_DISPSS=y
CONFIG_KUNLUN_CKGEN=y
CONFIG_DISPSS_KUNLUN=y
CONFIG_ARM_GIC=y
CONFIG_KUNLUN_SEM=y
CONFIG_SDRV_SYSCNT=y
CONFIG_SDRV_TMR=y
CONFIG_DW_UART=y
CONFIG_MEMMAP=y
CONFIG_BUFFQUEUE=y
CONFIG_WORKQUEUE=y
CONFIG_MEM_RW=y
CONFIG_APPLICATION=y
# CONFIG_APP_AUDIO is not set
```

## myproject/ssdk/boards/d9350_ref/safety/Kconfig
```kconfig
comment "D9 Safety Core Options"

config MEM_BASE
    hex "Memory Start Address"
    default 0x38800000

config MEM_SIZE
    hex "Memory Size"
    default 0xf000000

config BOARD_REMAP
    bool "Enable Kunlun board remap"
    select SCR
    select RESETGEN
    select KUNLUN_RESETGEN
    default n
config KUNLUN_BOOT_MP
    bool "Boot MP Core"
    default n

config EARLYCOPY
    bool "early copy"
    default n
```

## myproject/ssdk/boards/d9350_ref/secure/projects/ref/defconfig
```kconfig
CONFIG_ARCH_EARLY_ENABLE_ICACHE=y
CONFIG_ARCH_EARLY_ENABLE_DCACHE=y
CONFIG_ARCH_USE_FPU=y
CONFIG_ARCH_USE_MPU=y
CONFIG_ARCH_FIQ_STACK_SIZE=256
CONFIG_ARCH_SVC_STACK_SIZE=2048
CONFIG_ARM_WITH_PMU=y
CONFIG_ARCH_CHIP_D9_SEC=y
CONFIG_ARCH_CHIP_D9=y
CONFIG_MAIN_THREAD_PRIORITY=2
CONFIG_MEM_BASE=0x140000
CONFIG_MEM_SIZE=0x80000
CONFIG_BOARD_REMAP=y
CONFIG_KUNLUN_CKGEN=y
CONFIG_ARM_GIC=y
CONFIG_KUNLUN_MBOX=y
CONFIG_KUNLUN_PINCTRL=y
CONFIG_KUNLUN_SEM=y
CONFIG_SDRV_SYSCNT=y
CONFIG_SDRV_TMR=y
CONFIG_DW_UART=y
CONFIG_MEMMAP=y
CONFIG_MEM_RW=y
CONFIG_RPMSG_SERVICE=y
CONFIG_RPMSG_WITH_LK=y
CONFIG_USE_IPCC_RPC=y
CONFIG_OBSERVE_AP1=y
CONFIG_OBSERVE_AP2=y
CONFIG_APPLICATION=y
```

## myproject/ssdk/boards/d9_ref/safety/Kconfig
```kconfig
comment "D9 Safety Core Options"

config MEM_BASE
    hex "Memory Start Address"
    default 0x3B000000

config MEM_SIZE
    hex "Memory Size"
    default 0x10000000

config BOARD_REMAP
    bool "Enable Kunlun board remap"
    select SCR
    select RESETGEN
    select KUNLUN_RESETGEN
    default n

config EARLYCOPY
    bool "early copy"
    default n

config SUPPORT_STR_MODE
    bool "support str mode"
    default n

config ULINK_SINGLE_SIDE_SAF
    bool "ULINK for single side safety R5 core"
    default n
```

## myproject/ssdk/boards/d9_ref/safety/projects/ref/defconfig
```kconfig
CONFIG_ARCH_EARLY_ENABLE_ICACHE=y
CONFIG_ARCH_EARLY_ENABLE_DCACHE=y
CONFIG_ARCH_USE_FPU=y
CONFIG_ARCH_USE_MPU=y
CONFIG_ARM_WITH_PMU=y
CONFIG_ARCH_CHIP_D9=y
CONFIG_MAIN_THREAD_PRIORITY=2
CONFIG_MEM_BASE=0x37200000
CONFIG_BOARD_REMAP=y
CONFIG_SUPPORT_STR_MODE=y
CONFIG_ULINK_SINGLE_SIDE_SAF=y
CONFIG_DISPSS=y
CONFIG_KUNLUN_CKGEN=y
CONFIG_DISPSS_KUNLUN=y
CONFIG_DW_DMA=y
CONFIG_KUNLUN_FUSE=y
CONFIG_ARM_GIC=y
CONFIG_KUNLUN_MBOX=y
CONFIG_KUNLUN_PINCTRL=y
CONFIG_DW_RTC=y
CONFIG_KUNLUN_SEM=y
CONFIG_SDRV_SYSCNT=y
CONFIG_SDRV_TMR=y
CONFIG_DW_UART=y
CONFIG_UNILINK=y
CONFIG_SDRV_WDOG_KUNLUN=y
CONFIG_PFM=y
CONFIG_MEMMAP=y
CONFIG_SD_BOOT_PIN=y
CONFIG_CLI=y
CONFIG_RPMSG_WITH_LK=y
CONFIG_OBSERVE_AP1=y
CONFIG_OBSERVE_AP2=y
CONFIG_KUNLUN_REBOOT=y
CONFIG_APP_REBOOT_SS=y
CONFIG_LWIP=y
CONFIG_SDRV_VIRT_CONSOLE=y
CONFIG_SUPPORT_CRASHDUMP_FEATURE=y
CONFIG_FUSALIB_DDR=y
CONFIG_DRIVERS_EXAMPLE=y
CONFIG_RPMSG_DEMO=y
CONFIG_APPLICATION=y
CONFIG_FuncSafetyPkg_TEST=y
CONFIG_PIN_TESTER=y
```

## myproject/ssdk/boards/v9p_ms/mp/projects/ms-vmmc/defconfig
```kconfig
CONFIG_ARCH_EARLY_ENABLE_ICACHE=y
CONFIG_ARCH_EARLY_ENABLE_DCACHE=y
CONFIG_ARCH_USE_FPU=y
CONFIG_ARCH_USE_MPU=y
CONFIG_ARCH_FIQ_STACK_SIZE=256
CONFIG_ARCH_SVC_STACK_SIZE=2048
CONFIG_ARM_WITH_PMU=y
CONFIG_ARMV7R_TCMA_BASE=0x22C0000
CONFIG_ARMV7R_TCMB_BASE=0x22B0000
CONFIG_ARCH_CHIP_X9=y
CONFIG_MAIN_THREAD_PRIORITY=2
CONFIG_MP=y
CONFIG_MEM_BASE=0x7EE00000
CONFIG_MEM_SIZE=0x8000000
CONFIG_BOARD_REMAP=y
CONFIG_DISPSS=y
CONFIG_KUNLUN_CKGEN=y
CONFIG_SILEX_CRYPTO=y
CONFIG_DISPSS_TAIHANG=y
CONFIG_LVDS_WALLFACERA2_HSD123_SERDES_1920x720_LCD=y
CONFIG_LVDS_WALLFACERA2_HSD123_SERDES_1920x720_2_LCD=y
CONFIG_MIPI_WALLFACERA2_HSD123_SERDES_1920x720_LCD=y
CONFIG_MIPI_WALLFACERA2_HSD123_SERDES_1920x720_2_LCD=y
CONFIG_DS90UB9XX=y
CONFIG_MAXIM_DISP=y
CONFIG_DW_DMA=y
CONFIG_KUNLUN_FUSE=y
CONFIG_ARM_GIC=y
CONFIG_TCA9539=y
CONFIG_TCA6408=y
CONFIG_DW_I2C=y
CONFIG_KUNLUN_MBOX=y
CONFIG_KUNLUN_PINCTRL=y
CONFIG_SDRV_KUNLUN_PMU=y
CONFIG_KUNLUN_PWM=y
CONFIG_DW_RTC=y
CONFIG_KUNLUN_SEM=y
CONFIG_SERDES_KUNLUN_PLATFORM=y
CONFIG_SERDES_MAX967XX=y
CONFIG_KUNLUN_SND=y
CONFIG_CDNS_I2S_SC=y
CONFIG_SDRV_SYSCNT=y
CONFIG_SDRV_TMR=y
CONFIG_SUPPORT_LOG_TIMESTAMP=y
CONFIG_DW_UART=y
CONFIG_UNILINK=y
CONFIG_SDRV_KUNLUN_VPU=y
CONFIG_VPU_DEV_API=y
CONFIG_KUNLUN_MMC=y
CONFIG_MEMMAP=y
CONFIG_DEBUG_LEVEL=3
CONFIG_DISK_RAM=y
CONFIG_DISK_NAME="mmc0"
CONFIG_ELF_LOADER=y
CONFIG_ELF_LOADER_ADDR_CONVERT=y
CONFIG_CLI=y
CONFIG_IPCC_BUFF_NUM=16
CONFIG_RPMSG_WITH_LK=y
CONFIG_USE_IPCC_RPC=y
CONFIG_OBSERVE_AP1=y
CONFIG_OBSERVE_AP2=y
CONFIG_MEM_IMAGE=y
CONFIG_GUI_LVGL=y
CONFIG_LVGL_SDRV_GPU=y
CONFIG_BACKLIGHT_SERVICE=y
CONFIG_CAN_PROXY=y
CONFIG_VCAN_CLIENT=y
CONFIG_CLUSTER_BRIDGE=y
CONFIG_DISP_CLIENT=y
CONFIG_DISPLAY_SERVICE=y
CONFIG_LWIP=y
CONFIG_NFS_CLIENT=y
CONFIG_PROPERTY=y
CONFIG_SDRV_PROP_SERVER=y
CONFIG_ERRCODE=y
CONFIG_SDRV_VIRT_CONSOLE=y
CONFIG_GRAPHICS=y
CONFIG_VIRTIO=y
CONFIG_VIRTIO_FRONTEND=y
CONFIG_VIRTIO_BACKEND=y
CONFIG_VIRTIO_MMC_FRONTEND=y
CONFIG_TIME_SYNC=y
CONFIG_DRIVERS_EXAMPLE=y
CONFIG_MBOX_DEMO=y
CONFIG_RPMSG_DEMO=y
CONFIG_PMU_DEMO=y
CONFIG_RTC_DEMO=y
CONFIG_APPLICATION=y
# CONFIG_APP_AUDIO is not set
CONFIG_PFM_ON=y
CONFIG_POWER_OFF=y
CONFIG_KERNEL_MONITOR=y
CONFIG_SEM_MONITOR=y
CONFIG_BACKLIGHT_DEMO=y
CONFIG_SILEX_CRYPTO_TESTER=y
CONFIG_DISP_TESTER=y
CONFIG_FUSE_DEMO=y
CONFIG_SERDES_DEMO=y
CONFIG_VPU_DEMO=y
CONFIG_I2C_TESTER=y
CONFIG_I2C_TOOLS_CMD=y
CONFIG_PIN_TESTER=y
```
