## myproject/ssdk/drivers/taishan/scr/Kconfig
```kconfig
menuconfig TAISHAN_SCR
    bool "Taishan SCR Driver Support"
    select SCR
    default n

if TAISHAN_SCR

config SCR_FUSA
    bool "SCR Function Safety Support"
    default n

endif # TAISHAN_SCR
```

## myproject/ssdk/drivers/taishan/sdramc/Kconfig
```kconfig
menuconfig SDRV_SDRAMC
    bool "Taishan SDRAMC Driver Support"
    select SDRAMC
    default n

if SDRV_SDRAMC

config SDRAM_BASE
    hex "SDRAM Start Address"
    default 0x30000000

config SDRAM_SIZE
    hex "SDRAM Size"
    default 0x4000000

endif # SDRV_SDRAMC
```

## myproject/ssdk/drivers/taishan/sensor/Kconfig
```kconfig
menuconfig SENSOR
    bool "Taishan Sensor Drivers Support"
    default n

if SENSOR

config TAISHAN_TEMPERATURE_SENSOR
    bool "Taishan Temperature Sensor Driver"
    default n

endif # SENSOR
```

## myproject/ssdk/drivers/taishan/sent/Kconfig
```kconfig
config SDRV_SENT
    bool "Taishan SENT Driver Support"
    select TIMER
    select SDRV_ETIMER
    select CHECKSUM
    default n
```

## myproject/ssdk/drivers/taishan/smc/Kconfig
```kconfig
config SDRV_SMC
    bool "Taishan SMC Driver Support"
    select SMC
    select RTC
    select SEC_RTC
    select PMU
    select SDRV_PMU
    default n
```

## myproject/ssdk/drivers/taishan/snd/Kconfig
```kconfig
menuconfig TAISHAN_SND
    bool "Taishan Sound Driver Support"
    select SND
    default n

if TAISHAN_SND

config SACI_I2S
    bool "SACI I2S Driver"
    default n

config SACI_SLAVE
    bool "SACI hardware slave bug fix"
    default n
    depends on SACI_I2S

config SACI_PDM
    bool "SACI PDM Driver"
    default n

config CODEC
    bool "CODEC Driver"
    default n

config CODEC_AK4619
    bool "Codec Ak4619 Driver"
    default n
    depends on CODEC

config CODEC_TLV320
    bool "Codec Tlv320 Driver"
    default n
    depends on CODEC

endif # TAISHAN_SND
```

## myproject/ssdk/drivers/taishan/spi/Kconfig
```kconfig
config SD_SPI
    bool "Taishan SPI Driver Support"
    select SPI
    select DMA
    select SDRV_DMA
    default n
```

## myproject/ssdk/drivers/taishan/spi_nor/Kconfig
```kconfig
menuconfig TAISHAN_XSPI
    bool "TAISHAN XSPI Driver Support"
    select OSPI
    default n

if TAISHAN_XSPI

config XSPI_Z1_TEST
    bool "XSPI Z1 TEST"
    default n

endif # TAISHAN_XSPI
```

## myproject/ssdk/drivers/taishan/tmonitor/Kconfig
```kconfig
config TAMPER_MONITOR
    bool "Taishan Tamper Monitor Driver Support"
    default n
```

## myproject/ssdk/drivers/taishan/touch/Kconfig
```kconfig
config TOUCH_GOODIX
    bool "Goodix Touch Driver Support"
    select TOUCH
    default n
```

## myproject/ssdk/drivers/taishan/uart/Kconfig
```kconfig
config SDRV_UART
    bool "Taishan Uart Driver Support"
    select UART
    default n
```

## myproject/ssdk/drivers/taishan/vic/Kconfig
```kconfig
menuconfig SDRV_VIC
    bool "Taishan vic Driver Support"
    select IRQ
    default n

if SDRV_VIC

config VIC_IRQ_INTERRUPT_MODE
    bool "VIC vectored IRQ interrupt mode"
    default n

config VIC_1_0
    bool "VIC hardware version 1.0"
    default y

config VIC_INT_NEST_ERRATA
    bool "Enable VIC interrupt nesting errata"
    default n
    depends on VIC_1_0

config VIC_INT_NEST_AUTO_ENABLE
    bool "Automatically enable irq nesting by system"
    default n

config VIC_INT_NEST_MAX_CNT
    int "VIC maximum allowed interupt nesting counter"
    default 16
    depends on VIC_INT_NEST_AUTO_ENABLE

endif # SDRV_VIC
```

## myproject/ssdk/drivers/taishan/watchdog/Kconfig
```kconfig
config SDRV_WDOG_TAISHAN
    bool "Taishan WDOG Driver Support"
    select WDOG
    default n
```

## myproject/ssdk/drivers/taishan/xspi_mst_slv/Kconfig
```kconfig
menuconfig XSPI_MST_SLV
    bool "XSPI Master and Slave Driver Support"
    default n

if XSPI_MST_SLV

config XSPI_MST
    bool "Taishan XSPI Master"
    default n
    ---help---
    Use XSPI controller as master device, so we can directlly read and
    write memory and register spaces of an external XSPI slave device
    through memory mapped APB area of the XSPI master.

config XSPI_SLV
    bool "Taishan XSPI Slave"
    default n
    ---help---
    Use XSPI controller as slave device, so an external XSPI master can
    directlly read and write memory and register spaces of this device.

endif # XSPI_MST_SLV
```

## myproject/ssdk/drivers/taishan/xtrg/Kconfig
```kconfig
config XTRG
    bool "Cross Trigger Driver Support"
    default n
    ---help---
    Enable the Cross Trigger module, which manages internal trigger and
    signal networks between eTimer, ePWM, ADC, ACMP modules and I/O pads.
```

## myproject/ssdk/drivers/xilinx/Kconfig
```kconfig
comment "Xilinx Device Drivers"

rsource "ttc/Kconfig"
rsource "uart/Kconfig"
rsource "gic/Kconfig"
```

## myproject/ssdk/drivers/xilinx/gic/Kconfig
```kconfig
comment "ARM GIC Driver Options"

config ARM_GIC
    bool "ARM GIC Driver"
    select IRQ
    default n
```

## myproject/ssdk/examples/Kconfig
```kconfig
if ARCH_CHIP_E3 || ARCH_CHIP_D3
rsource "taishan/Kconfig"
endif

if ARCH_CHIP_D9 || ARCH_CHIP_G9 || ARCH_CHIP_X9 || ARCH_ARM64
rsource "kunlun/Kconfig"
endif

if ARCH_CHIP_X9
rsource "taihang/Kconfig"
endif

menuconfig BMS
    bool "bms"
    default n

if BMS
orsource "bms/Kconfig"
endif # BMS
```

## myproject/ssdk/examples/bms/Functions/OSUser/Kconfig
```kconfig
config TASK_MONITOR
    bool "Task Monitor (Debug Only)"
    default n
    help
      Enable periodic task monitoring thread that prints
      all task stats (CPU%, runtime, stack, state, timeouts)
      to serial console every N seconds.

config TASKMONITOR_PERIOD_MS
    int "Monitor print interval (ms)"
    default 60000
    range 1000 60000
    depends on TASK_MONITOR

config TASKMONITOR_THREAD_STACK_SIZE
    int "Monitor thread stack size (bytes)"
    default 2048
    depends on TASK_MONITOR

config TASKMONITOR_THREAD_PRIORITY
    int "Monitor thread priority"
    default 28
    range 0 31
    depends on TASK_MONITOR
```
