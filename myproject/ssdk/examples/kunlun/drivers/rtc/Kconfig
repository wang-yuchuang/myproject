## myproject/ssdk/examples/kunlun/gateway/Kconfig
```kconfig
comment "Driver and Application Example Options"

menuconfig SDPE_CTRL
    bool "SDPE Control Example"
    default n
    ---help---
        Enable SDPE controller functions, such as start/stop routing,
        and gateway event monitors.

if SDPE_CTRL
rsource "sdpe_ctrl/Kconfig"
endif # sdpe_ctrl

menuconfig SDPE_MGR
    bool "SDPE Manager Support"
    select SDPE_CTRL
    select SDPE_RPC
    select SDPE_RPC_MBOX_TRANSPORT
    select VLIN
    select VCAN
    depends on DW_I2C
    depends on TCA9539
    default n

if SDPE_MGR
rsource "sdpe_mgr/Kconfig"
endif # SDPE_MGR

menuconfig SIG_ROUTE
    bool "Sig route Support"
    select SDPE_MGR
    default n

if SIG_ROUTE
rsource "sig_route/Kconfig"
endif # SIG_ROUTE

menuconfig LIN_SCHED
    bool "LIN Scheduler Support"
    select SIG_ROUTE
    default n

if LIN_SCHED
rsource "lin_sched/Kconfig"
endif # LIN_SCHED
```

## myproject/ssdk/examples/kunlun/gateway/sdpe_mgr/Kconfig
```kconfig
comment "SDPE Manager Options"

config ROUTE_TABLE_MEMBASE
    hex "SDPE route table memory base"
    default 0x1E7000

config ROUTE_TABLE_MEMSIZE
    hex "SDPE route table memory size"
    default 0x10000
```

## myproject/ssdk/examples/kunlun/gateway/sig_route/Kconfig
```kconfig
comment "Sig route Options"

config TX_THREAD_PERIOD
    int "Transmit thread period, Unit ms"
    default 10
```

## myproject/ssdk/examples/taihang/Kconfig
```kconfig
comment "Taihang Driver and Application Example Options"

menuconfig APPLICATION
    bool "applications"
    default n

if APPLICATION
rsource "application/Kconfig"
endif # APPLICATION

menuconfig DRIVERS_EXAMPLE
    bool "Taihang Driver Example Support"
    default n

if DRIVERS_EXAMPLE
rsource "drivers/Kconfig"
endif # DRIVERS_EXAMPLE
```

## myproject/ssdk/examples/taihang/application/Kconfig
```kconfig
comment "Application Options"

menuconfig SLT_TEST_DEMO
    bool "slt test demo"
    default n
```

## myproject/ssdk/examples/taihang/drivers/Kconfig
```kconfig
comment "Taihang Driver Example Options"

config SDRV_LIN_DEMO
    bool "Taihang SemiDrive Lin example"
    select SDRV_LIN
    default n

if SDRV_LIN_DEMO
rsource "sdrv_lin/Kconfig"
endif # SDRV_LIN_DEMO

config SDRV_UART_DEMO
    bool "Taihang SemiDrive Uart example"
    select SDRV_UART
    default n

if SDRV_UART_DEMO
rsource "sdrv_uart/Kconfig"
endif # SDRV_UART_DEMO
```

## myproject/ssdk/examples/taihang/drivers/sdrv_lin/Kconfig
```kconfig
comment "LIN Example Application Options"

config SDRV_LIN_UART_DEMO
    bool "Taihang Semidrive Lin Example"
    select LIN
    select SDRV_LIN
    select SDRV_UART
    default n
```

## myproject/ssdk/examples/taihang/drivers/sdrv_uart/Kconfig
```kconfig
comment "UART Example Application Options"

config SDRV_UART_LIN_DEMO
    bool "Taihang Semidrive Uart example"
    select UART
    select SDRV_UART
    default n
```

## myproject/ssdk/examples/taishan/Kconfig
```kconfig
comment "E3 Driver and Application Example Options"

menuconfig DRIVERS_EXAMPLE
    bool "Driver Example Support"
    default n

if DRIVERS_EXAMPLE
rsource "drivers/Kconfig"
endif # DRIVERS_EXAMPLE

menuconfig GUI_APPLICATION
    bool "Gui Application Support"
    default n

if GUI_APPLICATION
rsource "application/Kconfig"
endif # GUI_APPLICATION

menuconfig BOOT_EXAMPLE
    bool "Boot Example Support"
    default n

if BOOT_EXAMPLE
rsource "boot/Kconfig"
endif # BOOT_EXAMPLE

menuconfig UTIL_EXAMPLE
    bool "Example Utilities"
    default n

if UTIL_EXAMPLE
rsource "util/Kconfig"
endif # UTIL_EXAMPLE

menuconfig OTA_EXAMPLE
    bool "OTA example application"
    select PARTITION
    select DISK
    select SD_BOOT_IMG
    select FATFS
    select MD5
    select REBOOT
    select TAISHAN_REBOOT_GLOBAL
    default n

if OTA_EXAMPLE
rsource "ota/Kconfig"
endif # OTA_EXAMPLE

menuconfig MOTOR_EXAMPLE
    bool "Motor example application"
    default n

if MOTOR_EXAMPLE
rsource "motor/Kconfig"
endif # MOTOR_EXAMPLE
```

## myproject/ssdk/examples/taishan/application/Kconfig
```kconfig
comment "Application Options"

menuconfig APP_EMIRROR
    bool "e-mirror application"
    select GUI_LVGL
    default n

if APP_EMIRROR
rsource "emirror/Kconfig"
endif # APP_EMIRROR

menuconfig APP_CLUSTER
    bool "cluster application"
    select GUI_LVGL
    default n

if APP_CLUSTER
rsource "cluster/Kconfig"
endif # APP_CLUSTER

menuconfig APP_CONTROLPANEL
    bool "control panel application"
    select GUI_LVGL
    default n

if APP_CONTROLPANEL
rsource "controlpanel/Kconfig"
endif # APP_CONTROLPANEL

menuconfig APP_QT_CLUSTER
    bool "qt cluster application"
    default n

if APP_QT_CLUSTER
rsource "qt_app/Kconfig"
endif # APP_QT_CLUSTER

menuconfig APP_MJPEG_DEC
    bool "mjpeg dec application"
    select MJPEG
    default n

if APP_MJPEG_DEC
rsource "mjpeg_dec/Kconfig"
endif # APP_MJPEG_DEC

menuconfig APP_MP3_DEC
    bool "mp3 dec application"
    depends on CODEC
    depends on SND
    depends on DMA
    select MP3_DEC
    default n

menuconfig APP_BOOTANIMATION
    bool "boot animation application"
    select MJPEG
    default n

if APP_BOOTANIMATION
rsource "bootanimation/Kconfig"
endif # APP_BOOTANIMATION

menuconfig APP_LAUNCHER
    bool "launcher application"
    default n

if APP_LAUNCHER
rsource "launcher/Kconfig"
endif # APP_LAUNCHER

menuconfig APP_CAM_PRE
    bool "camera preview support"
    default n
```
