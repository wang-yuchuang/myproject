## myproject/ssdk/drivers/kunlun/scr/Kconfig
```kconfig
menuconfig KUNLUN_SCR
    bool "Kunlun SCR Driver Support"
    select SCR
    default n

if KUNLUN_SCR

config SCR_FUSA
    bool "SCR Function Safety"
    default n

endif # KUNLUN_SCR
```

## myproject/ssdk/drivers/kunlun/sem/Kconfig
```kconfig
menuconfig KUNLUN_SEM
	bool "Kunlun SEM Driver"
	select SEM
	default n

if KUNLUN_SEM
	comment "kunlun sem driver config option"
endif
```

## myproject/ssdk/drivers/kunlun/serdes/Kconfig
```kconfig
menuconfig  SERDES_KUNLUN_PLATFORM
    bool "serdes Driver Options"
    select SERDES
    select I2C
    default n


if SERDES_KUNLUN_PLATFORM
config SERDES_TI9XX
    bool "serdes ti9xx Driver"
    select SERDES
    default n

config SERDES_MAX967XX
    bool "serdes max967xx Driver"
    select SERDES
    default n
endif
```

## myproject/ssdk/drivers/kunlun/snd/Kconfig
```kconfig
menuconfig KUNLUN_SND
    bool "Kunlun Sound Driver Support"
    select SND
    default n

if KUNLUN_SND

config SDRV_I2S_MC
    bool "SDRV I2S MC Driver"
    default n

config SDRV_SPDIF
    bool "SDRV SPDIF Driver"
    default n

config CDNS_I2S_SC
    bool "CDNS I2S SC Driver"
    default n

config CODEC
    select SND
    bool "CODEC Driver"
    default n

config CODEC_AK4619
    bool "Codec Ak4619 Driver"
    default n
    depends on CODEC

config CODEC_TLV320
    bool "Codec Tlv320 Driver"
    default n
    depends on CODEC

endif # KUNLUN_SND
```

## myproject/ssdk/drivers/kunlun/spi/Kconfig
```kconfig
config DW_SPI
    bool "DesignWare SPI Driver Support"
    select SPI
    default n
```

## myproject/ssdk/drivers/kunlun/spi_nor/Kconfig
```kconfig
menuconfig CDNS_OSPI
    bool "CDNS OSPI Driver Support"
    select OSPI
    default n

if CDNS_OSPI

config CDNS_OSPI_WR_DIRECT_EN
    bool "CDNS OSPI direct write enable"
    default n

endif # CDNS_OSPI
```

## myproject/ssdk/drivers/kunlun/syscnt/Kconfig
```kconfig
config SDRV_SYSCNT
    bool "Kunlun Syscnt Driver Support"
    select TIMER
    default n
```

## myproject/ssdk/drivers/kunlun/timestamp/Kconfig
```kconfig
config SUPPORT_LOG_TIMESTAMP
    bool "semidrive log timestamp support"
    default n
```

## myproject/ssdk/drivers/kunlun/tmr/Kconfig
```kconfig
config SDRV_TMR
    bool "Kunlun TMR Driver Support"
    select TIMER
    default n
```

## myproject/ssdk/drivers/kunlun/touch/Kconfig
```kconfig
menuconfig TOUCH_KUNLUN_PLATFORM
    bool "Touch Driver for kunlun"
    select TOUCH
    select I2C
    select GPIO
    default n

if TOUCH_KUNLUN_PLATFORM
    comment "kunlun touch option"
    menuconfig TOUCH_KUNLUN_GOODIX
        bool "goodix Touch Driver for kunlun"
        default n
    if TOUCH_KUNLUN_GOODIX
        config TOUCH_I2C_POLLING
            bool "touch i2c rw polling"
            default n

        config TOUCH_LINK_WITH_SERDES
            bool "touch sensor is link with serdes"
            default n
            select SERDES
    endif

    menuconfig TOUCH_KUNLUN_CYTTSP6
        bool "cyttsp6 Touch Driver for kunlun"
        default n

    if TOUCH_KUNLUN_CYTTSP6
        config WDT_MONITOR_PERIOD
        int "watchdog monitor period time, unit is ms"
        default 3000

        config CYTTSP_DRIVER_STACK_SIZE
        int "cyttsp driver task stack size"
        default 4096

    endif
endif
```

## myproject/ssdk/drivers/kunlun/uart/Kconfig
```kconfig
config DW_UART
    bool "DesignWare Uart Driver Support"
    select UART
    default n
```

## myproject/ssdk/drivers/kunlun/virt_uart/Kconfig
```kconfig
config SDRV_VIRT_UART
    bool "semidrive virtual serial port support"
    default n
```

## myproject/ssdk/drivers/kunlun/vpu/Kconfig
```kconfig
menuconfig SDRV_KUNLUN_VPU
    bool "kunlun VPU Driver"
    select VPU
    default n

if SDRV_KUNLUN_VPU
    comment "kunlun vpu driver config option"

    menuconfig VMEM_PAGE_SIZE
        hex "vmemory page size"
        default 0x100000
endif
```

## myproject/ssdk/drivers/kunlun/watchdog/Kconfig
```kconfig
config SDRV_WDOG_KUNLUN
    bool "Kunlun WDOG Driver Support"
    select WDOG
    default n
```

## myproject/ssdk/drivers/taihang/Kconfig
```kconfig
rsource "spi_nor/Kconfig"
rsource "sdrv_lin/Kconfig"
rsource "sdrv_uart/Kconfig"
```

## myproject/ssdk/drivers/taihang/sdrv_lin/Kconfig
```kconfig
config SDRV_LIN
    bool "Taihang semidrive Lin driver Support"
    select LIN
    select SDRV_UART
    default n
```

## myproject/ssdk/drivers/taihang/sdrv_uart/Kconfig
```kconfig
config SDRV_UART
    bool "Taihang semidrive uart driver Support"
    select UART
    default n
```

## myproject/ssdk/drivers/taihang/spi_nor/Kconfig
```kconfig
menuconfig TAIHANG_XSPI
    bool "TAIHANG XSPI Driver Support"
    select XSPI
    default n

if TAIHANG_XSPI

config XSPI_Z1_TEST
    bool "XSPI Z1 TEST"
    default n

endif # TAIHANG_XSPI
```

## myproject/ssdk/drivers/taishan/Kconfig
```kconfig
rsource "adc/Kconfig"
rsource "asw/Kconfig"
rsource "acmp/Kconfig"
rsource "btm/Kconfig"
rsource "can/Kconfig"
rsource "clk/Kconfig"
rsource "csi/Kconfig"
rsource "crypto/osr_crypto/Kconfig"
rsource "dma/Kconfig"
rsource "dispss/Kconfig"
rsource "eic/Kconfig"
rsource "epwm/Kconfig"
rsource "eth/Kconfig"
rsource "etimer/Kconfig"
rsource "fuse/Kconfig"
rsource "gpio/Kconfig"
rsource "g2dlite/Kconfig"
rsource "hwmutex/Kconfig"
rsource "irda/Kconfig"
rsource "i2c/Kconfig"
rsource "lin/Kconfig"
rsource "mbox/Kconfig"
rsource "mmc/Kconfig"
rsource "pinctrl/Kconfig"
rsource "pmu/Kconfig"
rsource "power/Kconfig"
rsource "reset/Kconfig"
rsource "rtc/Kconfig"
rsource "scr/Kconfig"
rsource "sdramc/Kconfig"
rsource "sem/Kconfig"
rsource "sent/Kconfig"
rsource "sensor/Kconfig"
rsource "smc/Kconfig"
rsource "snd/Kconfig"
rsource "spi/Kconfig"
rsource "spi_nor/Kconfig"
rsource "tmonitor/Kconfig"
rsource "touch/Kconfig"
rsource "uart/Kconfig"
rsource "vic/Kconfig"
rsource "watchdog/Kconfig"
rsource "xtrg/Kconfig"
rsource "xspi_mst_slv/Kconfig"
```

## myproject/ssdk/drivers/taishan/acmp/Kconfig
```kconfig
config SDRV_ACMP
    bool "Taishan ACMP Driver Support"
    depends on TAISHAN_ADC
    default n
    ---help---
    The Analog Comparator (ACMP) controller is a built-in analog compare
    module with multiple analog input channels and external analog mux
    control. The ACMP supports continuous, windowed, sampled and filtered
    compare modes.
```

## myproject/ssdk/drivers/taishan/adc/Kconfig
```kconfig
config TAISHAN_ADC
    bool "Taishan ADC Driver Support"
    select ADC
    default n
```

## myproject/ssdk/drivers/taishan/asw/Kconfig
```kconfig
config ASW
    bool "Taishan ASW Driver Support"
    select G2DLITE
    default n
    ---help---
    Enable Any Shape Warp (ASW) hardware controller, which performs image
    de-warping in between system memory, camera and display controllers.
```

## myproject/ssdk/drivers/taishan/btm/Kconfig
```kconfig
config SDRV_BTM
    bool "Taishan BTM Driver Support"
    select TIMER
    default n
```
