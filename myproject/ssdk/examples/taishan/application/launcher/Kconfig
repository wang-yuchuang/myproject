## myproject/ssdk/examples/taishan/application/mjpeg_dec/Kconfig
```kconfig
comment "Mjpeg Test Options"

config MJPEG_LOAD_METHOD
    int "Specifies the test mjpeg load method"
    default 0
    ---help---
        Specifies mjpeg load method.
            0: from file system
            1: from data array
```

## myproject/ssdk/examples/taishan/boot/Kconfig
```kconfig
comment "Boot Example Options"

menuconfig BOOT_CORE_EXAMPLE
    bool "Taishan Core Boot Example Support"
    default n

if BOOT_CORE_EXAMPLE
rsource "boot_core/Kconfig"
endif # BOOT_CORE_EXAMPLE

menuconfig GLOBAL_REBOOT_EXAMPLE
    bool "Taishan Global Reboot Example Support"
    default n

if GLOBAL_REBOOT_EXAMPLE
rsource "global_reboot/Kconfig"
endif # GLOBAL_REBOOT_EXAMPLE

menuconfig LOAD_IMAGE_EXAMPLE
    bool "Taishan Image Load Example Support"
    select PARTITION
    select DISK
    default n

if LOAD_IMAGE_EXAMPLE
rsource "load_image/Kconfig"
endif # LOAD_IMAGE_EXAMPLE
```

## myproject/ssdk/examples/taishan/drivers/Kconfig
```kconfig
comment "Driver Example Options"

config USB_DEMO
    bool "USB Example Application Support"
    default n
    help
      USB example applications. Corresponding class drivers shall be enabled as well.

if USB_DEMO
rsource "usb/Kconfig"
endif # USB_DEMO

config UART_DEMO
    bool "UART Example Application Support"
    depends on CLI
    default n

if UART_DEMO
rsource "uart/Kconfig"
endif # UART_DEMO

config SPI_DEMO
    bool "SPI Example Application Support"
    default n

if SPI_DEMO
rsource "spi/Kconfig"
endif # SPI_DEMO

config SENT_DEMO
    bool "SENT Example Application Support"
    depends on CLI
    default n

if SENT_DEMO
rsource "sent/Kconfig"
endif # SENT_DEMO

config LIN_DEMO
    bool "LIN Example Application Support"
    depends on CLI
    default n

if LIN_DEMO
rsource "lin/Kconfig"
endif # LIN_DEMO

config ADC_DEMO
    bool "ADC Example Application Support"
    default n

if ADC_DEMO
rsource "adc/Kconfig"
endif # ADC_DEMO

menuconfig MBOX_DEMO
    bool "MBOX Example Application Support"
    select MBOX
    default n

if MBOX_DEMO
rsource "mbox/Kconfig"
endif # MBOX_DEMO

menuconfig RPMSG_DEMO
    bool "RPMSG Example Application Support"
    select RPMSG
    select RPMSG_SERVICE
    default n

if RPMSG_DEMO
rsource "rpmsg/Kconfig"
endif # RPMSG_DEMO

menuconfig DMA_DEMO
    bool "DMA Example Application Support"
    depends on DMA
    default n
    help
      DMA example applications. Corresponding class drivers shall be enabled as well.

if DMA_DEMO
rsource "dma/Kconfig"
endif # DMA_DEMO

config CANFD_DEMO
    bool "CANFD Example Application Support"
    depends on CLI
    default n

if CANFD_DEMO
rsource "canfd/Kconfig"
endif #CANFD_DEMO

config LED_DEMO
    bool "LED Example Application Support"
    depends on CLI
    default n

config ANALOG_IN_DEMO
    bool "ANALOG_IN Example Application Support"
    depends on CLI
    default n

config ANALOG_OUT_DEMO
    bool "ANALOG_OUT Example Application Support"
    depends on CLI
    default n

config FUSE_UTILITY
    bool "eFuse tool"
    depends on CLI
    default n
    help
      eFuse utility. Fuse driver shall be enabled as well.

config HSD_DEMO
    bool "HSD Example Application Support"
    depends on CLI
    default n

if HSD_DEMO
rsource "hsd/Kconfig"
endif #HSD_DEMO

config ACMP_DEMO
    bool "ACMP Example Application Support"
    depends on SDRV_ACMP
    default n

config LSD_DEMO
    bool "LSD Example Application Support"
    depends on CLI
    default n

config SBC
    bool "SBC TLE9461-3ES for E3 gateway examples"
    depends on CLI
    default n

if LSD_DEMO
rsource "lsd/Kconfig"
endif #LSD_DEMO

config PMU_DEMO
    bool "PMU Example Application Support"
    default n

if PMU_DEMO
rsource "pmu/Kconfig"
endif #PMU_DEMO

config WDOG_DEMO
    bool "Watchdog Example Application Support"
    depends on CLI
    default n

config TIMER_DEMO
    bool "Timer Example Support"
    default n

if TIMER_DEMO
rsource "timer/Kconfig"
endif #TIMER_DEMO

menuconfig DISK_DEMO
    bool "DISK Example Support"
    default n

if DISK_DEMO
rsource "disk/Kconfig"
endif # DISK_DEMO

menuconfig FEE_DEMO
    bool "FEE Example Support"
    depends on (CDNS_OSPI || TAISHAN_XSPI) && DISK_NOR_FLASH
    default y

if FEE_DEMO
rsource "fee/Kconfig"
endif # FEE_DEMO

config PINCTRL_DEMO
    bool "Pinctrl Example Support"
    default n

if PINCTRL_DEMO
rsource "pinctrl/Kconfig"
endif #PINCTRL_DEMO

config CPUFREQ_DEMO
    bool "Cpufreq Example Support"
    depends on CPU_FREQ
    default n

if CPUFREQ_DEMO
rsource "cpufreq/Kconfig"
endif #CPUFREQ_DEMO

config I2C_DEMO
    bool "I2C Example Support"
    default n

if I2C_DEMO
rsource "i2c/Kconfig"
endif #I2C_DEMO

config ETH_DEMO
    bool "Eth Example Support"
    depends on ETH
    default n

if ETH_DEMO
rsource "eth/Kconfig"
endif #ETH_DEMO

config POWER_DEMO
    bool "Power Example Support"
    depends on PM
    default n

if POWER_DEMO
rsource "power/Kconfig"
endif #POWER_DEMO

config PWM_DEMO
    bool "PWM Example Support"
    default n

if PWM_DEMO
rsource "pwm/Kconfig"
endif #PWM_DEMO

config RTC_DEMO
    bool "RTC Example Support"
    default n

if RTC_DEMO
rsource "rtc/Kconfig"
endif #RTC_DEMO
```

## myproject/ssdk/examples/taishan/drivers/acmp/Kconfig
```kconfig
comment "ADC Example Application Options"

config TAISHAN_ACMP_DEMO
    bool "Taishan ACMP Example Application"
    select SCR
    select ACMP
    select SDRV_ACMP
    default n
```

## myproject/ssdk/examples/taishan/drivers/adc/Kconfig
```kconfig
comment "ADC Example Application Options"

config KUNLUN_ADC_DEMO
    bool "Kunlun ADC Example Application"
    default n
	depends on KUNLUN_ADC

config TAISHAN_ADC_DEMO
    bool "Taishan ADC Example Application"
    select SCR
    default n
	depends on TAISHAN_ADC
```

## myproject/ssdk/examples/taishan/drivers/canfd/Kconfig
```kconfig
comment "CANFD DEMO For Gateway"

config CANFD_BOARD_TEST
    bool "Add Board Test For CANFD"
    default n
```

## myproject/ssdk/examples/taishan/drivers/disk/Kconfig
```kconfig
comment "DISK Demo Options"

config DISK_RAM_DEMO
    bool "block device disk ram demo"
    default n

config DISK_MMC_DEMO
    bool "block device disk mmc demo"
    default n

config DISK_NOR_FLASH_DEMO
    bool "block device disk nor flash demo"
    default n

config DISK_USB_DEMO
    bool "block device disk usb demo"
    default n
```

## myproject/ssdk/examples/taishan/drivers/fee/Kconfig
```kconfig
comment "FEE Demo Options"

config FEE_BLOCK_DEMO
    bool "FEE demo access base on block"
    default n

config FEE_EEPROM_DEMO
    bool "FEE demo access base on eepromc addr"
    default y
```

## myproject/ssdk/examples/taishan/drivers/i2c/Kconfig
```kconfig
comment "I2C Example Application Options"

config TAISHAN_I2C_DEMO
    bool "Taishan i2c example"
    depends on I2C
    depends on SDRV_I2C
    default n
```

## myproject/ssdk/examples/taishan/drivers/lin/Kconfig
```kconfig
comment "LIN Example Application Options"

config SDRV_LIN_DEMO
    bool "Taishan LIN Demo"
    select LIN
    select SDRV_LIN
    default n
```

## myproject/ssdk/examples/taishan/drivers/mbox/Kconfig
```kconfig
comment "MBOX Demo Options"

config TAISHAN_MBOX_DEMO
    bool "Taishan mbox demo"
    select TAISHAN_MBOX
    depends on CLI
    default n

config BAREMETAL_MBOX_DEMO
    bool "baremetal mbox demo"
    select TAISHAN_MBOX
    default n
```

## myproject/ssdk/examples/taishan/drivers/pmu/Kconfig
```kconfig
comment "Taishan PMU Demo Options"

config TAISHAN_PMU_DEMO
    bool "Taishan pmu demo"
    select PMU
    select SDRV_PMU
    default n
```

## myproject/ssdk/examples/taishan/drivers/pwm/Kconfig
```kconfig
comment "PWM Example Application Options"

config SDRV_PWM_DEMO
    bool "Taishan PWM Demo"
    default n
```
