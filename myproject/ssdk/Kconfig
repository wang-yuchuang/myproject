## myproject/ssdk/boards/d3_disp/sf/Kconfig
```kconfig
comment "D3 SF Core Options"

config MEM_BASE
    hex "Memory Start Address"
    default 0x404000

config MEM_SIZE
    hex "Memory Size"
    range 0 IRAM_LIMIT
    default 0x3FC000

config IRAM_NONE_ECC_BASE
    hex "IRAM NONE-ECC Base Address"
    default 0x800000

config IRAM_NONE_ECC_SIZE
    hex "IRAM NONE-ECC Size"
    default 0x80000

config EARLYCOPY
    bool "Early Copy sections from LMA to VMA"
    default y

config WORK_ON_Z1
    bool "Work on Z1"
    default n

config CLOCK_OVER_DRIVE_MODE
    bool "Clock over drive mode"
    default n

config HEAP_ON_SDRAM
    bool "Heap on SDRAM"
    depends on SDRV_SDRAMC
    default n

config BOARD_DEBUG
    bool "Enable CR5 debug"
    select CORE_DEBUG
    select TAISHAN_CORE_DEBUG
    default n

config FIX_LDO_1V8
    bool "Fix internal 1.8V LDO output"
    default y

config BOARD_REMAP
    bool "Do Remap When Early Init"
    select RESETGEN
    default n
```

## myproject/ssdk/boards/d3_disp/sf/projects/cluster/defconfig
```kconfig
CONFIG_ARCH_EARLY_ENABLE_ICACHE=y
CONFIG_ARCH_EARLY_ENABLE_DCACHE=y
CONFIG_ARCH_USE_FPU=y
CONFIG_ARCH_USE_MPU=y
CONFIG_ARCH_CHIP_D3=y
CONFIG_ARM_WITH_PMU=y
CONFIG_ARMV7R_TCMA_BASE=0x1910000
CONFIG_ARMV7R_TCMB_BASE=0x1900000
CONFIG_MAIN_THREAD_PRIORITY=2
CONFIG_AUTO_SIGN_BOARD_IMG=y
CONFIG_HEAP_ON_SDRAM=y
CONFIG_IDLE_TASK_STACK_SIZE=2048
CONFIG_USE_TICKLESS_IDLE=y
CONFIG_TAISHAN_ADC=y
CONFIG_SDRV_ACMP=y
CONFIG_SDRV_BTM=y
CONFIG_FLEXCAN=y
CONFIG_SDRV_FLEXCAN_ENH=y
CONFIG_TAISHAN_CKGEN=y
CONFIG_CLK_MONITOR=y
CONFIG_CSI=y
CONFIG_CSI_IOMUX=y
CONFIG_MAX96706=y
CONFIG_OSR_CRYPTO=y
CONFIG_OSR_CRYPTO_DRIVER=y
CONFIG_OSR_CRYPTO_DRIVER_MAILBOX=y
CONFIG_LVDS_1440X540_LCD=y
CONFIG_SDRV_EPWM=y
CONFIG_SDRV_ETIMER=y
CONFIG_SDRV_ETIMER_PWM=y
CONFIG_TAISHAN_FUSE=y
CONFIG_TAISHAN_HWMUTEX=y
CONFIG_SDRV_I2C=y
CONFIG_SEHC=y
CONFIG_TAISHAN_PINCTRL=y
CONFIG_TAISHAN_PM=y
CONFIG_DEBUG_TAISHAN_PM=y
CONFIG_TRACE_TAISHAN_PM=y
CONFIG_SDRV_SDRAMC=y
CONFIG_SEM=y
CONFIG_SENSOR=y
CONFIG_TAISHAN_TEMPERATURE_SENSOR=y
CONFIG_SDRV_SMC=y
CONFIG_TAISHAN_SND=y
CONFIG_SACI_I2S=y
CONFIG_SACI_SLAVE=y
CONFIG_SACI_PDM=y
CONFIG_CODEC=y
CONFIG_CODEC_AK4619=y
CONFIG_SD_SPI=y
CONFIG_TAISHAN_XSPI=y
CONFIG_TOUCH_GOODIX=y
CONFIG_SDRV_UART=y
CONFIG_SDRV_VIC=y
CONFIG_SDRV_WDOG_TAISHAN=y
CONFIG_XTRG=y
CONFIG_DISK_MMC=y
CONFIG_DISK_NOR_FLASH=y
CONFIG_MEM_RW=y
CONFIG_DHRYSTONE=y
CONFIG_COREMARK=y
CONFIG_LVGL_SDRV_DISPLAY=y
CONFIG_LVGL_SDRV_DECODER_PNG=y
CONFIG_LVGL_SDRV_FAT_FS=y
CONFIG_LVGL_SDRV_GPU=y
CONFIG_LVGL_SDRV_INPUT=y
CONFIG_FLOPS=y
CONFIG_USB=y
CONFIG_USB_DEVICE=y
CONFIG_USB_DEVICE_CDC_ACM=y
CONFIG_USB_HOST=y
CONFIG_USB_HOST_HID=y
CONFIG_USB_HOST_MSC=y
CONFIG_DRIVERS_EXAMPLE=y
CONFIG_USB_DEMO=y
CONFIG_USBD_DEMO_CDC_ACM=y
CONFIG_ADC_DEMO=y
CONFIG_TAISHAN_ADC_DEMO=y
CONFIG_DMA_DEMO=y
# CONFIG_DMA_UART_PREPARED is not set
CONFIG_CANFD_DEMO=y
CONFIG_LED_DEMO=y
CONFIG_ANALOG_IN_DEMO=y
CONFIG_ACMP_DEMO=y
CONFIG_PMU_DEMO=y
CONFIG_TAISHAN_PMU_DEMO=y
CONFIG_WDOG_DEMO=y
CONFIG_GUI_APPLICATION=y
CONFIG_APP_CLUSTER=y
CONFIG_APP_MJPEG_DEC=y
CONFIG_APP_MP3_DEC=y
CONFIG_APP_BOOTANIMATION=y
CONFIG_APP_LAUNCHER=y
CONFIG_BOOT_EXAMPLE=y
CONFIG_GLOBAL_REBOOT_EXAMPLE=y
CONFIG_UTIL_EXAMPLE=y
CONFIG_POWER_MONITOR=y
CONFIG_POWER_CLOCK_GATE=y
CONFIG_POWER_GATE_EXAMPLE_D3=y
CONFIG_CLOCK_GATE_EXAMPLE_D3=y
CONFIG_PVT_EXAMPLE=y
CONFIG_TAISHAN_TEMPERATURE_EXAMPLE=y
CONFIG_OTA_EXAMPLE=y
CONFIG_OTA_FROM_ETH_TFTP=y
```

## myproject/ssdk/boards/d3_disp/sf/projects/cluster_88/defconfig
```kconfig
CONFIG_ARCH_EARLY_ENABLE_ICACHE=y
CONFIG_ARCH_EARLY_ENABLE_DCACHE=y
CONFIG_ARCH_USE_FPU=y
CONFIG_ARCH_USE_MPU=y
CONFIG_ARCH_CHIP_D3=y
CONFIG_ARM_WITH_PMU=y
CONFIG_ARMV7R_TCMA_BASE=0x1910000
CONFIG_ARMV7R_TCMB_BASE=0x1900000
CONFIG_MAIN_THREAD_PRIORITY=2
CONFIG_HEAP_ON_SDRAM=y
CONFIG_BOARD_DEBUG=y
CONFIG_SDRV_BTM=y
CONFIG_TAISHAN_CKGEN=y
CONFIG_LVDS_LT9211_TO_MIPI_480x1920_LCD=y
CONFIG_TAISHAN_HWMUTEX=y
CONFIG_SDRV_I2C=y
CONFIG_SEHC=y
CONFIG_TAISHAN_PINCTRL=y
CONFIG_TAISHAN_RESETGEN=y
CONFIG_SDRV_SDRAMC=y
CONFIG_TAISHAN_XSPI=y
CONFIG_SDRV_UART=y
CONFIG_SDRV_VIC=y
CONFIG_DISK_RAM=y
CONFIG_DISK_MMC=y
CONFIG_DISK_NOR_FLASH=y
CONFIG_MEM_RW=y
CONFIG_LVGL_SDRV_DISPLAY=y
CONFIG_LVGL_SDRV_DECODER_PNG=y
CONFIG_LVGL_SDRV_FAT_FS=y
CONFIG_LVGL_SDRV_GPU=y
CONFIG_GUI_APPLICATION=y
CONFIG_APP_CLUSTER=y
CONFIG_APP_BOOTANIMATION=y
CONFIG_APP_LAUNCHER=y
CONFIG_OTA_EXAMPLE=y
CONFIG_OTA_FROM_ETH_TFTP=y
```

## myproject/ssdk/boards/d3_disp/sf/projects/dloader/defconfig
```kconfig
CONFIG_ARCH_EARLY_ENABLE_ICACHE=y
CONFIG_ARCH_EARLY_ENABLE_DCACHE=y
CONFIG_ARCH_USE_FPU=y
CONFIG_ARCH_USE_MPU=y
CONFIG_ARCH_CHIP_D3=y
CONFIG_ARM_WITH_PMU=y
CONFIG_ARMV7R_TCMA_BASE=0x1910000
CONFIG_ARMV7R_TCMB_BASE=0x1900000
CONFIG_MAIN_THREAD_PRIORITY=2
CONFIG_SDRV_BTM=y
CONFIG_TAISHAN_CKGEN=y
CONFIG_TAISHAN_HWMUTEX=y
CONFIG_SEHC=y
CONFIG_TAISHAN_PINCTRL=y
CONFIG_TAISHAN_RESETGEN=y
CONFIG_TAISHAN_SCR=y
CONFIG_SDRV_SDRAMC=y
CONFIG_TAISHAN_XSPI=y
CONFIG_SDRV_UART=y
CONFIG_SDRV_VIC=y
CONFIG_DISK_MMC=y
CONFIG_DISK_NOR_FLASH=y
CONFIG_MEM_RW=y
CONFIG_DLOADER_TESTER=y
CONFIG_BOOT_CORE_EXAMPLE=y
CONFIG_LOAD_IMAGE_EXAMPLE=y
```

## myproject/ssdk/boards/d3_disp/sf/projects/flashloader/defconfig
```kconfig
CONFIG_ARCH_EARLY_ENABLE_ICACHE=y
CONFIG_ARCH_EARLY_ENABLE_DCACHE=y
CONFIG_ARCH_USE_FPU=y
CONFIG_ARCH_ABT_STACK_SIZE=4
CONFIG_ARCH_IRQ_STACK_SIZE=4
CONFIG_ARCH_FIQ_STACK_SIZE=4
CONFIG_ARCH_SYS_STACK_SIZE=4
CONFIG_ARCH_UND_STACK_SIZE=4
CONFIG_ARCH_SVC_STACK_SIZE=4
CONFIG_ARM_WITH_PMU=y
CONFIG_ARMV7R_TCMA_BASE=0x1910000
CONFIG_ARMV7R_TCMB_BASE=0x1900000
CONFIG_MAIN_THREAD_PRIORITY=2
CONFIG_BOARD_LOOPSPERUSEC=30
CONFIG_MEM_BASE=0x400000
CONFIG_MEM_SIZE=0x40000
# CONFIG_EARLYCOPY is not set
# CONFIG_FIX_LDO_1V8 is not set
CONFIG_OS_BAREMETAL=y
CONFIG_BAREMETAL_WORK_IN_IRQ=y
CONFIG_CLK=y
CONFIG_TAISHAN_CKGEN=y
CONFIG_PINCTRL=y
CONFIG_TAISHAN_PINCTRL=y
CONFIG_RESETGEN=y
CONFIG_TAISHAN_RESETGEN=y
CONFIG_SCR=y
CONFIG_TAISHAN_SCR=y
CONFIG_TAISHAN_XSPI=y
CONFIG_UART=y
CONFIG_SDRV_UART=y
CONFIG_DEBUG_LEVEL=3
CONFIG_FLASH_LOADER=y
CONFIG_BPT_UPDATE=y
```
