## myproject/ssdk/boards/x9cc_ms_a/mp/projects/ms-vmmc/defconfig
```kconfig
CONFIG_ARCH_EARLY_ENABLE_ICACHE=y
CONFIG_ARCH_EARLY_ENABLE_DCACHE=y
CONFIG_ARCH_USE_FPU=y
CONFIG_ARCH_USE_MPU=y
CONFIG_ARCH_FIQ_STACK_SIZE=256
CONFIG_ARCH_SVC_STACK_SIZE=2048
CONFIG_ARM_WITH_PMU=y
CONFIG_ARMV7R_TCMA_BASE=0x22C0000
CONFIG_ARMV7R_TCMB_BASE=0x22B0000
CONFIG_ARCH_CHIP_X9_THANG=y
CONFIG_ARCH_CHIP_X9=y
CONFIG_MAIN_THREAD_PRIORITY=2
CONFIG_MP=y
CONFIG_MEM_BASE=0x7EE00000
CONFIG_MEM_SIZE=0x8000000
CONFIG_BOARD_REMAP=y
CONFIG_DISPSS=y
CONFIG_AUDIO_BOARD=y
CONFIG_KUNLUN_CKGEN=y
CONFIG_SILEX_CRYPTO_CPUID=2
CONFIG_DESER=y
CONFIG_dvp_max96706_fengjing_MC163_MAX96705=y
CONFIG_mipi_max96722_fengjing_MC163_MAX96705=y
CONFIG_mipi_max96722_sengyun_IMX390C_5200_MAX9295=y
CONFIG_DISPSS_TAIHANG=y
CONFIG_LVDS_WALLFACERA2_HSD123_SERDES_1920x720_LCD=y
CONFIG_MIPI_WALLFACERA2_HSD123_SERDES_1920x720_LCD=y
CONFIG_MIPI_WALLFACERA2_HSD123_SERDES_1920x720_2_LCD=y
CONFIG_MAXIM_DISP=y
CONFIG_DW_DMA=y
CONFIG_ARM_GIC=y
CONFIG_TCA9539=y
CONFIG_TCA6408=y
CONFIG_DW_I2C=y
CONFIG_KUNLUN_MBOX=y
CONFIG_KUNLUN_PINCTRL=y
CONFIG_KUNLUN_PWM=y
CONFIG_DW_RTC=y
CONFIG_KUNLUN_SEM=y
CONFIG_SERDES_KUNLUN_PLATFORM=y
CONFIG_SERDES_MAX967XX=y
CONFIG_KUNLUN_SND=y
CONFIG_CDNS_I2S_SC=y
CONFIG_SDRV_SYSCNT=y
CONFIG_SDRV_TMR=y
CONFIG_SUPPORT_LOG_TIMESTAMP=y
CONFIG_TOUCH_KUNLUN_GOODIX=y
CONFIG_TOUCH_LINK_WITH_SERDES=y
CONFIG_DW_UART=y
CONFIG_UNILINK=y
CONFIG_SDRV_KUNLUN_VPU=y
CONFIG_VPU_DEV_API=y
CONFIG_KUNLUN_MMC=y
CONFIG_MEMMAP=y
CONFIG_SLIMFS=y
CONFIG_SLIMFS_SLOT128_NUM=100
CONFIG_SLIMFS_SLOT256_NUM=100
CONFIG_SLIMFS_SLOT512_NUM=10
CONFIG_SLIMFS_SLOT16K_NUM=10
CONFIG_SLIMFS_SLOT32K_NUM=10
CONFIG_VERIFIED_BOOT=y
CONFIG_DISK_RAM=y
CONFIG_DISK_NAME="mmc0"
CONFIG_ELF_LOADER=y
CONFIG_ELF_LOADER_ADDR_CONVERT=y
CONFIG_CLI=y
CONFIG_IPCC_BUFF_NUM=16
CONFIG_RPMSG_WITH_LK=y
CONFIG_USE_IPCC_RPC=y
CONFIG_OBSERVE_AP1=y
CONFIG_OBSERVE_AP2=y
CONFIG_AUDIO_MANAGER=y
CONFIG_MEM_IMAGE=y
CONFIG_VI2C=y
CONFIG_BACKLIGHT_SERVICE=y
CONFIG_KUNLUN_CAMERA_SERVICE=y
CONFIG_CAN_PROXY=y
CONFIG_VCAN_CLIENT=y
CONFIG_CLUSTER_BRIDGE=y
CONFIG_DISP_CLIENT=y
CONFIG_DISPLAY_SERVICE=y
CONFIG_AVMCAST_SERVICE=y
CONFIG_INPUT_SERVICE_DUMMY_DATA=y
CONFIG_LWIP=y
CONFIG_NFS_CLIENT=y
CONFIG_PROPERTY=y
CONFIG_SDRV_PROP_SERVER=y
CONFIG_ERRCODE=y
CONFIG_MODULE_HELPER=y
CONFIG_MODULE_HELPER_PER_DDR=y
CONFIG_MODULE_HELPER_PER_TEST=y
CONFIG_MODULE_HELPER_PER_DISP=y
CONFIG_SDRV_VIRT_CONSOLE=y
CONFIG_VPU_SRV=y
CONFIG_VPU_CLIENT=y
CONFIG_GRAPHICS=y
CONFIG_VIRTIO_MMC_FRONTEND=y
CONFIG_TIME_SYNC=y
CONFIG_SDRV_SHM=y
CONFIG_DRIVERS_EXAMPLE=y
CONFIG_MBOX_DEMO=y
CONFIG_RPMSG_DEMO=y
CONFIG_APP_LAUNCHER=y
CONFIG_APPLICATION=y
CONFIG_APP_LAUNCHER_DEBUG=y
CONFIG_AUTO_START_BOOT_ANIMATION=y
CONFIG_BOOT_ANIMATION=y
CONFIG_LOOP_LOGO=y
CONFIG_CLOSE_GUI=y
CONFIG_CAM_PRE=y
CONFIG_CAM_DEBUG=y
CONFIG_AUDIO_MANAGER_TEST=y
CONFIG_PFM_ON=y
CONFIG_POWER_OFF=y
CONFIG_KERNEL_MONITOR=y
CONFIG_SEM_MONITOR=y
CONFIG_SDLOG_COMMAND=y
CONFIG_SDLOGC=y
CONFIG_SDLOGD=y
CONFIG_SDLOGD_POLL_SAF=y
CONFIG_SDLOGD_POLL_SEC=y
CONFIG_SDLOGD_POLL_AP1=y
CONFIG_SDLOGD_POLL_AP2=y
CONFIG_SDLOGD_OUTPUT_UART=y
CONFIG_SDSHELL_BACKEND=y
CONFIG_SDSHELL_AP1_FRONTEND=y
CONFIG_SDSHELL_AP2_FRONTEND=y
CONFIG_BACKLIGHT_DEMO=y
CONFIG_SILEX_CRYPTO_TESTER=y
CONFIG_DISP_TESTER=y
CONFIG_DISP_PQ_TESTER=y
CONFIG_FUSE_DEMO=y
CONFIG_INPUT_DEMO=y
CONFIG_SERDES_DEMO=y
CONFIG_TOUCH_DEMO=y
CONFIG_VPU_DEMO=y
CONFIG_I2C_TESTER=y
CONFIG_I2C_TOOLS_CMD=y
CONFIG_PIN_TESTER=y
CONFIG_MMC_TESTER=y
CONFIG_VPU_TEST=y
```

## myproject/ssdk/boards/x9cc_ms_a/safety/projects/ms-vmmc/defconfig
```kconfig
CONFIG_ARCH_EARLY_ENABLE_ICACHE=y
CONFIG_ARCH_EARLY_ENABLE_DCACHE=y
CONFIG_ARCH_USE_FPU=y
CONFIG_ARCH_USE_MPU=y
CONFIG_ARCH_FIQ_STACK_SIZE=256
CONFIG_ARCH_SVC_STACK_SIZE=2048
CONFIG_ARM_WITH_PMU=y
CONFIG_PHYS_RELOCATION=y
CONFIG_ARMV7R_TCMA_BASE=0x0
CONFIG_ARMV7R_TCMB_BASE=0x10000
CONFIG_ARCH_CHIP_X9_THANG=y
CONFIG_ARCH_CHIP_X9=y
CONFIG_MAIN_THREAD_PRIORITY=2
CONFIG_BOARD_REMAP=y
CONFIG_KUNLUN_BOOT_MP=y
CONFIG_SUPPORT_STR_MODE=y
CONFIG_HANDOVER_CFG=y
# CONFIG_SOC_CLK_INIT is not set
# CONFIG_SOC_RST_INIT is not set
CONFIG_OS_DEFAULT_STACK_SIZE=2048
CONFIG_KUNLUN_CKGEN=y
CONFIG_SILEX_CRYPTO=y
CONFIG_DW_DMA=y
CONFIG_KUNLUN_FUSE=y
CONFIG_ARM_GIC=y
CONFIG_DW_I2C=y
CONFIG_KUNLUN_MBOX=y
CONFIG_KUNLUN_PINCTRL=y
CONFIG_SDRV_KUNLUN_PMU=y
CONFIG_SDRV_KUNLUN_PVT=y
CONFIG_DW_RTC=y
CONFIG_KUNLUN_SEM=y
CONFIG_SDRV_SYSCNT=y
CONFIG_SDRV_TMR=y
CONFIG_SUPPORT_LOG_TIMESTAMP=y
CONFIG_DW_UART=y
CONFIG_UNILINK=y
CONFIG_SDRV_WDOG_KUNLUN=y
CONFIG_KUNLUN_MMC=y
CONFIG_PMIC=y
CONFIG_PMIC_LP875XX=y
CONFIG_MEMMAP=y
CONFIG_SLIMFS=y
CONFIG_SLIMFS_SLOT128_NUM=100
CONFIG_SLIMFS_SLOT256_NUM=100
CONFIG_SLIMFS_SLOT512_NUM=10
CONFIG_DISK_NAME="mmc0"
CONFIG_ELF_LOADER=y
CONFIG_ELF_LOADER_ADDR_CONVERT=y
CONFIG_CLI=y
CONFIG_RPMSG_WITH_LK=y
CONFIG_USE_IPCC_RPC=y
CONFIG_OBSERVE_AP1=y
CONFIG_OBSERVE_AP2=y
CONFIG_KUNLUN_REBOOT=y
CONFIG_UPDATE_MONITOR=y
CONFIG_APP_REBOOT_SS=y
CONFIG_NOTIFY_SEC_REBOOT=y
CONFIG_CAN_PROXY=y
CONFIG_SUPPORT_CAN_SDDRV=y
CONFIG_LWIP=y
CONFIG_PROPERTY=y
CONFIG_SDRV_PROP_CLIENT=y
CONFIG_ERRCODE=y
CONFIG_SDRV_VIRT_CONSOLE=y
CONFIG_VIRT_CONSOLE_MP_BE=y
CONFIG_SDRV_THERMAL_SERVICE=y
CONFIG_SUPPORT_CRASHDUMP_FEATURE=y
CONFIG_VIRTIO=y
CONFIG_VIRTIO_FRONTEND=y
CONFIG_VIRTIO_MMC_FRONTEND=y
CONFIG_TIME_SYNC=y
CONFIG_SDRV_SHM=y
CONFIG_DRIVERS_EXAMPLE=y
CONFIG_RPMSG_DEMO=y
CONFIG_PMU_DEMO=y
CONFIG_RTC_DEMO=y
CONFIG_APPLICATION=y
CONFIG_PVT_APPLICATION=y
CONFIG_PVT_APPLICATION_PRINT=y
# CONFIG_APP_AUDIO is not set
CONFIG_PFM_ON=y
CONFIG_POWER_OFF=y
CONFIG_KERNEL_MONITOR=y
CONFIG_SEM_MONITOR=y
CONFIG_SDLOG_COMMAND=y
CONFIG_SDLOGC=y
CONFIG_EXT_RST_REQ=y
CONFIG_SILEX_CRYPTO_TESTER=y
CONFIG_FUSE_DEMO=y
CONFIG_PIN_TESTER=y
# CONFIG_PINMUX_AP is not set
CONFIG_MMC_TESTER=y
```

## myproject/ssdk/boards/x9cc_ms_b/Kconfig
```kconfig
config BOARD_X9SP
    bool
    depends on ARCH_CHIP_X9
    default y

rsource "$(CORE)/Kconfig"
```

## myproject/ssdk/boards/x9h_ref/Kconfig
```kconfig
config BOARD_X9H_REF
    bool
    depends on ARCH_CHIP_X9
    default y

rsource "$(CORE)/Kconfig"
```

## myproject/ssdk/boards/x9h_ref/safety/projects/ref/defconfig
```kconfig
CONFIG_ARCH_EARLY_ENABLE_ICACHE=y
CONFIG_ARCH_EARLY_ENABLE_DCACHE=y
CONFIG_ARCH_USE_FPU=y
CONFIG_ARCH_USE_MPU=y
CONFIG_ARM_WITH_PMU=y
CONFIG_ARCH_CHIP_X9=y
CONFIG_MAIN_THREAD_PRIORITY=2
CONFIG_MEM_BASE=0x37200000
CONFIG_BOARD_REMAP=y
CONFIG_KUNLUN_CKGEN=y
CONFIG_ARM_GIC=y
CONFIG_KUNLUN_PINCTRL=y
CONFIG_SDRV_TMR=y
CONFIG_DW_UART=y
CONFIG_SDRV_WDOG_KUNLUN=y
CONFIG_MEMMAP=y
CONFIG_CLI=y
CONFIG_SUPPORT_CRASHDUMP_FEATURE=y
```

## myproject/ssdk/boards/x9h_ref/secure/Kconfig
```kconfig
comment "X9 Secure Core Options"

config MEM_BASE
    hex "Memory Start Address"
    default 0x3B000000

config MEM_SIZE
    hex "Memory Size"
    default 0x10000000

config BOARD_REMAP
    bool "Enable Kunlun board remap"
    select SCR
    select RESETGEN
    select KUNLUN_RESETGEN
    default n
```

## myproject/ssdk/boards/x9h_ref/secure/projects/ref/defconfig
```kconfig
CONFIG_ARCH_EARLY_ENABLE_ICACHE=y
CONFIG_ARCH_EARLY_ENABLE_DCACHE=y
CONFIG_ARCH_USE_FPU=y
CONFIG_ARCH_USE_MPU=y
CONFIG_ARCH_CHIP_X9=y
CONFIG_ARM_WITH_PMU=y
CONFIG_ARCH_CHIP_X9_SEC=y
CONFIG_MAIN_THREAD_PRIORITY=2
CONFIG_MEM_BASE=0x00140000
CONFIG_MEM_SIZE=0x40000
CONFIG_BOARD_REMAP=y
CONFIG_CLK=y
CONFIG_KUNLUN_CKGEN=y
CONFIG_IRQ=y
CONFIG_ARM_GIC=y
CONFIG_PINCTRL=y
CONFIG_KUNLUN_PINCTRL=y
CONFIG_TIMER=y
CONFIG_SDRV_TMR=y
CONFIG_DW_UART=y
CONFIG_MEMMAP=y
CONFIG_CLI=y
```
