## myproject/ssdk/Kconfig
```kconfig
menu "Arch Type"
rsource "arch/Kconfig"
endmenu

menu "Board Common Features"
rsource "boards/Kconfig"
endmenu

menu "RTOS Features"
rsource "rtos/Kconfig"
endmenu

menu "Device Drivers"
rsource "drivers/Kconfig"
endmenu

menu "Library Routines"
rsource "lib/Kconfig"
endmenu

menu "Middleware Routines"
rsource "middleware/Kconfig"
endmenu

menu "Driver and Application Examples"
rsource "examples/Kconfig"
endmenu

menu "Tester Routines"
orsource "test/Kconfig"
endmenu

menu "Validation Options"
orsource "validation/Kconfig"
endmenu
```

## myproject/ssdk/arch/Kconfig
```kconfig
comment "Architecture Options"

choice
    prompt "CPU Architecture"
    default ARCH_ARM

config ARCH_ARM
    bool "ARM"
    ---help---
        The ARM architectures

config ARCH_ARM64
    bool "ARM64"
    ---help---
        The ARM64 architectures

endchoice

if ARCH_ARM
config ARCH
    string
    default "arm"
endif

if ARCH_ARM64
config ARCH
    string
    default "arm64"
endif


menu "ARCH Common Options"

config ARCH_WITH_SMP
    bool "ARCH SMP"
    default n

if ARCH_WITH_SMP

config SMP_MAX_CPUS
    int "max cpu num"
    default 4

config SMP_CPU_CLUSTER_SHIFT
    int "smp cluster offset"
    default 8

config SMP_CPU_ID_BITS
    int "smp bit offset"
    default 24

endif

if !ARCH_WITH_SMP

config SMP_MAX_CPUS
    int "max cpu num"
    default 1
endif

config ARCH_WITH_CACHE
    bool "ARCH with cache"
    default n

config ARCH_CACHE_LINE
    int "cache line size"
    default 32

if ARCH_WITH_CACHE

config ARCH_ICACHE
    bool "ARCH with I-Cache"
    default n

config ARCH_DCACHE
    bool "ARCH with D-Cache"
    default n

config ARCH_L2CACHE
    bool "ARCH with L2 Cache"
    default n

config ARCH_DISABLE_ICACHE
    bool "ARCH disable I-Cache in arch init"
    default n
    depends on ARCH_ICACHE

config ARCH_DISABLE_DCACHE
    bool "ARCH disable D-Cache in arch init"
    default n
    depends on ARCH_DCACHE

if !ARCH_DISABLE_ICACHE

config ARCH_EARLY_ENABLE_ICACHE
    bool "ARCH early enable I-Cache"
    default n
    depends on ARCH_ICACHE

endif

if !ARCH_DISABLE_DCACHE

config ARCH_EARLY_ENABLE_DCACHE
    bool "ARCH early enable D-Cache"
    default n
    depends on ARCH_DCACHE

endif

endif # ARCH_WITH_CACHE

config ARCH_WITH_FPU
    bool "ARCH with FPU"
    default n

config ARCH_USE_FPU
    bool "ARCH enable FPU"
    default n
    depends on ARCH_WITH_FPU

config ARCH_WITH_MMU
    bool "ARCH with MMU"
    default n

config ARCH_USE_MMU
    bool "ARCH enable MMU"
    default n
    depends on ARCH_WITH_MMU

config ARCH_WITH_MPU
    bool "ARCH with MPU"
    default n

config ARCH_USE_MPU
    bool "ARCH enable MPU"
    default n
    depends on ARCH_WITH_MPU

config ARCH_STACK_DYNAMIC
    bool "Dynamic user stack"
    default y
    ---help---
        Select this option if the user process stack resides in its own
        address space.
if ARCH_ARM
if ARCH_STACK_DYNAMIC

config ARCH_STACK_COLORATION
    bool "Add stack coloration"
    default y

config ARCH_ABT_STACK_SIZE
    int "Abort stack size"
    default 128

config ARCH_IRQ_STACK_SIZE
    int "IRQ stack size"
    default 512

config ARCH_FIQ_STACK_SIZE
    int "FIQ stack size"
    default 1024

config ARCH_SYS_STACK_SIZE
    int "System stack size"
    default 2048

config ARCH_UND_STACK_SIZE
    int "Undefined stack size"
    default 128

config ARCH_SVC_STACK_SIZE
    int "Supervisor stack size"
    default 4096

endif # ARCH_STACK_DYNAMIC
endif
endmenu

if ARCH_ARM64

config ARCH_STACK_SIZE
    int "System stack size"
    default 4096

config ARCH_TLB_SIZE
    int "System tlb reserve size for mmu page table"
    default 131072

endif # ARCH_ARM64

if ARCH_ARM64
menu "ARM64 Specific Options"
rsource "arm64/Kconfig"
endmenu
endif

if ARCH_ARM
menu "ARM Specific Options"
rsource "arm/Kconfig"
endmenu
endif

comment "ARM Chip Options"

choice
    prompt "ARM MCU selection"
    default ARCH_CHIP_E3

config ARCH_CHIP_G9
    bool "Semidrive G9 Chip"
    select ARCH_CORTEXR5 if ARCH_ARM
    help
        Semidrive G9 Chip architectures

config ARCH_CHIP_X9
    bool "Semidrive X9 Chip"
    select ARCH_CORTEXR5 if ARCH_ARM
    help
        Semidrive X9 Chip architectures

config ARCH_CHIP_D9
    bool "Semidrive D9 Chip"
    select ARCH_CORTEXR5 if ARCH_ARM
    help
        Semidrive D9 Chip architectures

config ARCH_CHIP_E3
    bool "Semidrive E3 Chip"
    select ARCH_CORTEXR5
    help
        Semidrive E3 Chip architectures

config ARCH_CHIP_D3
    bool "Semidrive D3 Chip"
    select ARCH_CORTEXR5
    help
        Semidrive D3 Chip architectures

config ARCH_CHIP_OTHER
    bool "Semidrive Other Chip"
    select ARCH_CORTEXR5
    help
        Semidrive Other Chip architectures

endchoice
```

## myproject/ssdk/arch/arm/Kconfig
```kconfig
config ARCH_CORTEXR5
    bool
    select ARCH_WITH_CACHE
    select ARCH_DCACHE
    select ARCH_ICACHE
    select ARCH_WITH_MPU
    select ARM_WITH_CP15
    select ARM_THUMB
    select ARCH_WITH_FPU
    select ARM_FPU_D16
    ---help---
        The ARM CORTEXR5 architectures

config ARCH_FAMILY
    string
    default "armv7-r"   if ARCH_CORTEXR5

menu "ARM Chip Common Options"

config ARM_THUMB
    bool "Enable ARM Thumb"
    default n

if ARM_THUMB

config ARM_THUMB2
    bool "Enable ARM Thumb2"
    default n

endif # ARM_THUMB

config ARM_HIGHVECTORS
    bool "Vectors in high memory"
    default n

config ARM_WITH_TCM
    bool "ARM with TCM"
    default y

config ARM_WITH_CP15
    bool "ARM with CP15"
    default y

config ARM_WITH_PMU
    bool "ARM with PMU"
    default n
    select ARM_WITH_CP15

config ENABLE_CYCLE_COUNTER
    bool "Enable cycle counter"
    default n
    depends on ARM_WITH_PMU

config ARM_FPU_D16
    bool "ARM FPU D16"
    default n
    select ARCH_WITH_FPU

endmenu

config PHYS_RELOCATION
    bool "physical address relocation"
    default n

config SKIP_REMAP_DONE_RELOCATION
    bool "no relocation if remap is done"
    default y

if ARCH_CORTEXR5

menu "ARMV7-R Specific Options"
rsource "armv7-r/Kconfig"
endmenu

endif # ARCH_CORTEXR5

menu "Chip Specific Options"

if ARCH_CHIP_G9
orsource "g9/Kconfig"
endif # ARCH_CHIP_G9

if ARCH_CHIP_X9
orsource "x9/Kconfig"
endif # ARCH_CHIP_X9

if ARCH_CHIP_D9
orsource "d9/Kconfig"
endif # ARCH_CHIP_D9

if ARCH_CHIP_E3
orsource "e3/Kconfig"
endif # ARCH_CHIP_E3

if ARCH_CHIP_D3
orsource "d3/Kconfig"
endif # ARCH_CHIP_D3

endmenu
```

## myproject/ssdk/arch/arm/armv7-r/Kconfig
```kconfig
menu "ARMv7-R Configuration Options"

config ARMV7R_USE_TCMA
    bool "Use TCMA"
    default y
    depends on ARM_WITH_TCM

if ARMV7R_USE_TCMA

config ARMV7R_TCMA_BASE
    hex "TCMA base address"
    default 0x4C0000

config ARMV7R_TCMA_ECC
    bool "Enable TCMA ECC"
    default n

endif # ARMV7R_USE_TCMA

config ARMV7R_USE_TCMB
    bool "Use TCMB"
    default y
    depends on ARM_WITH_TCM

if ARMV7R_USE_TCMB

config ARMV7R_TCMB_BASE
    hex "TCMB base address"
    default 0x4B0000

config ARMV7R_TCMB_ECC
    bool "Enable TCMB ECC"
    default n

endif # ARMV7R_USE_TCMB

config ARMV7R_MPU_CACHE_ALIGN_CHECK
    bool "Enable cache align check"
    default n
    depends on ARCH_WITH_MPU

endmenu
```

## myproject/ssdk/arch/arm/d3/Kconfig
```kconfig
comment "D3 Chip Options"

choice
    prompt "Select Target Core"
    default ARCH_CHIP_D3_SF
    help
        Select the target core.

config ARCH_CHIP_D3_SF
    bool "D3 SF Core"

config ARCH_CHIP_D3_SP0
    bool "D3 SP0 Core"
    help
        D3 SP0 core in split mode or SP core in lockstep mode

config ARCH_CHIP_D3_SP1
    bool "D3 SP1 Core"
    help
        D3 SP1 core in split mode

config ARCH_CHIP_D3_SX0
    bool "D3 SX0 Core"
    help
        D3 SX0 core in split mode or SX core in lockstep mode

config ARCH_CHIP_D3_SX1
    bool "D3 SX1 Core"
    help
        D3 SX1 core in split mode

endchoice

config CORE
    string
    option env="CORE"

rsource "part/Kconfig"

config MULTI_CORE
    bool "D3 multi-core environment"
    default n
    help
        Enable multi-core environment
```

## myproject/ssdk/arch/arm/d9/Kconfig
```kconfig
comment "D9 Chip Options"

choice
    prompt "Select target core"
    default ARCH_CHIP_D9_SAF
    help
        Select the target core.

config ARCH_CHIP_D9_SAF
    bool "D9 Saftey Core"

config ARCH_CHIP_D9_SEC
    bool "D9 Secure Core"

endchoice
```

## myproject/ssdk/arch/arm/e3/Kconfig
```kconfig
comment "E3 Chip Options"

choice
    prompt "Select Target Core"
    default ARCH_CHIP_E3_SF
    help
        Select the target core.

config ARCH_CHIP_E3_SF
    bool "E3 SF Core"

config ARCH_CHIP_E3_SP0
    bool "E3 SP0 Core"
    help
        E3 SP0 core in split mode or SP core in lockstep mode

config ARCH_CHIP_E3_SP1
    bool "E3 SP1 Core"
    help
        E3 SP1 core in split mode

config ARCH_CHIP_E3_SX0
    bool "E3 SX0 Core"
    help
        E3 SX0 core in split mode or SX core in lockstep mode

config ARCH_CHIP_E3_SX1
    bool "E3 SX1 Core"
    help
        E3 SX1 core in split mode

endchoice

config CORE
    string
    option env="CORE"

rsource "part/Kconfig" 
if ("${CORE}" != 'sx0' && "${CORE}" != 'sx1' && "${CORE}" != 'sp0' && "${CORE}" != 'sp1')
    menu "Select Core Mode"
        choice
        depends on PART_SP
            prompt "SP Core Mode"
            default SP_Split
                config SP_Lockstep
                bool "SP Core Lockstep"
                config SP_Split
                bool "SP Core Split"
                depends on !PART_SP_LS_DISABLE
                config SP_OFF
                bool "SP Core OFF"
        endchoice

        choice 
        depends on PART_SX
            prompt "SX Core Mode"
            default SX_Split
                config SX_Lockstep
                bool "SX Core Lockstep"
                config SX_Split
                bool "SX Core Split"
                depends on !PART_SX_LS_DISABLE
                config SX_OFF
                bool "SX Core OFF"
        endchoice
    endmenu
endif

config MULTI_CORE
    bool "E3 multi-core environment"
    default n
    help
        Enable multi-core environment
```

## myproject/ssdk/arch/arm/g9/Kconfig
```kconfig
comment "G9 Chip Options"

choice
    prompt "Select target core"
    default ARCH_CHIP_G9_SAF
    help
        Select the target core.

config ARCH_CHIP_G9_SAF
    bool "G9 Saftey Core"

endchoice
```

## myproject/ssdk/arch/arm/x9/Kconfig
```kconfig
comment "X9 Chip Options"

choice
    prompt "Select target core"
    default ARCH_CHIP_X9_SAF
    help
        Select the target core.

config ARCH_CHIP_X9_SAF
    bool "X9 Saftey Core"

config ARCH_CHIP_X9_SEC
    bool "X9 Secure Core"

endchoice


config ARCH_CHIP_X9_THANG
    bool "Semidrive X9 Chip version thang"
    depends on ARCH_CHIP_X9
    default n
    help
        Semidrive X9  thang architectures
```

## myproject/ssdk/arch/arm64/Kconfig
```kconfig
comment "ARM64 Options"

choice
    prompt "ARM64 CPU selection"
    default ARCH_CORTEXA55

config ARCH_CORTEXA55
    bool "ARM CORTEXA55"
    select ARCH_WITH_CACHE
    select ARCH_DCACHE
    select ARCH_ICACHE
    select ARM_WITH_CP15
    select ARM_THUMB
    ---help---
        The ARM CORTEXA55 CPU

endchoice

config ARCH_FAMILY
    string
    default "armv8-a"   if ARCH_CORTEXA55

config ARM_THUMB
    bool "Enable ARM Thumb"
    default n

if ARM_THUMB

config ARM_THUMB2
    bool "Enable ARM Thumb2"
    default n

endif # ARM_THUMB

config ARM_WITH_CP15
    bool "ARM with CP15"
    default y

config ARM_WITH_PMU
    bool "ARM with PMU"
    default n
    select ARM_WITH_CP15

config ENABLE_CYCLE_COUNTER
    bool "Enable cycle counter"
    default n
    depends on ARM_WITH_PMU

rsource d9/Kconfig
```

## myproject/ssdk/boards/Kconfig
```kconfig
comment "Board Common Features"

config MAIN_THREAD_STACK_SIZE
    int "main thread stack size"
    default 8192

config MAIN_THREAD_PRIORITY
    int "main thread priority"
    default 24

config AUTO_SIGN_BOARD_IMG
    bool "after board build, auto sign board img, output xxx_signed.bin"
    default n

config CHIP_ID_DISPLAY
    bool "read and display chip id form fuse , and compare with ssdk chip id configration."
    select FUSE
    select TAISHAN_FUSE
    default n

config BOARD_LOOPSPERUSEC
    int "loop count per usec"
    default 300

config BOARD
    string
    option env="BOARD"

config BOARD_NAME_STR
    string
    default BOARD

# menuconfig BOARD_CORE_SELECT
choice
    prompt "select name for SoC core"
    default SAFETY

config SAFETY
    bool "SAFETY"

config SECURE
    bool "SECURE"

config MP
    bool "MP"

config AP
    bool "AP"
endchoice

config HAS_AP1
    def_bool y if BOARD_X9HP_MS || BOARD_X9HP_SP || BOARD_X9H_REF || BOARD_X9SP

config HAS_AP2
    def_bool y if BOARD_X9HP_MS || BOARD_X9HP_SP || BOARD_X9SP

menu "Board Special Features"
rsource "$(BOARD)/Kconfig"
endmenu
```

## myproject/ssdk/boards/bmu02_a00/secure/Kconfig
```kconfig
comment "D9 Secure Core Options"

config MEM_BASE
    hex "Memory Start Address"
    default 0x3B000000

config MEM_SIZE
    hex "Memory Size"
    default 0x10000000

config BOARD_REMAP
    bool "Enable Kunlun board remap"
    select SCR
    select RESETGEN
    select KUNLUN_RESETGEN
    default n

config FIREWALL_DISABLE
    bool "disable firewall function"
	default y

config EARLYCOPY
    bool "early copy"
    default n

config SUPPORT_STR_MODE
    bool "support str mode"
    default n

config PROJECT_VERSION
    string "Custom project version string"
    default "V0.0.1"
    help
      This is a custom string macro for device version, 
      e.g. "V1.0.2" etc.
```

## myproject/ssdk/boards/bmu02_a00/secure/projects/lowerpoweros/defconfig
```kconfig
CONFIG_ARCH_EARLY_ENABLE_ICACHE=y
CONFIG_ARCH_EARLY_ENABLE_DCACHE=y
CONFIG_ARCH_USE_FPU=y
CONFIG_ARCH_USE_MPU=y
CONFIG_ARM_WITH_PMU=y
CONFIG_ARCH_CHIP_D9=y
CONFIG_MAIN_THREAD_PRIORITY=2
CONFIG_MEM_BASE=0x100000
CONFIG_MEM_SIZE=0x40000
CONFIG_OS_BAREMETAL=y
CONFIG_DWCMSHC=y
CONFIG_KUNLUN_CKGEN=y
CONFIG_KUNLUN_FUSE=y
CONFIG_ARM_GIC=y
CONFIG_KUNLUN_MBOX=y
CONFIG_KUNLUN_SEM=y
CONFIG_SDRV_SYSCNT=y
CONFIG_SDRV_TMR=y
CONFIG_DW_UART=y
CONFIG_KUNLUN_MMC=y
CONFIG_MEMMAP=y
CONFIG_DEBUG_LEVEL=5
CONFIG_DISK_MMC=y
CONFIG_DISK_NOR_FLASH=y
CONFIG_PARTITION=y
CONFIG_CLI=y
CONFIG_RPMSG_SERVICE=y
CONFIG_RPMSG_WITH_LK=y
CONFIG_USE_IPCC_RPC=y
CONFIG_OBSERVE_AP1=y
CONFIG_OBSERVE_AP2=y
CONFIG_STR_CORE=y
CONFIG_LOWER_POWER_OS=y
CONFIG_SAVE_DDR_INFO_IN_EMMC=y
```

## myproject/ssdk/boards/bmu05_a00/secure/Kconfig
```kconfig
comment "D9 Secure Core Options"

config MEM_BASE
    hex "Memory Start Address"
    default 0x3B000000

config MEM_SIZE
    hex "Memory Size"
    default 0x10000000

config BOARD_REMAP
    bool "Enable Kunlun board remap"
    select SCR
    select RESETGEN
    select KUNLUN_RESETGEN
    default n

config FIREWALL_DISABLE
    bool "disable firewall function"
	default y

config EARLYCOPY
    bool "early copy"
    default n

config SUPPORT_STR_MODE
    bool "support str mode"
    default n

config PROJECT_VERSION
    string "Custom project version string"
    default "V0.0.1"
    help
      This is a custom string macro for device version, 
      e.g. "V1.0.2" etc.

config XIP_MODE
    bool "Run in XIP mode"
    default n

config RAM_BASE
    hex "RAM base for XIP mode"
    depends on XIP_MODE
    default 0x140000

config RAM_SIZE
    hex "RAM size for XIP mode"
    depends on XIP_MODE
    default 0xC0000

config IRAM_NONE_ECC_BASE
    hex "IRAM NONE-ECC Base Address"
    default 0x0

config IRAM_NONE_ECC_SIZE
    hex "IRAM NONE-ECC Size"
    default 0x0

config ARMV7R_TCMA_BASE
    hex "ARMV7-R TCMA Base Address"
    default 0x004b0000

config ARMV7R_TCMB_BASE
    hex "ARMV7-R TCMB Base Address"
    default 0x004c0000
```

## myproject/ssdk/boards/bmu05_t00/Kconfig
```kconfig
config BOARD_D9360_REF
    bool
    select HAS_AP1
    depends on ARCH_CHIP_D9
    default y

rsource "$(CORE)/Kconfig"
```
