## myproject/ssdk/drivers/kunlun/clk/Kconfig
```kconfig
menuconfig KUNLUN_CKGEN
    bool "Kunlun Clock Generator Driver Support"
    select CLK
    select SC_PLL
    default n

if KUNLUN_CKGEN

config SC_PLL
    bool "SC PLL Driver"
    default n

config CLK_MONITOR
    bool "Enable Clock Monitor"
    default n

config CLK_PARENTS_NUM
    int
    default 8

endif # KUNLUN_CKGEN
```

## myproject/ssdk/drivers/kunlun/crypto/silex_crypto/Kconfig
```kconfig
comment "Kunlun Silex Crypto Driver Options"

menuconfig SILEX_CRYPTO
    bool "Silex CRYPTO Driver Support"
    default n

menuconfig SILEX_CRYPTO_CPUID
    int "Silex CRYPTO Driver for which core"
    default 0
```

## myproject/ssdk/drivers/kunlun/csi/Kconfig
```kconfig
menuconfig CSI
    bool "Kunlun & Taihang CSI/Camera Support"
    default n

if CSI

config CSI_NUM
    int
    default 3

config CSI_CH_NUM
    int
    default 4

config CSI_VERSION
    int
    default 0

config OV5640
    bool "sensor ov5640 driver"
    default n
    depends on I2C

config DESER
    bool "camera serdes driver"
    default n
    depends on I2C

config mipi_max9286_fengjing_MC163_720P_MAX96705
    bool "camera fengjing module with max9286 and max96705"
	default n
    depends on DESER

config dvp_max96706_fengjing_MC163_MAX96705
    bool "camera fengjing module with max96706 and max96705"
    default n
    depends on DESER

config mipi_max96722_fengjing_MC163_MAX96705
    bool "camera fengjing module with max96722 and max96705"
    default n
    depends on DESER

config mipi_max96722_sengyun_IMX390C_5200_MAX9295
    bool "camera senyun module with max96722 and max9295"
    default n
    depends on DESER

endif #CSI
```

## myproject/ssdk/drivers/kunlun/dispss/Kconfig
```kconfig
menuconfig DISPSS
    bool "Display Driver Support"
    default n

if DISPSS
rsource "sd_disp/Kconfig"
rsource "lcm/Kconfig"

menuconfig DISP_VLDN_SUPPORT
    bool "display validation support"
    default n

if DISP_VLDN_SUPPORT
#    rsource "disp_vldn/Kconfig"
endif

endif #DISPSS
```

## myproject/ssdk/drivers/kunlun/dispss/lcm/Kconfig
```kconfig
comment "LCM Driver Options"

menuconfig LVDS_HSD123_SERDES_1920x720_LCD
    bool "lvds_hsd123_serdes_1920x720_lcd driver"
    default n

menuconfig MIPI_HSD123_SERDES_1920x720_LCD
    bool "mipi_hsd123_serdes_1920x720_lcd driver"
    default n

menuconfig MIPI_HSD123_SERDES_1920x720_2_LCD
    bool "mipi_hsd123_serdes_1920x720_2_lcd driver"
    default n

menuconfig LVDS_HSD123_SERDES_1920x720_x9u_b_LCD
    bool "lvds_hsd123_serdes_1920x720_x9u_b_lcd serdes_1920x720_lcd driver"
    default n

menuconfig LVDS_HSD101_SERDES_1280x800_LCD
    bool "lvds_hsd101_serdes_1280x800_lcd driver"
    default n

menuconfig LVDS_KD070_SERDES_1024x600_LCD
    bool "lvds_kd070_serdes_1024x600_lcd driver"

menuconfig LVDS_LMT070_SERDES_800x480_LCD
    bool "lvds_lmt070_serdes_800x480_lcd driver"

menuconfig LVDS_WALLFACERA2_HSD123_SERDES_1920x720_LCD
    bool "lvds_WallfacerA2_hsd123_serdes_1920x720_lcd driver"

menuconfig LVDS_WALLFACERA2_HSD123_SERDES_1920x720_2_LCD
    bool "lvds_WallfacerA2_hsd123_serdes_1920x720_2_lcd driver"

menuconfig MIPI_WALLFACERA2_HSD123_SERDES_1920x720_LCD
    bool "mipi_WallfacerA2_hsd123_serdes_1920x720_lcd driver"

menuconfig MIPI_WALLFACERA2_HSD123_SERDES_1920x720_2_LCD
    bool "mipi_WallfacerA2_hsd123_serdes_1920x720_2_lcd driver"

menuconfig MIPI_WALLFACERA_HSD160_SERDES_2560x1600_LCD
    bool "mipi_WallfacerA_hsd160_serdes_2560x1600_lcd driver"

menuconfig LVDS_KD070_MAX_SERDES_1024x600_LCD
    bool "lvds_kd070_max_serdes_1024x600_lcd driver"

menuconfig DS90UB9XX
    bool "ds90ub9xx driver"
    default n

menuconfig MAXIM_DISP
    bool "maxim display serdes driver"
    default n
```

## myproject/ssdk/drivers/kunlun/dispss/sd_disp/Kconfig
```kconfig
comment "DISPSS_Version_Options"

menuconfig DISPSS_KUNLUN
	bool "KUNLUN Display Driver"
	default n

menuconfig DISPSS_TAIHANG
	bool "TAIHANG Display Driver"
	default n
```

## myproject/ssdk/drivers/kunlun/dma/Kconfig
```kconfig
config DW_DMA
    bool "DesignWare DMA Driver Support"
	select DMA
    default n

config DW_PCIE_DMA
    bool "DesignWare PCIe DMA Driver Support"
	select DMA
    default n
    depends on DWC_PCIE
```

## myproject/ssdk/drivers/kunlun/eth/Kconfig
```kconfig
config DWC_ETH
    bool "Kunlun dwc eth Driver Support"
    select ETH
    default n
```

## myproject/ssdk/drivers/kunlun/fuse/Kconfig
```kconfig
config KUNLUN_FUSE
    bool "Kunlun FUSE Driver Support"
    select FUSE
    default n
```

## myproject/ssdk/drivers/kunlun/g2dlite/Kconfig
```kconfig
comment "Kunlun g2dlite Options"

menuconfig G2DLITE
    bool "kunlun g2dlite driver"
    default n
```

## myproject/ssdk/drivers/kunlun/gic/Kconfig
```kconfig
menuconfig ARM_GIC
    bool "ARM GIC Driver"
    select IRQ
    default n

if ARM_GIC

config INTERRUPT_NESTING
    bool "Support interrupt nesting"
    default n

endif # ARM_GIC
```

## myproject/ssdk/drivers/kunlun/gpio/Kconfig
```kconfig
config KUNLUN_GPIO
    bool "Kunlun GPIO Driver Support"
    select GPIO
    default n

config TCA9539
    bool "TCA9539 I/O Expander Driver Support"
    depends on I2C
    select GPIO
    default n

config TCA6408
    bool "TC6408 I/O Expander Driver Support"
    depends on I2C
    select GPIO
    default n
```

## myproject/ssdk/drivers/kunlun/i2c/Kconfig
```kconfig
config DW_I2C
    bool "DesignWare I2C Driver support"
    select I2C
    default n
```

## myproject/ssdk/drivers/kunlun/lin/Kconfig
```kconfig
config UART_LIN
    bool "Kunlun Lin driver Support"
    select UART
    select DW_UART
    default n
```

## myproject/ssdk/drivers/kunlun/mbox/Kconfig
```kconfig
menuconfig KUNLUN_MBOX
    bool "Kunlun Mailbox driver Support"
    select MBOX
    default n

if KUNLUN_MBOX

config MBOX_TX_POLL
    int "Mailbox tx polling timer(us)"
    default 2

endif # KUNLUN_MBOX
```

## myproject/ssdk/drivers/kunlun/mmc/Kconfig
```kconfig
menuconfig KUNLUN_MMC
    bool "Kunlun MMC Driver Options"
    select MBOX
    default n
if KUNLUN_MMC
config DWCMSHC
    bool "DWCMSHC Driver"
    default n
config SEHC
    bool "SEHC Driver"
    default n
endif # KUNLUN_MMC
```

## myproject/ssdk/drivers/kunlun/pcie/Kconfig
```kconfig
config DWC_PCIE
    bool "DWC PCIE Driver Support"
    select PCIE
    default n
```

## myproject/ssdk/drivers/kunlun/pinctrl/Kconfig
```kconfig
config KUNLUN_PINCTRL
    bool "Kunlun PIN CTRL driver Support"
    select PINCTRL
    select GPIO
    select KUNLUN_GPIO
    default n
```

## myproject/ssdk/drivers/kunlun/pmic/Kconfig
```kconfig
config PMIC
    bool "pmic Support"
    default n

config PMIC_LP875XX
    bool "pmic lp875xx driver Support"
    default n
```

## myproject/ssdk/drivers/kunlun/pmu/Kconfig
```kconfig
menuconfig SDRV_KUNLUN_PMU
    bool "kunlun PMU Driver"
    select PMU
    default n

if SDRV_KUNLUN_PMU
    comment "kunlun pmu driver config option"
endif
```

## myproject/ssdk/drivers/kunlun/pvt/Kconfig
```kconfig
menuconfig SDRV_KUNLUN_PVT
    bool "kunlun PVT Driver"
    select PVT
    default n

if SDRV_KUNLUN_PVT
    comment "kunlun pvt driver config option"
endif
```

## myproject/ssdk/drivers/kunlun/reset/Kconfig
```kconfig
config KUNLUN_RESETGEN
    bool "Kunlun reset gen Driver Support"
    select RESETGEN
    default n
```
