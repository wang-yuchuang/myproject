## myproject/ssdk/drivers/taishan/can/Kconfig
```kconfig
menuconfig FLEXCAN
    bool "Flexcan Driver Support"
    select CAN
    default n

if FLEXCAN

config SDRV_FLEXCAN_ENH
    bool "SemiDrive enhancements for Flexcan"
    default n

endif # FLEXCAN
```

## myproject/ssdk/drivers/taishan/clk/Kconfig
```kconfig
menuconfig TAISHAN_CKGEN
    bool "Taishan Clock Generator Driver Support"
    select CLK
    select TAISHAN_PLL
    default n

if TAISHAN_CKGEN

config TAISHAN_PLL
    bool

config CLK_MONITOR
    bool "Enable Clock Monitor"
    default n

config CLK_PARENTS_NUM
    int
    default 5

endif # TAISHAN_CKGEN
```

## myproject/ssdk/drivers/taishan/crypto/osr_crypto/Kconfig
```kconfig
menuconfig OSR_CRYPTO
    bool "OSR CRYPTO Driver Support"
    default n

if OSR_CRYPTO

config OSR_CRYPTO_DRIVER
    bool "osr crypto driver"
    default n

config OSR_CRYPTO_DRIVER_AES
    bool "osr crypto aes driver"
    default n
    depends on OSR_CRYPTO_DRIVER

config OSR_CRYPTO_DRIVER_PKE
    bool "osr crypto pke driver"
    default n
    depends on OSR_CRYPTO_DRIVER

config OSR_CRYPTO_DRIVER_HASH
    bool "osr crypto hash driver"
    default n
    depends on OSR_CRYPTO_DRIVER

config OSR_CRYPTO_DRIVER_MAILBOX
    bool "osr crypto mailbox driver"
    default n
    depends on OSR_CRYPTO_DRIVER

endif # OSR_CRYPTO
```

## myproject/ssdk/drivers/taishan/csi/Kconfig
```kconfig
menuconfig CSI
    bool "Taishan CSI Support"
    default n

if CSI

config CSI_NUM
    int
    default 1

config CSI_CH_NUM
    int
    default 2

config CSI_VERSION
    int
    default 1

config CSI_IOMUX
    bool "csi iomux for pin to external devices"
    default n

config OV5640
    bool "sensor ov5640 driver"
    default n
    depends on I2C

config MAX96706
    bool "camera deser max96706 driver"
    default n
    depends on I2C

config TI926
    bool "video in deser ti926 driver"
    default n
    depends on I2C

config VIRTUAL_CAMERA
    bool "virtual camera driver"
    default n

endif #CSI
```

## myproject/ssdk/drivers/taishan/dispss/Kconfig
```kconfig
menuconfig DISPSS
    bool "Taishan Dispss Support"
    default n

if DISPSS
rsource "lcm/Kconfig"
endif #DISPSS
```

## myproject/ssdk/drivers/taishan/dispss/lcm/Kconfig
```kconfig
comment "LCM Driver Options"

menuconfig LVDS_800X600_LCD
    bool "lvds_800x600_lcd driver"
    default n
    depends on DISPSS

menuconfig HDMI_ADV_800X600_LCD
    bool "hdmi_adv_800x600_lcd driver"
    default n
    depends on DISPSS

menuconfig RGB_1280X800_LCD
    bool "rgb_1280x720_lcd driver"
    default n
    depends on DISPSS

menuconfig RGB_800X600_LCD_Z1
    bool "rgb_800x600_lcd_z1 driver"
    default n
    depends on DISPSS

menuconfig LVDS_1440X540_LCD
    bool "lvds_1440x540_lcd driver"
    default n
    depends on DISPSS

menuconfig LVDS_1280X768_LCD
    bool "lvds_1280x768_lcd driver"
    default n
    depends on DISPSS

menuconfig RGB_480X272_LCD
    bool "rgb_480x272_lcd driver"
    default n
    depends on DISPSS

menuconfig LVDS_LT9211_TO_MIPI_480x1920_LCD
    bool "lvds_lt9211_to_mipi_480x1920_lcd driver"
    default n
    depends on DISPSS

menuconfig LVDS_1920X1080_LCD
    bool "lvds_1920x1080_lcd driver"
    default n
    depends on DISPSS

menuconfig LVDS_LT9211_1PORT_TO_2PORT_1920x720_LCD
    bool "lvds_lt9211_1port_to_2port_1920x720_lcd driver"
    default n
    depends on DISPSS
```

## myproject/ssdk/drivers/taishan/dma/Kconfig
```kconfig
menuconfig SDRV_DMA
    bool "Taishan DMA Driver Support"
	select DMA
    default n

if SDRV_DMA

config SDRV_DMA_USE_LBC
     bool "Load lli description using DMA local buffer"
     default n

config SDRV_DMA_1_0
    bool "Semidrive DMA hardware version 1.0"
    default y

endif # SDRV_DMA
```

## myproject/ssdk/drivers/taishan/epwm/Kconfig
```kconfig
menuconfig SDRV_EPWM
    bool "Taishan EPWM Driver Support"
    select PWM
    default n

if SDRV_EPWM

config SDRV_EPWM_LITE
    bool "Taishan Lite EPWM Driver Support"
    default n

endif # SDRV_EPWM
```

## myproject/ssdk/drivers/taishan/eth/Kconfig
```kconfig
config DWC_ETH
    bool "Taishan dwc eth Driver Support"
    select ETH
    default n
```

## myproject/ssdk/drivers/taishan/etimer/Kconfig
```kconfig
menuconfig SDRV_ETIMER
    bool "Taishan Etimer Driver Support"
    select TIMER
    default n

if SDRV_ETIMER

config SDRV_ETIMER_PWM
    bool "Taishan ETIMER Driver"
    default n

config SDRV_ETIMER_PWM_LITE
    bool "Taishan Lite ETIMER Driver"
    default n

endif # SDRV_ETIMER
```

## myproject/ssdk/drivers/taishan/fuse/Kconfig
```kconfig
config TAISHAN_FUSE
    bool "Taishan FUSE Driver Support"
    select FUSE
    default n
```

## myproject/ssdk/drivers/taishan/gpio/Kconfig
```kconfig
config TAISHAN_GPIO
    bool "Taishan GPIO Driver Support"
    select GPIO
    default n
```

## myproject/ssdk/drivers/taishan/hwmutex/Kconfig
```kconfig
config TAISHAN_HWMUTEX
    bool "Taishan HWMUTEX Driver Support"
    select HWMUTEX
    select TAISHAN_MBOX
    default n
```

## myproject/ssdk/drivers/taishan/i2c/Kconfig
```kconfig
config SDRV_I2C
    bool "Taishan I2C Driver Support"
    select I2C
    default n
```

## myproject/ssdk/drivers/taishan/irda/Kconfig
```kconfig
config SDRV_IRDA
    bool "Taishan IRDA Driver Support"
    select UART
    select SDRV_UART
    select IRDA
    default n
```

## myproject/ssdk/drivers/taishan/lin/Kconfig
```kconfig
config SDRV_LIN
    bool "Taishan Lin driver Support"
    select UART
    select SDRV_UART
    default n
```

## myproject/ssdk/drivers/taishan/mbox/Kconfig
```kconfig
menuconfig TAISHAN_MBOX
    bool "Taishan Mailbox driver Support"
    select MBOX
    default n

if TAISHAN_MBOX

config MBOX_FLUSH_CACHE
    bool "Taishan Mailbox flush cache"
    default y

config MBOX_TX_POLL
    int "Mailbox tx polling timer(us)"
    default 2

endif # TAISHAN_MBOX
```

## myproject/ssdk/drivers/taishan/mmc/Kconfig
```kconfig
config DWCMSHC
    bool "DWCMSHC Driver Support"
    select MMC
    default n

config SEHC
    bool "SEHC Driver Support"
    select MMC
    default n
```

## myproject/ssdk/drivers/taishan/pinctrl/Kconfig
```kconfig
config TAISHAN_PINCTRL
    bool "Taishan PIN CTRL driver Support"
    select PINCTRL
    select GPIO
    select TAISHAN_GPIO
    default n
```

## myproject/ssdk/drivers/taishan/pmu/Kconfig
```kconfig
config SDRV_PMU
    bool "Taishan PMU Driver Support"
    select PMU
    default n
```

## myproject/ssdk/drivers/taishan/power/Kconfig
```kconfig
menuconfig TAISHAN_PM
    bool "Taishan Power manager driver Support"
    select PM
    select MBOX
    select RESETGEN
    select TAISHAN_MBOX
    select TAISHAN_RESETGEN
    default n

if TAISHAN_PM

config DEFAULT_TAISHAN_PM_STATE
    int "Taishan default PM state"
    default 1

config DEBUG_TAISHAN_PM
    bool "Debug taishan power manager driver"
    default n

config TRACE_TAISHAN_PM
    bool "Trace taishan power manager driver"
    default n

endif
```

## myproject/ssdk/drivers/taishan/reset/Kconfig
```kconfig
config TAISHAN_RESETGEN
    bool "Taishan reset gen Driver Support"
    select RESETGEN
    default n
```

## myproject/ssdk/drivers/taishan/rtc/Kconfig
```kconfig
config SEC_RTC
    bool "Taishan RTC Driver Support"
    select RTC 
    default n
```
